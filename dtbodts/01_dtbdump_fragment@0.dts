/dts-v1/;

/ {

	__fixups__ {
		accdet = "/fragment@12:target:0";
		auxadc = "/fragment@24:target:0\0/fragment@25/__overlay__:io-channels:0";
		chosen = "/fragment@1:target:0";
		consys = "/fragment@14:target:0";
		dsi_te = "/fragment@44:target:0";
		fpc = "/fragment@10:target:0";
		gpio = "/fragment@37:target:0";
		gpio_usage_mapping = "/fragment@36:target:0";
		i2c0 = "/fragment@19:target:0\0/fragment@23:target:0\0/fragment@27:target:0";
		i2c1 = "/fragment@28:target:0";
		i2c2 = "/fragment@8:target:0\0/fragment@29:target:0";
		i2c3 = "/fragment@30:target:0";
		i2c4 = "/fragment@31:target:0";
		i2c5 = "/fragment@32:target:0";
		i2c6 = "/fragment@33:target:0";
		i2c7 = "/fragment@2:target:0\0/fragment@34:target:0";
		i2c8 = "/fragment@35:target:0";
		i2c_lcd_bias_mtk = "/fragment@18:target:0";
		irq_nfc = "/fragment@39:target:0";
		irtx_pwm = "/fragment@15:target:0";
		kd_camera_hw1 = "/fragment@55:target:0\0/fragment@59:target:0";
		keypad = "/fragment@57:target:0";
		lcm_power_gpio = "/fragment@7:target:0";
		main_pmic = "/fragment@45:target:0";
		md1_sim1_hot_plug_eint = "/fragment@46:target:0";
		md1_sim2_hot_plug_eint = "/fragment@47:target:0";
		md_auxadc = "/fragment@25:target:0";
		mt_pmic_vcama1_ldo_reg = "/fragment@48:target:0\0/fragment@55/__overlay__:vcama-supply:0\0/fragment@59/__overlay__:cam2_vcama-supply:0\0/fragment@59/__overlay__:cam3_vcama-supply:0\0/fragment@59/__overlay__:cam4_vcama-supply:0";
		mt_pmic_vcama2_ldo_reg = "/fragment@49:target:0\0/fragment@55/__overlay__:vcama_sub-supply:0";
		mt_pmic_vcamd_ldo_reg = "/fragment@52:target:0\0/fragment@55/__overlay__:vcamd_main2-supply:0\0/fragment@59/__overlay__:cam1_vcamd-supply:0\0/fragment@59/__overlay__:cam3_vcamd-supply:0";
		mt_pmic_vcamio_ldo_reg = "/fragment@53:target:0\0/fragment@55/__overlay__:vcamio-supply:0\0/fragment@55/__overlay__:vcamio_sub-supply:0\0/fragment@55/__overlay__:vcamio_main2-supply:0\0/fragment@59/__overlay__:cam0_vcamio-supply:0\0/fragment@59/__overlay__:cam1_vcamio-supply:0\0/fragment@59/__overlay__:cam2_vcamio-supply:0\0/fragment@59/__overlay__:cam3_vcamio-supply:0\0/fragment@59/__overlay__:cam4_vcamio-supply:0";
		mt_pmic_vldo28_ldo_reg = "/fragment@54:target:0\0/fragment@55/__overlay__:vcamaf-supply:0\0/fragment@55/__overlay__:vcamaf_sub-supply:0\0/fragment@55/__overlay__:vcamaf_main2-supply:0\0/fragment@56/__overlay__:vtouch-supply:0";
		mt_pmic_vsim1_ldo_reg = "/fragment@50:target:0";
		mt_pmic_vsim2_ldo_reg = "/fragment@51:target:0";
		mtkfb = "/fragment@21:target:0";
		odm = "/fragment@3:target:0";
		pio = "/fragment@2/__overlay__/speaker_amp@34:reset-gpio:0\0/fragment@2/__overlay__/speaker_amp@34:irq-gpio:0\0/fragment@5:target:0\0/fragment@7/__overlay__:gpio_lcd_ldo18_gpio:0\0/fragment@7/__overlay__:gpio_lcd_bias_enp_gpio:0\0/fragment@7/__overlay__:gpio_lcd_bias_enn_gpio:0\0/fragment@10/__overlay__:interrupt-parent:0\0/fragment@11:target:0\0/fragment@13:target:0\0/fragment@16:target:0\0/fragment@17:target:0\0/fragment@19/__overlay__/dcam@40:pdn_pin:0\0/fragment@19/__overlay__/dcam@40:rst_pin:0\0/fragment@20:target:0\0/fragment@22:target:0\0/fragment@36/__overlay__:GPIO_SIM2_HOT_PLUG:0\0/fragment@36/__overlay__:GPIO_SIM1_HOT_PLUG:0\0/fragment@36/__overlay__:GPIO_SIM2_SIO:0\0/fragment@36/__overlay__:GPIO_SIM2_SRST:0\0/fragment@36/__overlay__:GPIO_SIM2_SCLK:0\0/fragment@36/__overlay__:GPIO_SIM1_SCLK:0\0/fragment@36/__overlay__:GPIO_SIM1_SRST:0\0/fragment@36/__overlay__:GPIO_SIM1_SIO:0\0/fragment@38/__overlay__:interrupt-parent:0\0/fragment@39/__overlay__:interrupt-parent:0\0/fragment@40/__overlay__:interrupt-parent:0\0/fragment@41/__overlay__:interrupt-parent:0\0/fragment@42/__overlay__:interrupt-parent:0\0/fragment@43/__overlay__:interrupt-parent:0\0/fragment@44/__overlay__:interrupt-parent:0\0/fragment@45/__overlay__:interrupt-parent:0\0/fragment@58:target:0";
		pmic_clock_buffer_ctrl = "/fragment@26:target:0";
		reserved_memory = "/fragment@0:target:0";
		rt9465_slave_chr = "/fragment@43:target:0";
		smart_pa = "/fragment@41:target:0";
		spi0 = "/fragment@6:target:0";
		spi2 = "/fragment@9:target:0";
		subpmic_pmu_eint = "/fragment@40:target:0";
		tcpc_pd = "/fragment@42:target:0";
		touch = "/fragment@4:target:0\0/fragment@38:target:0\0/fragment@56:target:0";
	};

	__local_fixups__ {

		fragment@10 {

			__overlay__ {
				pinctrl-0 = <0x00>;
				pinctrl-1 = <0x00>;
				pinctrl-10 = <0x00>;
				pinctrl-11 = <0x00>;
				pinctrl-12 = <0x00>;
				pinctrl-13 = <0x00>;
				pinctrl-2 = <0x00>;
				pinctrl-3 = <0x00>;
				pinctrl-4 = <0x00>;
				pinctrl-5 = <0x00>;
				pinctrl-6 = <0x00>;
				pinctrl-7 = <0x00>;
				pinctrl-8 = <0x00>;
				pinctrl-9 = <0x00>;
			};
		};

		fragment@14 {

			__overlay__ {
				pinctrl-0 = <0x00>;
				pinctrl-1 = <0x00>;
				pinctrl-2 = <0x00>;
				pinctrl-3 = <0x00>;
				pinctrl-4 = <0x00>;
				pinctrl-5 = <0x00>;
				pinctrl-6 = <0x00>;
			};
		};

		fragment@15 {

			__overlay__ {
				pinctrl-0 = <0x00>;
				pinctrl-1 = <0x00>;
			};
		};

		fragment@18 {

			__overlay__ {
				pinctrl-0 = <0x00>;
				pinctrl-1 = <0x00>;
				pinctrl-2 = <0x00>;
				pinctrl-3 = <0x00>;
				pinctrl-4 = <0x00>;
			};
		};

		fragment@21 {

			__overlay__ {
				pinctrl-0 = <0x00>;
				pinctrl-1 = <0x00>;
				pinctrl-2 = <0x00>;
			};
		};

		fragment@23 {

			__overlay__ {

				aw36518@63 {
					pinctrl-0 = <0x00>;
					pinctrl-1 = <0x00>;
					pinctrl-2 = <0x00>;
					pinctrl-3 = <0x00>;
					pinctrl-4 = <0x00>;
				};
			};
		};

		fragment@4 {

			__overlay__ {
				pinctrl-0 = <0x00>;
				pinctrl-1 = <0x00>;
				pinctrl-2 = <0x00>;
				pinctrl-3 = <0x00>;
				pinctrl-4 = <0x00>;
				pinctrl-5 = <0x00>;
			};
		};

		fragment@59 {

			__overlay__ {
				pinctrl-0 = <0x00>;
				pinctrl-1 = <0x00>;
				pinctrl-10 = <0x00>;
				pinctrl-11 = <0x00>;
				pinctrl-12 = <0x00>;
				pinctrl-13 = <0x00>;
				pinctrl-14 = <0x00>;
				pinctrl-15 = <0x00>;
				pinctrl-16 = <0x00>;
				pinctrl-17 = <0x00>;
				pinctrl-18 = <0x00>;
				pinctrl-19 = <0x00>;
				pinctrl-2 = <0x00>;
				pinctrl-20 = <0x00>;
				pinctrl-21 = <0x00>;
				pinctrl-22 = <0x00>;
				pinctrl-23 = <0x00>;
				pinctrl-24 = <0x00>;
				pinctrl-25 = <0x00>;
				pinctrl-26 = <0x00>;
				pinctrl-27 = <0x00>;
				pinctrl-28 = <0x00>;
				pinctrl-29 = <0x00>;
				pinctrl-3 = <0x00>;
				pinctrl-30 = <0x00>;
				pinctrl-31 = <0x00>;
				pinctrl-32 = <0x00>;
				pinctrl-33 = <0x00>;
				pinctrl-34 = <0x00>;
				pinctrl-35 = <0x00>;
				pinctrl-36 = <0x00>;
				pinctrl-37 = <0x00>;
				pinctrl-38 = <0x00>;
				pinctrl-39 = <0x00>;
				pinctrl-4 = <0x00>;
				pinctrl-40 = <0x00>;
				pinctrl-41 = <0x00>;
				pinctrl-42 = <0x00>;
				pinctrl-43 = <0x00>;
				pinctrl-44 = <0x00>;
				pinctrl-45 = <0x00>;
				pinctrl-46 = <0x00>;
				pinctrl-47 = <0x00>;
				pinctrl-48 = <0x00>;
				pinctrl-49 = <0x00>;
				pinctrl-5 = <0x00>;
				pinctrl-50 = <0x00>;
				pinctrl-51 = <0x00>;
				pinctrl-52 = <0x00>;
				pinctrl-53 = <0x00>;
				pinctrl-54 = <0x00>;
				pinctrl-55 = <0x00>;
				pinctrl-56 = <0x00>;
				pinctrl-57 = <0x00>;
				pinctrl-6 = <0x00>;
				pinctrl-7 = <0x00>;
				pinctrl-8 = <0x00>;
				pinctrl-9 = <0x00>;
			};
		};
	};

	__symbols__ {
		aw36518_default = "/fragment@22/__overlay__/aw36518_default";
		aw36518_en_0 = "/fragment@22/__overlay__/aw36518_en_0";
		aw36518_en_1 = "/fragment@22/__overlay__/aw36518_en_1";
		aw36518_strobe_0 = "/fragment@22/__overlay__/aw36518_strobe_0";
		aw36518_strobe_1 = "/fragment@22/__overlay__/aw36518_strobe_1";
		cam_mipi_switch_en_0 = "/fragment@58/__overlay__/cam_mipi_switch_en_0";
		cam_mipi_switch_en_1 = "/fragment@58/__overlay__/cam_mipi_switch_en_1";
		cam_mipi_switch_sel_0 = "/fragment@58/__overlay__/cam_mipi_switch_sel_0";
		cam_mipi_switch_sel_1 = "/fragment@58/__overlay__/cam_mipi_switch_sel_1";
		camera0_mclk_2mA = "/fragment@58/__overlay__/camera0_mclk_2mA@gpio99";
		camera0_mclk_4mA = "/fragment@58/__overlay__/camera0_mclk_4mA@gpio99";
		camera0_mclk_6mA = "/fragment@58/__overlay__/camera0_mclk_6mA@gpio99";
		camera0_mclk_8mA = "/fragment@58/__overlay__/camera0_mclk_8mA@gpio99";
		camera0_mclk_off = "/fragment@58/__overlay__/camera0_mclk_gpio_mode@gpio99";
		camera0_pdn_high = "/fragment@58/__overlay__/camera0_pdn_output_high@gpio107";
		camera0_pdn_low = "/fragment@58/__overlay__/camera0_pdn_output_low@gpio107";
		camera0_rst_high = "/fragment@58/__overlay__/camera0_rst_output_high@gpio109";
		camera0_rst_low = "/fragment@58/__overlay__/camera0_rst_output_low@gpio109";
		camera0_vcama_off = "/fragment@58/__overlay__/camera0_vcama_output_low@gpio79";
		camera0_vcama_on = "/fragment@58/__overlay__/camera0_vcama_output_high@gpio79";
		camera0_vcamd_off = "/fragment@58/__overlay__/camera0_vcamd_output_low@gpio80";
		camera0_vcamd_on = "/fragment@58/__overlay__/camera0_vcamd_output_high@gpio80";
		camera1_mclk_2mA = "/fragment@58/__overlay__/camera1_mclk_2mA@gpio100";
		camera1_mclk_4mA = "/fragment@58/__overlay__/camera1_mclk_4mA@gpio100";
		camera1_mclk_6mA = "/fragment@58/__overlay__/camera1_mclk_6mA@gpio100";
		camera1_mclk_8mA = "/fragment@58/__overlay__/camera1_mclk_8mA@gpio100";
		camera1_mclk_off = "/fragment@58/__overlay__/camera1_mclk_gpio_mode@gpio100";
		camera1_pdn_high = "/fragment@58/__overlay__/camera1_pdn_output_high@gpio98";
		camera1_pdn_low = "/fragment@58/__overlay__/camera1_pdn_output_low@gpio98";
		camera1_rst_high = "/fragment@58/__overlay__/camera1_rst_output_high@gpio102";
		camera1_rst_low = "/fragment@58/__overlay__/camera1_rst_output_low@gpio102";
		camera1_vcama_off = "/fragment@58/__overlay__/camera1_vcama_output_low@gpio54";
		camera1_vcama_on = "/fragment@58/__overlay__/camera1_vcama_output_high@gpio54";
		camera1_vcamd_off = "/fragment@58/__overlay__/camera1_vcamd_output_low@gpio31";
		camera1_vcamd_on = "/fragment@58/__overlay__/camera1_vcamd_output_high@gpio31";
		camera2_mclk_2mA = "/fragment@58/__overlay__/camera2_mclk_2mA@gpio108";
		camera2_mclk_4mA = "/fragment@58/__overlay__/camera2_mclk_4mA@gpio108";
		camera2_mclk_6mA = "/fragment@58/__overlay__/camera2_mclk_6mA@gpio108";
		camera2_mclk_8mA = "/fragment@58/__overlay__/camera2_mclk_8mA@gpio108";
		camera2_mclk_off = "/fragment@58/__overlay__/camera2_mclk_gpio_mode@gpio108";
		camera2_pdn_high = "/fragment@58/__overlay__/camera2_pdn_output_high@gpio97";
		camera2_pdn_low = "/fragment@58/__overlay__/camera2_pdn_output_low@gpio97";
		camera2_rst_high = "/fragment@58/__overlay__/camera2_rst_output_high@gpio101";
		camera2_rst_low = "/fragment@58/__overlay__/camera2_rst_output_low@gpio101";
		camera2_vcama_off = "/fragment@58/__overlay__/camera2_vcama_output_low@gpio150";
		camera2_vcama_on = "/fragment@58/__overlay__/camera2_vcama_output_high@gpio150";
		camera2_vcamd_off = "/fragment@58/__overlay__/camera2_vcamd_output_low@gpio160";
		camera2_vcamd_on = "/fragment@58/__overlay__/camera2_vcamd_output_high@gpio160";
		camera3_mclk_2mA = "/fragment@58/__overlay__/camera3_mclk_2mA@gpio99";
		camera3_mclk_4mA = "/fragment@58/__overlay__/camera3_mclk_4mA@gpio99";
		camera3_mclk_6mA = "/fragment@58/__overlay__/camera3_mclk_6mA@gpio99";
		camera3_mclk_8mA = "/fragment@58/__overlay__/camera3_mclk_8mA@gpio99";
		camera3_mclk_off = "/fragment@58/__overlay__/camera3_mclk_gpio_mode@gpio99";
		camera3_pdn_high = "/fragment@58/__overlay__/camera3_pdn_output_high@gpio14";
		camera3_pdn_low = "/fragment@58/__overlay__/camera3_pdn_output_low@gpio14";
		camera3_rst_high = "/fragment@58/__overlay__/camera3_rst_output_high@gpio16";
		camera3_rst_low = "/fragment@58/__overlay__/camera3_rst_output_low@gpio16";
		camera3_vcama_off = "/fragment@58/__overlay__/camera3_vcama_output_low@gpio24";
		camera3_vcama_on = "/fragment@58/__overlay__/camera3_vcama_output_high@gpio24";
		camera3_vcamd_off = "/fragment@58/__overlay__/camera3_vcamd_output_low@gpio21";
		camera3_vcamd_on = "/fragment@58/__overlay__/camera3_vcamd_output_high@gpio21";
		camera4_mclk_2mA = "/fragment@58/__overlay__/camera4_mclk_2mA@gpio111";
		camera4_mclk_4mA = "/fragment@58/__overlay__/camera4_mclk_4mA@gpio111";
		camera4_mclk_6mA = "/fragment@58/__overlay__/camera4_mclk_6mA@gpio111";
		camera4_mclk_8mA = "/fragment@58/__overlay__/camera4_mclk_8mA@gpio111";
		camera4_mclk_off = "/fragment@58/__overlay__/camera4_mclk_gpio_mode@gpio111";
		camera4_pdn_high = "/fragment@58/__overlay__/camera4_pdn_output_high@gpio110";
		camera4_pdn_low = "/fragment@58/__overlay__/camera4_pdn_output_low@gpio110";
		camera4_rst_high = "/fragment@58/__overlay__/camera4_rst_output_high@gpio92";
		camera4_rst_low = "/fragment@58/__overlay__/camera4_rst_output_low@gpio92";
		camera_main_af_mtk = "/fragment@29/__overlay__/camera_main_af@0c";
		camera_main_eeprom_mtk = "/fragment@29/__overlay__/camera_main_eeprom@50";
		camera_main_mtk = "/fragment@29/__overlay__/camera_main@1a";
		camera_main_two_eeprom_mtk = "/fragment@30/__overlay__/camera_main_two_eeprom@50";
		camera_main_two_mtk = "/fragment@27/__overlay__/camera_main_two@10";
		camera_pins_default = "/fragment@58/__overlay__/camdefault";
		camera_sub_eeprom_mtk = "/fragment@31/__overlay__/camera_sub_eeprom@52";
		camera_sub_mtk = "/fragment@31/__overlay__/camera_sub@2d";
		cap_touch_mtk = "/fragment@27/__overlay__/cap_touch@14";
		ccu_sensor_i2c_2_hw_mtk = "/fragment@29/__overlay__/ccu_sensor_i2c_2_hw@11";
		ccu_sensor_i2c_4_hw_mtk = "/fragment@31/__overlay__/ccu_sensor_i2c_4_hw@12";
		consys_pins_default = "/fragment@13/__overlay__/consys_default";
		ctp_pins_default = "/fragment@5/__overlay__/eint0default";
		ctp_pins_eint_as_int = "/fragment@5/__overlay__/eint@0";
		ctp_pins_eint_output0 = "/fragment@5/__overlay__/eintoutput0";
		ctp_pins_eint_output1 = "/fragment@5/__overlay__/eintoutput1";
		ctp_pins_rst_output0 = "/fragment@5/__overlay__/rstoutput0";
		ctp_pins_rst_output1 = "/fragment@5/__overlay__/rstoutput1";
		ctp_ts_int_active = "/fragment@5/__overlay__/int_active";
		ctp_ts_int_suspend = "/fragment@5/__overlay__/int_suspend";
		ctp_ts_pins_default = "/fragment@5/__overlay__/eint1default";
		ctp_ts_reset_active = "/fragment@5/__overlay__/reset_active";
		ctp_ts_reset_suspend = "/fragment@5/__overlay__/reset_suspend";
		fingerprint = "/fragment@9/__overlay__/fingerprint@spi2";
		fmlna_pins_init = "/fragment@13/__overlay__/fmlna@0";
		fmlna_pins_oh = "/fragment@13/__overlay__/fmlna@1";
		fmlna_pins_ol = "/fragment@13/__overlay__/fmlna@2";
		fpc_miso_pull_down = "/fragment@11/__overlay__/fpcmisolow";
		fpc_miso_pull_up = "/fragment@11/__overlay__/fpcmisoup";
		fpc_mode_as_ck = "/fragment@11/__overlay__/fpcck";
		fpc_mode_as_cs = "/fragment@11/__overlay__/fpccs";
		fpc_mode_as_mi = "/fragment@11/__overlay__/fpcmi";
		fpc_mode_as_mo = "/fragment@11/__overlay__/fpcmo";
		fpc_mosi_pull_down = "/fragment@11/__overlay__/fpcmosilow";
		fpc_mosi_pull_up = "/fragment@11/__overlay__/fpcmosiup";
		fpc_pins_default = "/fragment@11/__overlay__/fpcdefault";
		fpc_pins_eint_as_int = "/fragment@11/__overlay__/fpceint@0";
		fpc_pins_pwr_high = "/fragment@11/__overlay__/fpcpwrhigh";
		fpc_pins_pwr_low = "/fragment@11/__overlay__/fpcpwrlow";
		fpc_pins_rst_high = "/fragment@11/__overlay__/fpcrsthigh";
		fpc_pins_rst_low = "/fragment@11/__overlay__/fpcrstlow";
		gpslna_pins_init = "/fragment@13/__overlay__/gpslna@0";
		gpslna_pins_oh = "/fragment@13/__overlay__/gpslna@1";
		gpslna_pins_ol = "/fragment@13/__overlay__/gpslna@2";
		irtx_gpio_led_default = "/fragment@16/__overlay__/irtx_gpio_led_def@gpio12";
		irtx_gpio_led_set = "/fragment@16/__overlay__/irtx_gpio_led_set@gpio12";
		lcd_bias_pins_default = "/fragment@17/__overlay__/default";
		lcd_bias_pins_enn0 = "/fragment@17/__overlay__/lcdbias_enn_low";
		lcd_bias_pins_enn1 = "/fragment@17/__overlay__/lcdbias_enn_high";
		lcd_bias_pins_enp0 = "/fragment@17/__overlay__/lcdbias_enp_low";
		lcd_bias_pins_enp1 = "/fragment@17/__overlay__/lcdbias_enp_high";
		led0 = "/fragment@3/__overlay__/led@0";
		led1 = "/fragment@3/__overlay__/led@1";
		led2 = "/fragment@3/__overlay__/led@2";
		led3 = "/fragment@3/__overlay__/led@3";
		led4 = "/fragment@3/__overlay__/led@4";
		led5 = "/fragment@3/__overlay__/led@5";
		led6 = "/fragment@3/__overlay__/led@6";
		mtkfb_pins_lcm_dsi_te = "/fragment@20/__overlay__/lcm_dsi_te";
		mtkfb_pins_lcm_rst_out0_gpio = "/fragment@20/__overlay__/lcm_rst_out0_gpio";
		mtkfb_pins_lcm_rst_out1_gpio = "/fragment@20/__overlay__/lcm_rst_out1_gpio";
		nfc_mtk = "/fragment@30/__overlay__/nfc@08";
		slave_charger_mtk = "/fragment@34/__overlay__/slave_charger@4b";
		speaker_amp = "/fragment@2/__overlay__/speaker_amp@34";
		speaker_amp_mtk = "/fragment@34/__overlay__/speaker_amp@34";
		subpmic_pmu_mtk = "/fragment@32/__overlay__/subpmic_pmu@34";
		usb_type_c_mtk = "/fragment@33/__overlay__/usb_type_c@4e";
		vibrator0 = "/fragment@3/__overlay__/vibrator@0";
	};

	fragment@0 {
		target = <0xffffffff>;

		__overlay__ {

			reserve-memory-scp_share {
				alignment = <0x00 0x1000000>;
				alloc-ranges = <0x00 0x40000000 0x00 0x50000000>;
				compatible = "mediatek,reserve-memory-scp_share";
				no-map;
				size = <0x00 0xd00000>;
			};
		};
	};

	fragment@1 {
		target = <0xffffffff>;

		__overlay__ {
			atag,videolfb-fb_base_h = <0x00>;
			atag,videolfb-fb_base_l = "~`P";
			atag,videolfb-fps = <0x1770>;
			atag,videolfb-islcm_inited = <0x00>;
			atag,videolfb-islcmfound = <0x01>;
			atag,videolfb-lcmname = "hx83112b_fhdp_dsi_cmd_auo_rt5081_drv";
			atag,videolfb-vramSize = <0x17e8000>;
		};
	};

	fragment@10 {
		target = <0xffffffff>;

		__overlay__ {
			interrupt-parent = <0xffffffff>;
			interrupts = <0x05 0x02 0x05 0x00>;
			pinctrl-0 = <0x07>;
			pinctrl-1 = <0x08>;
			pinctrl-10 = <0x11>;
			pinctrl-11 = <0x12>;
			pinctrl-12 = <0x13>;
			pinctrl-13 = <0x14>;
			pinctrl-2 = <0x09>;
			pinctrl-3 = <0x0a>;
			pinctrl-4 = <0x0b>;
			pinctrl-5 = <0x0c>;
			pinctrl-6 = <0x0d>;
			pinctrl-7 = <0x0e>;
			pinctrl-8 = <0x0f>;
			pinctrl-9 = <0x10>;
			pinctrl-names = "default\0fpc_eint_as_int\0fpc_pins_rst_high\0fpc_pins_rst_low\0fpc_pins_pwr_high\0fpc_pins_pwr_low\0fpc_mode_as_cs\0fpc_mode_as_ck\0fpc_mode_as_mi\0fpc_mode_as_mo\0fpc_miso_pull_up\0fpc_miso_pull_down\0fpc_mosi_pull_up\0fpc_mosi_pull_down";
			status = "okay";
		};
	};

	fragment@11 {
		target = <0xffffffff>;

		__overlay__ {

			fpcck {
				phandle = <0x0e>;

				pins_cmd_dat {
					bias-pull-up = <0x00>;
					pinmux = <0x1b02>;
				};
			};

			fpccs {
				phandle = <0x0d>;

				pins_cmd_dat {
					bias-pull-up = <0x00>;
					pinmux = <0x1902>;
				};
			};

			fpcdefault {
				phandle = <0x07>;
			};

			fpceint@0 {
				phandle = <0x08>;

				pins_cmd_dat {
					bias-disable;
					pinmux = <0x500>;
					slew-rate = <0x00>;
				};
			};

			fpcmi {
				phandle = <0x0f>;

				pins_cmd_dat {
					bias-pull-up = <0x00>;
					pinmux = <0x1c02>;
				};
			};

			fpcmisolow {
				phandle = <0x12>;

				pins_cmd_dat {
					output-low;
					pinmux = <0x1c00>;
					slew-rate = <0x01>;
				};
			};

			fpcmisoup {
				phandle = <0x11>;

				pins_cmd_dat {
					output-high;
					pinmux = <0x1c00>;
					slew-rate = <0x01>;
				};
			};

			fpcmo {
				phandle = <0x10>;

				pins_cmd_dat {
					bias-pull-down = <0x00>;
					pinmux = <0x1a02>;
				};
			};

			fpcmosilow {
				phandle = <0x14>;

				pins_cmd_dat {
					output-low;
					pinmux = <0x1a00>;
					slew-rate = <0x01>;
				};
			};

			fpcmosiup {
				phandle = <0x13>;

				pins_cmd_dat {
					output-high;
					pinmux = <0x1a00>;
					slew-rate = <0x01>;
				};
			};

			fpcpwrhigh {
				phandle = <0x0b>;

				pins_cmd_dat {
					output-high;
					pinmux = <0x3000>;
					slew-rate = <0x01>;
				};
			};

			fpcpwrlow {
				phandle = <0x0c>;

				pins_cmd_dat {
					output-low;
					pinmux = <0x3000>;
					slew-rate = <0x01>;
				};
			};

			fpcrsthigh {
				phandle = <0x09>;

				pins_cmd_dat {
					output-high;
					pinmux = <0xb200>;
					slew-rate = <0x01>;
				};
			};

			fpcrstlow {
				phandle = <0x0a>;

				pins_cmd_dat {
					output-low;
					pinmux = <0xb200>;
					slew-rate = <0x01>;
				};
			};
		};
	};

	fragment@12 {
		target = <0xffffffff>;

		__overlay__ {
			accdet-mic-mode = <0x01>;
			accdet-mic-vol = <0x06>;
			accdet-plugout-debounce = <0x01>;
			headset-eint-level-pol = <0x08>;
			headset-four-key-threshold = <0x00 0x3a 0x79 0xc0 0x190>;
			headset-mode-setting = <0x500 0x500 0x01 0x1f0 0x800 0x800 0x20 0x44>;
			headset-three-key-threshold = <0x00 0x50 0xdc 0x190>;
			headset-three-key-threshold-CDD = <0x00 0x79 0xc0 0x258>;
			status = "okay";
		};
	};

	fragment@13 {
		target = <0xffffffff>;

		__overlay__ {

			consys_default {
				phandle = <0x15>;
			};

			fmlna@0 {
				phandle = <0x19>;

				pins_cmd_dat {
					bias-disable;
					output-low;
					pinmux = <0x1d00>;
					slew-rate = <0x00>;
				};
			};

			fmlna@1 {
				phandle = <0x1a>;

				pins_cmd_dat {
					output-high;
					pinmux = <0x1d00>;
					slew-rate = <0x01>;
				};
			};

			fmlna@2 {
				phandle = <0x1b>;

				pins_cmd_dat {
					output-low;
					pinmux = <0x1d00>;
					slew-rate = <0x01>;
				};
			};

			gpslna@0 {
				phandle = <0x16>;

				pins_cmd_dat {
					bias-disable;
					output-low;
					pinmux = <0x9700>;
					slew-rate = <0x00>;
				};
			};

			gpslna@1 {
				phandle = <0x17>;

				pins_cmd_dat {
					output-high;
					pinmux = <0x9700>;
					slew-rate = <0x01>;
				};
			};

			gpslna@2 {
				phandle = <0x18>;

				pins_cmd_dat {
					output-low;
					pinmux = <0x9700>;
					slew-rate = <0x01>;
				};
			};
		};
	};

	fragment@14 {
		target = <0xffffffff>;

		__overlay__ {
			pinctrl-0 = <0x15>;
			pinctrl-1 = <0x16>;
			pinctrl-2 = <0x17>;
			pinctrl-3 = <0x18>;
			pinctrl-4 = <0x19>;
			pinctrl-5 = <0x1a>;
			pinctrl-6 = <0x1b>;
			pinctrl-names = "default\0gps_lna_state_init\0gps_lna_state_oh\0gps_lna_state_ol\0fm_lna_state_init\0fm_lna_state_oh\0fm_lna_state_ol";
			status = "okay";
		};
	};

	fragment@15 {
		target = <0xffffffff>;

		__overlay__ {
			pinctrl-0 = <0x1c>;
			pinctrl-1 = <0x1d>;
			pinctrl-names = "irtx_gpio_led_default\0irtx_gpio_led_set";
			status = "okay";
		};
	};

	fragment@16 {
		target = <0xffffffff>;

		__overlay__ {

			irtx_gpio_led_def@gpio12 {
				phandle = <0x1c>;

				pins_cmd_dat {
					bias-disable;
					input-schmitt-enable = <0x00>;
					output-low;
					pinmux = <0xc00>;
					slew-rate = <0x01>;
				};
			};

			irtx_gpio_led_set@gpio12 {
				phandle = <0x1d>;

				pins_cmd_dat {
					output-high;
					pinmux = <0xc01>;
					slew-rate = <0x01>;
				};
			};
		};
	};

	fragment@17 {
		target = <0xffffffff>;

		__overlay__ {

			default {
				phandle = <0x1e>;
			};

			lcdbias_enn_high {
				phandle = <0x21>;

				pins_cmd_dat {
					output-high;
					pinmux = <0xa500>;
					slew-rate = <0x01>;
				};
			};

			lcdbias_enn_low {
				phandle = <0x22>;

				pins_cmd_dat {
					output-low;
					pinmux = <0xa500>;
					slew-rate = <0x01>;
				};
			};

			lcdbias_enp_high {
				phandle = <0x1f>;

				pins_cmd_dat {
					output-high;
					pinmux = <0xa900>;
					slew-rate = <0x01>;
				};
			};

			lcdbias_enp_low {
				phandle = <0x20>;

				pins_cmd_dat {
					output-low;
					pinmux = <0xa900>;
					slew-rate = <0x01>;
				};
			};
		};
	};

	fragment@18 {
		target = <0xffffffff>;

		__overlay__ {
			pinctrl-0 = <0x1e>;
			pinctrl-1 = <0x1f>;
			pinctrl-2 = <0x20>;
			pinctrl-3 = <0x21>;
			pinctrl-4 = <0x22>;
			pinctrl-names = "default\0lcdbias_enp_high\0lcdbias_enp_low\0lcdbias_enn_high\0lcdbias_enn_low";
		};
	};

	fragment@19 {
		target = <0xffffffff>;

		__overlay__ {

			dcam@40 {
				compatible = "prize,dcam_r";
				pdn_pin = <0xffffffff 0x6e 0x00>;
				reg = <0x3c>;
				rst_pin = <0xffffffff 0x5c 0x00>;
				sensor_type = <0x17f5>;
			};
		};
	};

	fragment@2 {
		target = <0xffffffff>;

		__overlay__ {

			speaker_amp@34 {
				compatible = "mediatek,speaker_amp";
				irq-gpio = <0xffffffff 0x27 0x00>;
				phandle = <0x65>;
				reg = <0x34>;
				reset-gpio = <0xffffffff 0x1e 0x00>;
				status = "okay";
			};
		};
	};

	fragment@20 {
		target = <0xffffffff>;

		__overlay__ {

			lcm_dsi_te {
				phandle = <0x25>;

				pins_cmd_dat {
					pinmux = <0x2c01>;
				};
			};

			lcm_rst_out0_gpio {
				phandle = <0x24>;

				pins_cmd_dat {
					output-low;
					pinmux = <0x2d00>;
					slew-rate = <0x01>;
				};
			};

			lcm_rst_out1_gpio {
				phandle = <0x23>;

				pins_cmd_dat {
					output-high;
					pinmux = <0x2d00>;
					slew-rate = <0x01>;
				};
			};
		};
	};

	fragment@21 {
		target = <0xffffffff>;

		__overlay__ {
			pinctrl-0 = <0x23>;
			pinctrl-1 = <0x24>;
			pinctrl-2 = <0x25>;
			pinctrl-names = "lcm_rst_out1_gpio\0lcm_rst_out0_gpio\0mode_te_te";
			status = "okay";
		};
	};

	fragment@22 {
		target = <0xffffffff>;

		__overlay__ {

			aw36518_default {
				phandle = <0x26>;
			};

			aw36518_en_0 {
				phandle = <0x29>;

				pins_cmd_dat {
					output-low;
					pinmux = <0x9800>;
					slew-rate = <0x01>;
				};
			};

			aw36518_en_1 {
				phandle = <0x2a>;

				pins_cmd_dat {
					output-high;
					pinmux = <0x9800>;
					slew-rate = <0x01>;
				};
			};

			aw36518_strobe_0 {
				phandle = <0x27>;

				pins_cmd_dat {
					output-low;
					pinmux = <0x9900>;
					slew-rate = <0x01>;
				};
			};

			aw36518_strobe_1 {
				phandle = <0x28>;

				pins_cmd_dat {
					output-high;
					pinmux = <0x9900>;
					slew-rate = <0x01>;
				};
			};
		};
	};

	fragment@23 {
		target = <0xffffffff>;

		__overlay__ {

			aw36518@63 {
				compatible = "mediatek,flashlights_aw36518";
				pinctrl-0 = <0x26>;
				pinctrl-1 = <0x27>;
				pinctrl-2 = <0x28>;
				pinctrl-3 = <0x29>;
				pinctrl-4 = <0x2a>;
				pinctrl-names = "aw36518_default\0aw36518_strobe_0\0aw36518_strobe_1\0aw36518_en_0\0aw36518_en_1";
				reg = <0x63>;
				status = "okay";
			};
		};
	};

	fragment@24 {
		target = <0xffffffff>;

		__overlay__ {

			adc_channel@ {
				compatible = "mediatek,adc_channel";
				mediatek,adc_fdd_rf_params_dynamic_custom_ch = <0x02>;
				mediatek,temperature0 = <0x00>;
				mediatek,temperature1 = <0x01>;
				status = "okay";
			};
		};
	};

	fragment@25 {
		target = <0xffffffff>;

		__overlay__ {
			io-channels = <0xffffffff 0x02>;
		};
	};

	fragment@26 {
		target = <0xffffffff>;

		__overlay__ {
			mediatek,clkbuf-config = <0x02 0x01 0x01 0x02 0x00 0x00 0x00>;
			mediatek,clkbuf-driving-current = <0x01 0x01 0x01 0x01 0x01 0x01 0x01>;
			mediatek,clkbuf-quantity = <0x07>;
			status = "okay";
		};
	};

	fragment@27 {
		target = <0xffffffff>;

		__overlay__ {
			#address-cells = <0x01>;
			#size-cells = <0x00>;
			clock-frequency = <0x61a80>;
			mediatek,use-open-drain;

			camera_main_two@10 {
				compatible = "mediatek,camera_main_two";
				phandle = <0x75>;
				reg = <0x10>;
				status = "okay";
			};

			cap_touch@14 {
				compatible = "mediatek,cap_touch";
				phandle = <0x74>;
				reg = <0x14>;
				status = "okay";
			};
		};
	};

	fragment@28 {
		target = <0xffffffff>;

		__overlay__ {
			#address-cells = <0x01>;
			#size-cells = <0x00>;
			clock-frequency = <0x61a80>;
			mediatek,use-open-drain;
		};
	};

	fragment@29 {
		target = <0xffffffff>;

		__overlay__ {
			#address-cells = <0x01>;
			#size-cells = <0x00>;
			clock-frequency = <0x61a80>;
			mediatek,use-open-drain;

			camera_main@1a {
				compatible = "mediatek,camera_main";
				phandle = <0x76>;
				reg = <0x1a>;
				status = "okay";
			};

			camera_main_af@0c {
				compatible = "mediatek,camera_main_af";
				phandle = <0x78>;
				reg = <0x0c>;
				status = "okay";
			};

			camera_main_eeprom@50 {
				compatible = "mediatek,camera_main_eeprom";
				phandle = <0x77>;
				reg = <0x50>;
				status = "okay";
			};

			ccu_sensor_i2c_2_hw@11 {
				compatible = "mediatek,ccu_sensor_i2c_2_hw";
				phandle = <0x79>;
				reg = <0x11>;
				status = "okay";
			};
		};
	};

	fragment@3 {
		target = <0xffffffff>;

		__overlay__ {

			led@0 {
				compatible = "mediatek,red";
				data = <0x01>;
				led_mode = <0x00>;
				phandle = <0x66>;
				pwm_config = <0x00 0x00 0x00 0x00 0x00>;
			};

			led@1 {
				compatible = "mediatek,green";
				data = <0x01>;
				led_mode = <0x00>;
				phandle = <0x67>;
				pwm_config = <0x00 0x00 0x00 0x00 0x00>;
			};

			led@2 {
				compatible = "mediatek,blue";
				data = <0x01>;
				led_mode = <0x00>;
				phandle = <0x68>;
				pwm_config = <0x00 0x00 0x00 0x00 0x00>;
			};

			led@3 {
				compatible = "mediatek,jogball-backlight";
				data = <0x01>;
				led_mode = <0x00>;
				phandle = <0x69>;
				pwm_config = <0x00 0x00 0x00 0x00 0x00>;
			};

			led@4 {
				compatible = "mediatek,keyboard-backlight";
				data = <0x01>;
				led_mode = <0x00>;
				phandle = <0x6a>;
				pwm_config = <0x00 0x00 0x00 0x00 0x00>;
			};

			led@5 {
				compatible = "mediatek,button-backlight";
				data = <0x01>;
				led_mode = <0x00>;
				phandle = <0x6b>;
				pwm_config = <0x00 0x00 0x00 0x00 0x00>;
			};

			led@6 {
				compatible = "mediatek,lcd-backlight";
				data = <0x01>;
				led_mode = <0x05>;
				phandle = <0x6c>;
				pwm_config = <0x00 0x03 0x00 0x00 0x00>;
			};

			vibrator@0 {
				compatible = "mediatek,vibrator";
				phandle = <0x6d>;
				vib_limit = <0x09>;
				vib_timer = <0x19>;
				vib_vol = <0x0d>;
			};
		};
	};

	fragment@30 {
		target = <0xffffffff>;

		__overlay__ {
			#address-cells = <0x01>;
			#size-cells = <0x00>;
			clock-frequency = <0x61a80>;
			mediatek,use-open-drain;

			camera_main_two_eeprom@50 {
				compatible = "mediatek,camera_main_two_eeprom";
				phandle = <0x7b>;
				reg = <0x50>;
				status = "okay";
			};

			nfc@08 {
				compatible = "mediatek,nfc";
				phandle = <0x7a>;
				reg = <0x08>;
				status = "okay";
			};
		};
	};

	fragment@31 {
		target = <0xffffffff>;

		__overlay__ {
			#address-cells = <0x01>;
			#size-cells = <0x00>;
			clock-frequency = <0x61a80>;
			mediatek,use-open-drain;

			camera_sub@2d {
				compatible = "mediatek,camera_sub";
				phandle = <0x7c>;
				reg = <0x2d>;
				status = "okay";
			};

			camera_sub_eeprom@52 {
				compatible = "mediatek,camera_sub_eeprom";
				phandle = <0x7d>;
				reg = <0x52>;
				status = "okay";
			};

			ccu_sensor_i2c_4_hw@12 {
				compatible = "mediatek,ccu_sensor_i2c_4_hw";
				phandle = <0x7e>;
				reg = <0x12>;
				status = "okay";
			};
		};
	};

	fragment@32 {
		target = <0xffffffff>;

		__overlay__ {
			#address-cells = <0x01>;
			#size-cells = <0x00>;
			clock-frequency = <0x33e140>;
			mediatek,use-push-pull;

			subpmic_pmu@34 {
				compatible = "mediatek,subpmic_pmu";
				phandle = <0x7f>;
				reg = <0x34>;
				status = "okay";
			};
		};
	};

	fragment@33 {
		target = <0xffffffff>;

		__overlay__ {
			#address-cells = <0x01>;
			#size-cells = <0x00>;
			clock-frequency = <0x61a80>;
			mediatek,use-open-drain;

			usb_type_c@4e {
				compatible = "mediatek,usb_type_c";
				phandle = <0x80>;
				reg = <0x4e>;
				status = "okay";
			};
		};
	};

	fragment@34 {
		target = <0xffffffff>;

		__overlay__ {
			#address-cells = <0x01>;
			#size-cells = <0x00>;
			clock-frequency = <0x61a80>;
			mediatek,use-open-drain;

			slave_charger@4b {
				compatible = "mediatek,slave_charger";
				phandle = <0x82>;
				reg = <0x4b>;
				status = "okay";
			};

			speaker_amp@34 {
				compatible = "mediatek,speaker_amp";
				phandle = <0x81>;
				reg = <0x34>;
				status = "okay";
			};
		};
	};

	fragment@35 {
		target = <0xffffffff>;

		__overlay__ {
			#address-cells = <0x01>;
			#size-cells = <0x00>;
			clock-frequency = <0x61a80>;
			mediatek,use-open-drain;
		};
	};

	fragment@36 {
		target = <0xffffffff>;

		__overlay__ {
			GPIO_SIM1_HOT_PLUG = <0xffffffff 0x2f 0x00>;
			GPIO_SIM1_SCLK = <0xffffffff 0xac 0x00>;
			GPIO_SIM1_SIO = <0xffffffff 0xae 0x00>;
			GPIO_SIM1_SRST = <0xffffffff 0xad 0x00>;
			GPIO_SIM2_HOT_PLUG = <0xffffffff 0x2e 0x00>;
			GPIO_SIM2_SCLK = <0xffffffff 0x9d 0x00>;
			GPIO_SIM2_SIO = <0xffffffff 0x9b 0x00>;
			GPIO_SIM2_SRST = <0xffffffff 0x9c 0x00>;
		};
	};

	fragment@37 {
		target = <0xffffffff>;

		__overlay__ {
			gpio_init_default = <0x00 0x00 0x00 0x00 0x00 0x00 0x01 0x01 0x00 0x00 0x00 0x01 0x01 0x01 0x02 0x00 0x00 0x00 0x00 0x00 0x01 0x03 0x00 0x00 0x00 0x01 0x00 0x01 0x04 0x00 0x00 0x00 0x00 0x00 0x00 0x05 0x00 0x00 0x00 0x01 0x00 0x00 0x06 0x00 0x00 0x00 0x01 0x01 0x00 0x07 0x00 0x00 0x00 0x01 0x00 0x00 0x08 0x00 0x01 0x00 0x00 0x00 0x00 0x09 0x00 0x00 0x00 0x01 0x00 0x00 0x0a 0x00 0x00 0x00 0x01 0x01 0x00 0x0b 0x01 0x00 0x00 0x01 0x00 0x00 0x0c 0x00 0x00 0x00 0x01 0x00 0x00 0x0d 0x00 0x01 0x00 0x01 0x01 0x00 0x0e 0x00 0x01 0x00 0x01 0x01 0x00 0x0f 0x00 0x01 0x00 0x01 0x01 0x00 0x10 0x00 0x01 0x00 0x01 0x01 0x00 0x11 0x00 0x01 0x00 0x00 0x00 0x01 0x12 0x00 0x00 0x00 0x01 0x01 0x01 0x13 0x00 0x00 0x00 0x01 0x01 0x01 0x14 0x00 0x00 0x00 0x01 0x01 0x01 0x15 0x00 0x01 0x00 0x01 0x01 0x00 0x16 0x00 0x00 0x00 0x01 0x01 0x00 0x17 0x00 0x01 0x00 0x00 0x00 0x00 0x18 0x00 0x01 0x00 0x00 0x00 0x00 0x19 0x02 0x01 0x00 0x01 0x00 0x00 0x1a 0x02 0x01 0x00 0x00 0x00 0x00 0x1b 0x02 0x01 0x00 0x01 0x00 0x00 0x1c 0x02 0x00 0x00 0x01 0x00 0x00 0x1d 0x00 0x01 0x00 0x00 0x00 0x00 0x1e 0x00 0x01 0x00 0x00 0x00 0x00 0x1f 0x00 0x01 0x00 0x00 0x00 0x00 0x20 0x01 0x00 0x00 0x01 0x00 0x00 0x21 0x01 0x00 0x00 0x01 0x00 0x00 0x22 0x01 0x01 0x00 0x01 0x00 0x00 0x23 0x01 0x01 0x00 0x00 0x00 0x00 0x24 0x01 0x01 0x00 0x00 0x00 0x00 0x25 0x01 0x01 0x00 0x00 0x00 0x00 0x26 0x01 0x01 0x00 0x00 0x00 0x00 0x27 0x00 0x00 0x00 0x01 0x01 0x01 0x28 0x01 0x00 0x00 0x01 0x00 0x00 0x29 0x00 0x00 0x00 0x00 0x00 0x01 0x2a 0x00 0x00 0x00 0x01 0x00 0x01 0x2b 0x01 0x01 0x00 0x00 0x00 0x00 0x2c 0x01 0x00 0x00 0x01 0x00 0x00 0x2d 0x00 0x01 0x00 0x00 0x00 0x00 0x2e 0x01 0x00 0x00 0x00 0x00 0x00 0x2f 0x01 0x00 0x00 0x01 0x01 0x00 0x30 0x01 0x00 0x00 0x01 0x01 0x01 0x31 0x01 0x00 0x00 0x01 0x01 0x01 0x32 0x01 0x00 0x00 0x01 0x01 0x01 0x33 0x01 0x00 0x00 0x01 0x01 0x01 0x34 0x01 0x00 0x00 0x01 0x00 0x00 0x35 0x01 0x00 0x00 0x01 0x00 0x00 0x36 0x00 0x01 0x00 0x00 0x00 0x00 0x37 0x01 0x00 0x00 0x01 0x00 0x00 0x38 0x01 0x00 0x00 0x01 0x00 0x00 0x39 0x00 0x01 0x00 0x00 0x00 0x00 0x3a 0x00 0x00 0x00 0x01 0x00 0x00 0x3b 0x01 0x00 0x00 0x01 0x00 0x00 0x3c 0x01 0x00 0x00 0x01 0x00 0x00 0x3d 0x01 0x00 0x00 0x01 0x00 0x00 0x3e 0x01 0x00 0x00 0x01 0x00 0x00 0x3f 0x01 0x00 0x00 0x01 0x00 0x00 0x40 0x01 0x00 0x00 0x01 0x00 0x00 0x41 0x01 0x00 0x00 0x01 0x00 0x00 0x42 0x01 0x00 0x00 0x01 0x00 0x00 0x43 0x01 0x00 0x00 0x01 0x00 0x00 0x44 0x01 0x00 0x00 0x01 0x00 0x00 0x45 0x01 0x00 0x00 0x01 0x00 0x00 0x46 0x01 0x00 0x00 0x01 0x00 0x00 0x47 0x01 0x00 0x00 0x01 0x00 0x00 0x48 0x01 0x00 0x00 0x01 0x00 0x00 0x49 0x01 0x00 0x00 0x01 0x00 0x00 0x4a 0x01 0x00 0x00 0x01 0x00 0x00 0x4b 0x01 0x00 0x00 0x01 0x00 0x00 0x4c 0x01 0x00 0x00 0x01 0x00 0x00 0x4d 0x01 0x00 0x00 0x01 0x00 0x00 0x4e 0x00 0x01 0x00 0x00 0x00 0x00 0x4f 0x00 0x01 0x00 0x00 0x00 0x00 0x50 0x00 0x01 0x00 0x00 0x00 0x00 0x51 0x02 0x00 0x00 0x01 0x01 0x01 0x52 0x01 0x00 0x00 0x01 0x01 0x01 0x53 0x01 0x00 0x00 0x01 0x01 0x01 0x54 0x02 0x00 0x00 0x01 0x01 0x01 0x55 0x02 0x00 0x00 0x01 0x00 0x00 0x56 0x02 0x01 0x00 0x00 0x00 0x00 0x57 0x02 0x01 0x00 0x00 0x00 0x00 0x58 0x02 0x01 0x00 0x00 0x00 0x00 0x59 0x01 0x00 0x00 0x01 0x01 0x01 0x5a 0x01 0x00 0x00 0x01 0x01 0x01 0x5b 0x00 0x01 0x00 0x00 0x00 0x00 0x5c 0x00 0x01 0x00 0x00 0x00 0x00 0x5d 0x01 0x00 0x00 0x01 0x01 0x00 0x5e 0x01 0x00 0x00 0x01 0x01 0x00 0x5f 0x01 0x00 0x00 0x01 0x01 0x00 0x60 0x01 0x01 0x00 0x00 0x00 0x00 0x61 0x00 0x01 0x00 0x00 0x00 0x00 0x62 0x00 0x01 0x00 0x00 0x00 0x00 0x63 0x01 0x01 0x00 0x00 0x00 0x00 0x64 0x01 0x01 0x00 0x00 0x00 0x00 0x65 0x00 0x01 0x00 0x00 0x00 0x00 0x66 0x00 0x01 0x00 0x00 0x00 0x00 0x67 0x01 0x00 0x00 0x01 0x01 0x01 0x68 0x01 0x00 0x00 0x01 0x01 0x01 0x69 0x01 0x00 0x00 0x01 0x01 0x01 0x6a 0x01 0x00 0x00 0x01 0x01 0x01 0x6b 0x00 0x01 0x00 0x00 0x00 0x00 0x6c 0x01 0x01 0x00 0x00 0x00 0x00 0x6d 0x00 0x01 0x00 0x00 0x00 0x00 0x6e 0x00 0x01 0x00 0x00 0x00 0x00 0x6f 0x01 0x01 0x00 0x00 0x00 0x00 0x70 0x00 0x00 0x00 0x00 0x00 0x00 0x71 0x00 0x00 0x00 0x01 0x00 0x00 0x72 0x00 0x00 0x00 0x01 0x00 0x00 0x73 0x00 0x00 0x00 0x01 0x00 0x00 0x74 0x00 0x00 0x00 0x01 0x00 0x00 0x75 0x00 0x00 0x00 0x01 0x00 0x00 0x76 0x00 0x00 0x00 0x01 0x00 0x00 0x77 0x00 0x00 0x00 0x01 0x00 0x00 0x78 0x00 0x00 0x00 0x01 0x00 0x00 0x79 0x00 0x00 0x00 0x01 0x00 0x00 0x86 0x01 0x00 0x00 0x01 0x00 0x01 0x87 0x01 0x01 0x00 0x00 0x00 0x00 0x88 0x01 0x01 0x00 0x00 0x00 0x00 0x89 0x01 0x01 0x00 0x00 0x00 0x00 0x8a 0x01 0x01 0x00 0x00 0x00 0x00 0x8b 0x01 0x01 0x00 0x00 0x00 0x00 0x8c 0x01 0x00 0x00 0x01 0x00 0x00 0x8d 0x01 0x00 0x00 0x01 0x00 0x00 0x8e 0x01 0x00 0x00 0x01 0x00 0x00 0x8f 0x01 0x00 0x00 0x01 0x00 0x00 0x90 0x01 0x00 0x00 0x01 0x00 0x00 0x91 0x01 0x01 0x00 0x00 0x00 0x00 0x92 0x01 0x01 0x00 0x00 0x00 0x00 0x93 0x01 0x01 0x00 0x00 0x00 0x00 0x94 0x01 0x01 0x00 0x00 0x00 0x00 0x95 0x01 0x01 0x00 0x00 0x00 0x00 0x96 0x00 0x01 0x00 0x00 0x00 0x00 0x97 0x00 0x01 0x00 0x00 0x00 0x00 0x98 0x00 0x01 0x00 0x00 0x00 0x00 0x99 0x00 0x01 0x00 0x00 0x00 0x00 0x9a 0x01 0x01 0x00 0x00 0x00 0x00 0x9b 0x01 0x00 0x00 0x01 0x01 0x00 0x9c 0x01 0x01 0x00 0x00 0x00 0x00 0x9d 0x01 0x01 0x00 0x00 0x00 0x00 0x9e 0x00 0x01 0x00 0x00 0x00 0x00 0x9f 0x00 0x01 0x00 0x00 0x00 0x00 0xa0 0x00 0x01 0x00 0x00 0x00 0x00 0xa1 0x01 0x00 0x00 0x01 0x01 0x01 0xa2 0x01 0x00 0x00 0x01 0x01 0x01 0xa3 0x01 0x00 0x00 0x01 0x01 0x01 0xa4 0x01 0x00 0x00 0x01 0x01 0x01 0xa5 0x00 0x01 0x00 0x00 0x00 0x00 0xa6 0x00 0x01 0x00 0x00 0x00 0x00 0xa7 0x01 0x00 0x00 0x01 0x00 0x00 0xa8 0x01 0x00 0x00 0x01 0x00 0x00 0xa9 0x00 0x01 0x00 0x00 0x00 0x00 0xaa 0x01 0x00 0x00 0x01 0x01 0x01 0xab 0x01 0x01 0x00 0x00 0x00 0x01 0xac 0x01 0x01 0x00 0x00 0x00 0x00 0xad 0x01 0x01 0x00 0x00 0x00 0x00 0xae 0x01 0x00 0x00 0x01 0x01 0x00 0xaf 0x01 0x00 0x00 0x01 0x01 0x01 0xb0 0x01 0x00 0x00 0x01 0x01 0x01 0xb2 0x00 0x01 0x00 0x00 0x00 0x00 0xb3 0x00 0x01 0x00 0x00 0x00 0x00 0xb4 0x00 0x00 0x00 0x01 0x00 0x00 0xb5 0x00 0x00 0x00 0x01 0x00 0x00 0xb6 0x00 0x00 0x00 0x01 0x00 0x00 0xb7 0x00 0x00 0x00 0x01 0x00 0x00 0xb8 0x00 0x00 0x00 0x01 0x00 0x00 0xb9 0x00 0x00 0x00 0x01 0x00 0x00 0xba 0x00 0x00 0x00 0x01 0x00 0x00>;
		};
	};

	fragment@38 {
		target = <0xffffffff>;

		__overlay__ {
			interrupt-parent = <0xffffffff>;
			interrupts = <0x01 0x02 0x01 0x00>;
			status = "okay";
		};
	};

	fragment@39 {
		target = <0xffffffff>;

		__overlay__ {
			interrupt-parent = <0xffffffff>;
			interrupts = <0x09 0x01 0x09 0x00>;
			status = "okay";
		};
	};

	fragment@4 {
		target = <0xffffffff>;

		__overlay__ {
			pinctrl-0 = <0x01>;
			pinctrl-1 = <0x02>;
			pinctrl-2 = <0x03>;
			pinctrl-3 = <0x04>;
			pinctrl-4 = <0x05>;
			pinctrl-5 = <0x06>;
			pinctrl-names = "default\0state_eint_as_int\0state_eint_output0\0state_eint_output1\0state_rst_output0\0state_rst_output1";
			status = "okay";
			tpd-filter-custom-prameters = <0x00 0x00 0x00 0x00 0x00 0x00 0x00 0x00 0x00 0x00 0x00 0x00>;
			tpd-filter-custom-speed = <0x00 0x00 0x00>;
			tpd-filter-enable = <0x01>;
			tpd-filter-pixel-density = <0xa8>;
			tpd-key-dim-local = <0x5a 0x373 0x64 0x28 0xe6 0x373 0x64 0x28 0x172 0x373 0x64 0x28 0x00 0x00 0x00 0x00>;
			tpd-key-local = <0x8b 0xac 0x9e 0x00>;
			tpd-key-num = <0x03>;
			tpd-max-touch-num = <0x0a>;
			tpd-resolution = <0x438 0x960>;
			use-tpd-button = <0x00>;
		};
	};

	fragment@40 {
		target = <0xffffffff>;

		__overlay__ {
			interrupt-parent = <0xffffffff>;
			interrupts = <0x14 0x02 0x14 0x00>;
			status = "okay";
		};
	};

	fragment@41 {
		target = <0xffffffff>;

		__overlay__ {
			interrupt-parent = <0xffffffff>;
			interrupts = <0x27 0x08 0x27 0x00>;
			status = "okay";
		};
	};

	fragment@42 {
		target = <0xffffffff>;

		__overlay__ {
			interrupt-parent = <0xffffffff>;
			interrupts = <0x29 0x02 0x29 0x00>;
			status = "okay";
		};
	};

	fragment@43 {
		target = <0xffffffff>;

		__overlay__ {
			interrupt-parent = <0xffffffff>;
			interrupts = <0x2a 0x02 0x2a 0x00>;
			status = "okay";
		};
	};

	fragment@44 {
		target = <0xffffffff>;

		__overlay__ {
			interrupt-parent = <0xffffffff>;
			interrupts = <0x2c 0x01 0x2c 0x01>;
			status = "okay";
		};
	};

	fragment@45 {
		target = <0xffffffff>;

		__overlay__ {
			interrupt-parent = <0xffffffff>;
			interrupts = <0x90 0x04 0xb4 0x00>;
			status = "okay";
		};
	};

	fragment@46 {
		target = <0xffffffff>;

		__overlay__ {
			compatible = "mediatek,md1_sim1_hot_plug_eint-eint";
			debounce = <0x00 0x2710>;
			dedicated = <0x00 0x00>;
			interrupts = <0x00 0x08>;
			sockettype = <0x00 0x00>;
			src_pin = <0x00 0x01>;
			status = "okay";
		};
	};

	fragment@47 {
		target = <0xffffffff>;

		__overlay__ {
			compatible = "mediatek,md1_sim2_hot_plug_eint-eint";
			debounce = <0x01 0x2710>;
			dedicated = <0x01 0x00>;
			interrupts = <0x01 0x08>;
			sockettype = <0x01 0x00>;
			src_pin = <0x01 0x02>;
			status = "okay";
		};
	};

	fragment@48 {
		target = <0xffffffff>;

		__overlay__ {
			regulator-default-on = <0x01>;
			regulator-name = "vcama1";
			status = "okay";
		};
	};

	fragment@49 {
		target = <0xffffffff>;

		__overlay__ {
			regulator-default-on = <0x01>;
			regulator-name = "vcama2";
			status = "okay";
		};
	};

	fragment@5 {
		target = <0xffffffff>;

		__overlay__ {

			eint0default {
				phandle = <0x01>;
			};

			eint1default {
				phandle = <0x6e>;
			};

			eint@0 {
				phandle = <0x02>;

				pins_cmd_dat {
					bias-disable;
					pinmux = <0x100>;
					slew-rate = <0x00>;
				};
			};

			eintoutput0 {
				phandle = <0x03>;

				pins_cmd_dat {
					output-low;
					pinmux = <0x100>;
					slew-rate = <0x01>;
				};
			};

			eintoutput1 {
				phandle = <0x04>;

				pins_cmd_dat {
					output-high;
					pinmux = <0x100>;
					slew-rate = <0x01>;
				};
			};

			int_active {
				phandle = <0x6f>;

				pins_cmd_dat {
					bias-pull-up = <0x0b>;
					pinmux = <0x100>;
					slew-rate = <0x00>;
				};
			};

			int_suspend {
				phandle = <0x71>;

				pins_cmd_dat {
					output-low;
					pinmux = <0x100>;
					slew-rate = <0x01>;
				};
			};

			reset_active {
				phandle = <0x70>;

				pins_cmd_dat {
					output-high;
					pinmux = <0x1700>;
					slew-rate = <0x01>;
				};
			};

			reset_suspend {
				phandle = <0x72>;

				pins_cmd_dat {
					output-low;
					pinmux = <0x1700>;
					slew-rate = <0x01>;
				};
			};

			rstoutput0 {
				phandle = <0x05>;

				pins_cmd_dat {
					output-low;
					pinmux = <0x1700>;
					slew-rate = <0x01>;
				};
			};

			rstoutput1 {
				phandle = <0x06>;

				pins_cmd_dat {
					output-high;
					pinmux = <0x1700>;
					slew-rate = <0x01>;
				};
			};
		};
	};

	fragment@50 {
		target = <0xffffffff>;

		__overlay__ {
			regulator-default-on = <0x01>;
			regulator-name = "vsim1";
			status = "okay";
		};
	};

	fragment@51 {
		target = <0xffffffff>;

		__overlay__ {
			regulator-default-on = <0x01>;
			regulator-name = "vsim2";
			status = "okay";
		};
	};

	fragment@52 {
		target = <0xffffffff>;

		__overlay__ {
			regulator-default-on = <0x01>;
			regulator-name = "vcamd";
			status = "okay";
		};
	};

	fragment@53 {
		target = <0xffffffff>;

		__overlay__ {
			regulator-default-on = <0x01>;
			regulator-name = "vcamio";
			status = "okay";
		};
	};

	fragment@54 {
		target = <0xffffffff>;

		__overlay__ {
			regulator-default-on = <0x01>;
			regulator-name = "vldo28";
			status = "okay";
		};
	};

	fragment@55 {
		target = <0xffffffff>;

		__overlay__ {
			status = "okay";
			vcama-supply = <0xffffffff>;
			vcama_sub-supply = <0xffffffff>;
			vcamaf-supply = <0xffffffff>;
			vcamaf_main2-supply = <0xffffffff>;
			vcamaf_sub-supply = <0xffffffff>;
			vcamd_main2-supply = <0xffffffff>;
			vcamio-supply = <0xffffffff>;
			vcamio_main2-supply = <0xffffffff>;
			vcamio_sub-supply = <0xffffffff>;
		};
	};

	fragment@56 {
		target = <0xffffffff>;

		__overlay__ {
			status = "okay";
			vtouch-supply = <0xffffffff>;
		};
	};

	fragment@57 {
		target = <0xffffffff>;

		__overlay__ {
			mediatek,kpd-hw-dl-key0 = <0x11>;
			mediatek,kpd-hw-dl-key1 = <0x00>;
			mediatek,kpd-hw-dl-key2 = <0x08>;
			mediatek,kpd-hw-factory-key = <0x00>;
			mediatek,kpd-hw-init-map = <0x72 0x66 0x00 0x00 0x00 0x00 0x00 0x00 0x00 0x00 0x00 0x00 0x00 0x00 0x00 0x00 0x00 0x00 0x00 0x00 0x00 0x00 0x00 0x00 0x00 0x00 0x00 0x00 0x00 0x00 0x00 0x00 0x00 0x00 0x00 0x00 0x00 0x00 0x00 0x00 0x00 0x00 0x00 0x00 0x00 0x00 0x00 0x00 0x00 0x00 0x00 0x00 0x00 0x00 0x00 0x00 0x00 0x00 0x00 0x00 0x00 0x00 0x00 0x00 0x00 0x00 0x00 0x00 0x00 0x00 0x00 0x00>;
			mediatek,kpd-hw-map-num = <0x48>;
			mediatek,kpd-hw-pwrkey = <0x08>;
			mediatek,kpd-hw-recovery-key = <0x11>;
			mediatek,kpd-hw-rstkey = <0x11>;
			mediatek,kpd-key-debounce = <0x400>;
			mediatek,kpd-pwkey-gpio-din = <0x00>;
			mediatek,kpd-pwrkey-eint-gpio = <0x00>;
			mediatek,kpd-sw-pwrkey = <0x74>;
			mediatek,kpd-sw-rstkey = <0x73>;
			mediatek,kpd-use-extend-type = <0x00>;
			status = "okay";
		};
	};

	fragment@58 {
		target = <0xffffffff>;

		__overlay__ {

			cam_mipi_switch_en_0 {
				phandle = <0x61>;

				pins_cmd_dat {
					output-low;
					pinmux = <0xd00>;
					slew-rate = <0x01>;
				};
			};

			cam_mipi_switch_en_1 {
				phandle = <0x62>;

				pins_cmd_dat {
					output-high;
					pinmux = <0xd00>;
					slew-rate = <0x01>;
				};
			};

			cam_mipi_switch_sel_0 {
				phandle = <0x63>;

				pins_cmd_dat {
					output-low;
					pinmux = <0xf00>;
					slew-rate = <0x01>;
				};
			};

			cam_mipi_switch_sel_1 {
				phandle = <0x64>;

				pins_cmd_dat {
					output-high;
					pinmux = <0xf00>;
					slew-rate = <0x01>;
				};
			};

			camdefault {
				phandle = <0x2b>;
			};

			camera0_mclk_2mA@gpio99 {
				phandle = <0x41>;

				pins_cmd_dat {
					drive-strength = <0x02>;
					pinmux = <0x6301>;
				};
			};

			camera0_mclk_4mA@gpio99 {
				phandle = <0x42>;

				pins_cmd_dat {
					drive-strength = <0x04>;
					pinmux = <0x6301>;
				};
			};

			camera0_mclk_6mA@gpio99 {
				phandle = <0x43>;

				pins_cmd_dat {
					drive-strength = <0x06>;
					pinmux = <0x6301>;
				};
			};

			camera0_mclk_8mA@gpio99 {
				phandle = <0x44>;

				pins_cmd_dat {
					drive-strength = <0x07>;
					pinmux = <0x6301>;
				};
			};

			camera0_mclk_gpio_mode@gpio99 {
				phandle = <0x40>;

				pins_cmd_dat {
					drive-strength = <0x04>;
					pinmux = <0x6300>;
				};
			};

			camera0_pdn_output_high@gpio107 {
				phandle = <0x2f>;

				pins_cmd_dat {
					output-high;
					pinmux = <0x6b00>;
				};
			};

			camera0_pdn_output_low@gpio107 {
				phandle = <0x2e>;

				pins_cmd_dat {
					output-low;
					pinmux = <0x6b00>;
				};
			};

			camera0_rst_output_high@gpio109 {
				phandle = <0x2d>;

				pins_cmd_dat {
					output-high;
					pinmux = <0x6d00>;
				};
			};

			camera0_rst_output_low@gpio109 {
				phandle = <0x2c>;

				pins_cmd_dat {
					output-low;
					pinmux = <0x6d00>;
				};
			};

			camera0_vcama_output_high@gpio79 {
				phandle = <0x3c>;

				pins_cmd_dat {
					output-high;
					pinmux = <0x4f00>;
				};
			};

			camera0_vcama_output_low@gpio79 {
				phandle = <0x3d>;

				pins_cmd_dat {
					output-low;
					pinmux = <0x4f00>;
				};
			};

			camera0_vcamd_output_high@gpio80 {
				phandle = <0x38>;

				pins_cmd_dat {
					output-high;
					pinmux = <0x5000>;
				};
			};

			camera0_vcamd_output_low@gpio80 {
				phandle = <0x39>;

				pins_cmd_dat {
					output-low;
					pinmux = <0x5000>;
				};
			};

			camera1_mclk_2mA@gpio100 {
				phandle = <0x46>;

				pins_cmd_dat {
					drive-strength = <0x02>;
					pinmux = <0x6401>;
				};
			};

			camera1_mclk_4mA@gpio100 {
				phandle = <0x47>;

				pins_cmd_dat {
					drive-strength = <0x04>;
					pinmux = <0x6401>;
				};
			};

			camera1_mclk_6mA@gpio100 {
				phandle = <0x48>;

				pins_cmd_dat {
					drive-strength = <0x06>;
					pinmux = <0x6401>;
				};
			};

			camera1_mclk_8mA@gpio100 {
				phandle = <0x49>;

				pins_cmd_dat {
					drive-strength = <0x07>;
					pinmux = <0x6401>;
				};
			};

			camera1_mclk_gpio_mode@gpio100 {
				phandle = <0x45>;

				pins_cmd_dat {
					drive-strength = <0x04>;
					pinmux = <0x6400>;
				};
			};

			camera1_pdn_output_high@gpio98 {
				phandle = <0x33>;

				pins_cmd_dat {
					output-high;
					pinmux = <0x6200>;
				};
			};

			camera1_pdn_output_low@gpio98 {
				phandle = <0x32>;

				pins_cmd_dat {
					output-low;
					pinmux = <0x6200>;
					slew-rate = <0x01>;
				};
			};

			camera1_rst_output_high@gpio102 {
				phandle = <0x31>;

				pins_cmd_dat {
					output-high;
					pinmux = <0x6600>;
				};
			};

			camera1_rst_output_low@gpio102 {
				phandle = <0x30>;

				pins_cmd_dat {
					output-low;
					pinmux = <0x6600>;
				};
			};

			camera1_vcama_output_high@gpio54 {
				phandle = <0x3e>;

				pins_cmd_dat {
					output-high;
					pinmux = <0x3600>;
				};
			};

			camera1_vcama_output_low@gpio54 {
				phandle = <0x3f>;

				pins_cmd_dat {
					output-low;
					pinmux = <0x3600>;
				};
			};

			camera1_vcamd_output_high@gpio31 {
				phandle = <0x3a>;

				pins_cmd_dat {
					output-high;
					pinmux = <0x1f00>;
				};
			};

			camera1_vcamd_output_low@gpio31 {
				phandle = <0x3b>;

				pins_cmd_dat {
					output-low;
					pinmux = <0x1f00>;
				};
			};

			camera2_mclk_2mA@gpio108 {
				phandle = <0x4b>;

				pins_cmd_dat {
					drive-strength = <0x02>;
					pinmux = <0x6c01>;
				};
			};

			camera2_mclk_4mA@gpio108 {
				phandle = <0x4c>;

				pins_cmd_dat {
					drive-strength = <0x04>;
					pinmux = <0x6c01>;
				};
			};

			camera2_mclk_6mA@gpio108 {
				phandle = <0x4d>;

				pins_cmd_dat {
					drive-strength = <0x06>;
					pinmux = <0x6c01>;
				};
			};

			camera2_mclk_8mA@gpio108 {
				phandle = <0x4e>;

				pins_cmd_dat {
					drive-strength = <0x07>;
					pinmux = <0x6c01>;
				};
			};

			camera2_mclk_gpio_mode@gpio108 {
				phandle = <0x4a>;

				pins_cmd_dat {
					drive-strength = <0x04>;
					pinmux = <0x6c00>;
				};
			};

			camera2_pdn_output_high@gpio97 {
				phandle = <0x37>;

				pins_cmd_dat {
					output-high;
					pinmux = <0x6100>;
				};
			};

			camera2_pdn_output_low@gpio97 {
				phandle = <0x36>;

				pins_cmd_dat {
					output-low;
					pinmux = <0x6100>;
				};
			};

			camera2_rst_output_high@gpio101 {
				phandle = <0x35>;

				pins_cmd_dat {
					output-high;
					pinmux = <0x6500>;
				};
			};

			camera2_rst_output_low@gpio101 {
				phandle = <0x34>;

				pins_cmd_dat {
					output-low;
					pinmux = <0x6500>;
				};
			};

			camera2_vcama_output_high@gpio150 {
				phandle = <0x84>;

				pins_cmd_dat {
					output-high;
					pinmux = <0x9600>;
				};
			};

			camera2_vcama_output_low@gpio150 {
				phandle = <0x83>;

				pins_cmd_dat {
					output-low;
					pinmux = <0x9600>;
				};
			};

			camera2_vcamd_output_high@gpio160 {
				phandle = <0x86>;

				pins_cmd_dat {
					output-high;
					pinmux = <0xa000>;
				};
			};

			camera2_vcamd_output_low@gpio160 {
				phandle = <0x85>;

				pins_cmd_dat {
					output-low;
					pinmux = <0xa000>;
				};
			};

			camera3_mclk_2mA@gpio99 {
				phandle = <0x54>;

				pins_cmd_dat {
					drive-strength = <0x02>;
					pinmux = <0x6301>;
				};
			};

			camera3_mclk_4mA@gpio99 {
				phandle = <0x55>;

				pins_cmd_dat {
					drive-strength = <0x04>;
					pinmux = <0x6301>;
				};
			};

			camera3_mclk_6mA@gpio99 {
				phandle = <0x56>;

				pins_cmd_dat {
					drive-strength = <0x06>;
					pinmux = <0x6301>;
				};
			};

			camera3_mclk_8mA@gpio99 {
				phandle = <0x57>;

				pins_cmd_dat {
					drive-strength = <0x07>;
					pinmux = <0x6301>;
				};
			};

			camera3_mclk_gpio_mode@gpio99 {
				phandle = <0x53>;

				pins_cmd_dat {
					drive-strength = <0x04>;
					pinmux = <0x6300>;
				};
			};

			camera3_pdn_output_high@gpio14 {
				phandle = <0x52>;

				pins_cmd_dat {
					output-high;
					pinmux = <0xe00>;
				};
			};

			camera3_pdn_output_low@gpio14 {
				phandle = <0x51>;

				pins_cmd_dat {
					output-low;
					pinmux = <0xe00>;
				};
			};

			camera3_rst_output_high@gpio16 {
				phandle = <0x50>;

				pins_cmd_dat {
					output-high;
					pinmux = <0x1000>;
				};
			};

			camera3_rst_output_low@gpio16 {
				phandle = <0x4f>;

				pins_cmd_dat {
					output-low;
					pinmux = <0x1000>;
				};
			};

			camera3_vcama_output_high@gpio24 {
				phandle = <0x88>;

				pins_cmd_dat {
					output-high;
					pinmux = <0x1800>;
				};
			};

			camera3_vcama_output_low@gpio24 {
				phandle = <0x87>;

				pins_cmd_dat {
					output-low;
					pinmux = <0x1800>;
				};
			};

			camera3_vcamd_output_high@gpio21 {
				phandle = <0x8a>;

				pins_cmd_dat {
					output-high;
					pinmux = <0x1500>;
				};
			};

			camera3_vcamd_output_low@gpio21 {
				phandle = <0x89>;

				pins_cmd_dat {
					output-low;
					pinmux = <0x1500>;
				};
			};

			camera4_mclk_2mA@gpio111 {
				phandle = <0x5d>;

				pins_cmd_dat {
					drive-strength = <0x02>;
					pinmux = <0x6f01>;
				};
			};

			camera4_mclk_4mA@gpio111 {
				phandle = <0x5e>;

				pins_cmd_dat {
					drive-strength = <0x04>;
					pinmux = <0x6f01>;
				};
			};

			camera4_mclk_6mA@gpio111 {
				phandle = <0x5f>;

				pins_cmd_dat {
					drive-strength = <0x06>;
					pinmux = <0x6f01>;
				};
			};

			camera4_mclk_8mA@gpio111 {
				phandle = <0x60>;

				pins_cmd_dat {
					drive-strength = <0x07>;
					pinmux = <0x6f01>;
				};
			};

			camera4_mclk_gpio_mode@gpio111 {
				phandle = <0x5c>;

				pins_cmd_dat {
					drive-strength = <0x04>;
					pinmux = <0x6f00>;
				};
			};

			camera4_pdn_output_high@gpio110 {
				phandle = <0x5b>;

				pins_cmd_dat {
					output-high;
					pinmux = <0x6e00>;
				};
			};

			camera4_pdn_output_low@gpio110 {
				phandle = <0x5a>;

				pins_cmd_dat {
					output-low;
					pinmux = <0x6e00>;
				};
			};

			camera4_rst_output_high@gpio92 {
				phandle = <0x59>;

				pins_cmd_dat {
					output-high;
					pinmux = <0x5c00>;
				};
			};

			camera4_rst_output_low@gpio92 {
				phandle = <0x58>;

				pins_cmd_dat {
					output-low;
					pinmux = <0x5c00>;
				};
			};
		};
	};

	fragment@59 {
		target = <0xffffffff>;

		__overlay__ {
			cam0_vcamio-supply = <0xffffffff>;
			cam1_vcamd-supply = <0xffffffff>;
			cam1_vcamio-supply = <0xffffffff>;
			cam2_vcama-supply = <0xffffffff>;
			cam2_vcamio-supply = <0xffffffff>;
			cam3_vcama-supply = <0xffffffff>;
			cam3_vcamd-supply = <0xffffffff>;
			cam3_vcamio-supply = <0xffffffff>;
			cam4_vcama-supply = <0xffffffff>;
			cam4_vcamio-supply = <0xffffffff>;
			pinctrl-0 = <0x2b>;
			pinctrl-1 = <0x2c>;
			pinctrl-10 = <0x35>;
			pinctrl-11 = <0x36>;
			pinctrl-12 = <0x37>;
			pinctrl-13 = <0x38>;
			pinctrl-14 = <0x39>;
			pinctrl-15 = <0x3a>;
			pinctrl-16 = <0x3b>;
			pinctrl-17 = <0x3c>;
			pinctrl-18 = <0x3d>;
			pinctrl-19 = <0x3e>;
			pinctrl-2 = <0x2d>;
			pinctrl-20 = <0x3f>;
			pinctrl-21 = <0x40>;
			pinctrl-22 = <0x41>;
			pinctrl-23 = <0x42>;
			pinctrl-24 = <0x43>;
			pinctrl-25 = <0x44>;
			pinctrl-26 = <0x45>;
			pinctrl-27 = <0x46>;
			pinctrl-28 = <0x47>;
			pinctrl-29 = <0x48>;
			pinctrl-3 = <0x2e>;
			pinctrl-30 = <0x49>;
			pinctrl-31 = <0x4a>;
			pinctrl-32 = <0x4b>;
			pinctrl-33 = <0x4c>;
			pinctrl-34 = <0x4d>;
			pinctrl-35 = <0x4e>;
			pinctrl-36 = <0x4f>;
			pinctrl-37 = <0x50>;
			pinctrl-38 = <0x51>;
			pinctrl-39 = <0x52>;
			pinctrl-4 = <0x2f>;
			pinctrl-40 = <0x53>;
			pinctrl-41 = <0x54>;
			pinctrl-42 = <0x55>;
			pinctrl-43 = <0x56>;
			pinctrl-44 = <0x57>;
			pinctrl-45 = <0x58>;
			pinctrl-46 = <0x59>;
			pinctrl-47 = <0x5a>;
			pinctrl-48 = <0x5b>;
			pinctrl-49 = <0x5c>;
			pinctrl-5 = <0x30>;
			pinctrl-50 = <0x5d>;
			pinctrl-51 = <0x5e>;
			pinctrl-52 = <0x5f>;
			pinctrl-53 = <0x60>;
			pinctrl-54 = <0x61>;
			pinctrl-55 = <0x62>;
			pinctrl-56 = <0x63>;
			pinctrl-57 = <0x64>;
			pinctrl-6 = <0x31>;
			pinctrl-7 = <0x32>;
			pinctrl-8 = <0x33>;
			pinctrl-9 = <0x34>;
			pinctrl-names = "default\0cam0_rst0\0cam0_rst1\0cam0_pnd0\0cam0_pnd1\0cam1_rst0\0cam1_rst1\0cam1_pnd0\0cam1_pnd1\0cam2_rst0\0cam2_rst1\0cam2_pnd0\0cam2_pnd1\0cam0_vcamd_on\0cam0_vcamd_off\0cam1_vcamd_on\0cam1_vcamd_off\0cam0_vcama_on\0cam0_vcama_off\0cam1_vcama_on\0cam1_vcama_off\0cam0_mclk_off\0cam0_mclk_2mA\0cam0_mclk_4mA\0cam0_mclk_6mA\0cam0_mclk_8mA\0cam1_mclk_off\0cam1_mclk_2mA\0cam1_mclk_4mA\0cam1_mclk_6mA\0cam1_mclk_8mA\0cam2_mclk_off\0cam2_mclk_2mA\0cam2_mclk_4mA\0cam2_mclk_6mA\0cam2_mclk_8mA\0cam3_rst0\0cam3_rst1\0cam3_pnd0\0cam3_pnd1\0cam3_mclk_off\0cam3_mclk_2mA\0cam3_mclk_4mA\0cam3_mclk_6mA\0cam3_mclk_8mA\0cam4_rst0\0cam4_rst1\0cam4_pnd0\0cam4_pnd1\0cam4_mclk_off\0cam4_mclk_2mA\0cam4_mclk_4mA\0cam4_mclk_6mA\0cam4_mclk_8mA\0cam_mipi_switch_en_0\0cam_mipi_switch_en_1\0cam_mipi_switch_sel_0\0cam_mipi_switch_sel_1";
			status = "okay";
		};
	};

	fragment@6 {
		target = <0xffffffff>;

		__overlay__ {

			focaltech_spi@0 {
				compatible = "focaltech,fts";
				reg = <0x00>;
				spi-max-frequency = <0x5b8d80>;
				status = "okay";
			};
		};
	};

	fragment@7 {
		target = <0xffffffff>;

		__overlay__ {
			gpio_lcd_bias_enn_gpio = <0xffffffff 0xa5 0x00>;
			gpio_lcd_bias_enn_pin = <0xa5>;
			gpio_lcd_bias_enp_gpio = <0xffffffff 0xa9 0x00>;
			gpio_lcd_bias_enp_pin = <0xa9>;
			gpio_lcd_ldo18_gpio = <0xffffffff 0x4e 0x00>;
			gpio_lcd_ldo18_pin = <0x4e>;
		};
	};

	fragment@8 {
		target = <0xffffffff>;

		__overlay__ {
			clock-frequency = <0x61a80>;

			mtk-usb@60 {
				compatible = "mediatek,mtk-usb";
				reg = <0x60>;
				status = "okay";
			};
		};
	};

	fragment@9 {
		target = <0xffffffff>;

		__overlay__ {
			#address-cells = <0x01>;
			#size-cells = <0x00>;

			fingerprint@spi2 {
				compatible = "focaltech,fingerprint-spidev";
				phandle = <0x73>;
				reg = <0x00>;
				spi-max-frequency = <0xf4240>;
				status = "okay";
			};
		};
	};
};
