/dts-v1/;

/ {
	#address-cells = <0x02>;
	#size-cells = <0x02>;
	compatible = "mediatek,MT6768";
	interrupt-parent = <0x01>;
	model = "MT6768";

	__symbols__ {
		MCDI_CLUSTER = "/cpus/idle-states/mcdi-cluster";
		MCDI_CPU = "/cpus/idle-states/mcdi-cpu";
		STANDBY = "/cpus/idle-states/standby";
		SUSPEND = "/cpus/idle-states/suspend";
		accdet = "/accdet";
		afe = "/mt6768-afe-pcm@11220000";
		apdma = "/dma-controller@11000980";
		apmixed = "/apmixed@1000c000";
		apuart0 = "/serial@11002000";
		apuart1 = "/serial@11003000";
		aud_clk_miso_off = "/pinctrl/aud_clk_miso_off";
		aud_clk_miso_on = "/pinctrl/aud_clk_miso_on";
		aud_clk_mosi_off = "/pinctrl/aud_clk_mosi_off";
		aud_clk_mosi_on = "/pinctrl/aud_clk_mosi_on";
		aud_dat_miso_off = "/pinctrl/aud_dat_miso_off";
		aud_dat_miso_on = "/pinctrl/aud_dat_miso_on";
		aud_dat_mosi_off = "/pinctrl/aud_dat_mosi_off";
		aud_dat_mosi_on = "/pinctrl/aud_dat_mosi_on";
		aud_gpio_i2s0_off = "/pinctrl/aud_gpio_i2s0_off";
		aud_gpio_i2s0_on = "/pinctrl/aud_gpio_i2s0_on";
		aud_gpio_i2s1_off = "/pinctrl/aud_gpio_i2s1_off";
		aud_gpio_i2s1_on = "/pinctrl/aud_gpio_i2s1_on";
		aud_gpio_i2s2_off = "/pinctrl/aud_gpio_i2s2_off";
		aud_gpio_i2s2_on = "/pinctrl/aud_gpio_i2s2_on";
		aud_gpio_i2s3_off = "/pinctrl/aud_gpio_i2s3_off";
		aud_gpio_i2s3_on = "/pinctrl/aud_gpio_i2s3_on";
		audio = "/audio@11220000";
		auxadc = "/auxadc@11001000";
		bat_gm30 = "/battery";
		camsys = "/camsys@1a000000";
		charger = "/charger";
		chosen = "/chosen";
		clk26m = "/clocks/clk26m";
		clk32k = "/clocks/clk32k";
		consys = "/consys@18002000";
		cpu0 = "/cpus/cpu@000";
		cpu1 = "/cpus/cpu@001";
		cpu2 = "/cpus/cpu@002";
		cpu3 = "/cpus/cpu@003";
		cpu4 = "/cpus/cpu@100";
		cpu5 = "/cpus/cpu@101";
		cpu6 = "/cpus/cpu@102";
		cpu7 = "/cpus/cpu@103";
		cpu_dbgapb = "/cpu_dbgapb@0e010000";
		dcm = "/dcm";
		dfd_cache = "/dfd_cache";
		disp_color0 = "/disp_color0@1400f000";
		disp_mutex0 = "/disp_mutex0@14001000";
		doe_dvfs_cl0 = "/cpus/cpu-map/cluster0/doe";
		doe_dvfs_cl1 = "/cpus/cpu-map/cluster1/doe";
		drcc = "/drcc";
		dsi_te = "/dsi_te";
		dvfsp = "/dvfsp@00110800";
		dvfsrc = "/dvfsrc@10012000";
		eem_fsm = "/eem_fsm@1100b000";
		eint = "/apirq@1000b000";
		flashlight_core = "/flashlight_core";
		flashlights_aw36518 = "/flashlights_aw36518";
		flashlights_mt6370 = "/flashlights_mt6370";
		fpc = "/fpc";
		gce = "/gce@10238000";
		gce_mbox = "/gce_mbox@10238000";
		gic = "/interrupt-controller";
		goodix_fp = "/fingerprint";
		gpio = "/gpio@10005000";
		gpio_usage_mapping = "/gpio";
		hwrng = "/hwrng";
		i2c0 = "/i2c0@11007000";
		i2c1 = "/i2c1@11008000";
		i2c2 = "/i2c2@11009000";
		i2c3 = "/i2c3@1100f000";
		i2c4 = "/i2c4@11011000";
		i2c5 = "/i2c5@11016000";
		i2c6 = "/i2c6@1100d000";
		i2c7 = "/i2c7@11004000";
		i2c8 = "/i2c8@11005000";
		i2c_common = "/i2c_common";
		i2c_lcd_bias_mtk = "/i2c0@11007000/i2c_lcd_bias@3e";
		idlebus26m = "/cpus/idle-states/idlebus26m";
		idledram = "/cpus/idle-states/idledram";
		idlesyspll = "/cpus/idle-states/idlesyspll";
		imgsys = "/imgsys@15020000";
		infracfg_ao = "/infracfg_ao@10001000";
		io_cfg_bl = "/io_cfg_bl@10002600";
		io_cfg_lb = "/io_cfg_lb@10002400";
		io_cfg_lm = "/io_cfg_lm@10002200";
		io_cfg_lt = "/io_cfg_lt@10002000";
		io_cfg_rb = "/io_cfg_rb@10002a00";
		io_cfg_rm = "/io_cfg_rm@10002800";
		io_cfg_rt = "/io_cfg_rt@10002c00";
		io_cfg_tl = "/io_cfg_tl@10002e00";
		irq_nfc = "/irq_nfc";
		irtx_pwm = "/irtx_pwm";
		kd_camera_hw1 = "/kd_camera_hw1@1a040000";
		keypad = "/kp@10010000";
		lcm_power_gpio = "/pinctrl/lcm_power_gpio";
		lk_charger = "/lk_charger";
		main_pmic = "/pwrap@1000d000/mt6358-pmic";
		mcdi = "/mcdi@0010fc00";
		mcucfg = "/mcucfg@0c530000";
		md1_sim1_hot_plug_eint = "/md1_sim1_hot_plug_eint";
		md1_sim2_hot_plug_eint = "/md1_sim2_hot_plug_eint";
		md_auxadc = "/md_auxadc";
		mdcldma = "/mdcldma@10014000";
		mdp_ccorr = "/mdp_ccorr0@14005000";
		mdp_rdma0 = "/mdp_rdma0@14004000";
		mdp_rsz0 = "/mdp_rsz0@14006000";
		mdp_rsz1 = "/mdp_rsz1@14007000";
		mdp_tdshp0 = "/mdp_tdshp0@1400a000";
		mdp_wdma0 = "/mdp_wdma0@14008000";
		mdp_wrot0 = "/mdp_wrot0@14009000";
		memory_ssmr_features = "/memory-ssmr-features";
		mfg_cfg = "/mfg_cfg@13000000";
		mipi_rx_ana_csi0a = "/mipi_rx_ana_csi0a@11c10000";
		mipi_rx_ana_csi0b = "/mipi_rx_ana_csi0b@11c11000";
		mipi_rx_ana_csi1a = "/mipi_rx_ana_csi1a@11c12000";
		mipi_rx_ana_csi1b = "/mipi_rx_ana_csi1b@11c13000";
		mipi_rx_ana_csi2a = "/mipi_rx_ana_csi2a@11c14000";
		mipi_rx_ana_csi2b = "/mipi_rx_ana_csi2b@11c15000";
		mmsys_config = "/mmsys_config@14000000";
		mrdump_ext_rst = "/mrdump_ext_rst";
		msdc0 = "/msdc@11230000";
		msdc0_pins_default = "/pinctrl/msdc0@default";
		msdc0_pins_hs200 = "/pinctrl/msdc0@hs200";
		msdc0_pins_hs400 = "/pinctrl/msdc0@hs400";
		msdc0_register_setting_default = "/pinctrl/msdc0@register_default";
		msdc1 = "/msdc@11240000";
		msdc1_pins_ddr50 = "/pinctrl/msdc1@ddr50";
		msdc1_pins_default = "/pinctrl/msdc1@default";
		msdc1_pins_sdr104 = "/pinctrl/msdc1@sdr104";
		msdc1_pins_sdr50 = "/pinctrl/msdc1@sdr50";
		msdc1_register_setting_default = "/pinctrl/msdc1@register_default";
		mt6358_misc = "/pwrap@1000d000/mt6358-pmic/mt6358_misc";
		mt6358_rtc = "/pwrap@1000d000/mt6358-pmic/mt6358_rtc";
		mt6358_snd = "/mt6358_snd";
		mt6358regulator = "/pwrap@1000d000/mt6358-pmic/mt6358regulator";
		mt_charger = "/mt_charger";
		mt_cpufreq = "/mt_cpufreq";
		mt_pmic_va09_ldo_reg = "/pwrap@1000d000/mt6358-pmic/mt6358regulator/ldo_va09";
		mt_pmic_va12_ldo_reg = "/pwrap@1000d000/mt6358-pmic/mt6358regulator/ldo_va12";
		mt_pmic_vaud28_ldo_reg = "/pwrap@1000d000/mt6358-pmic/mt6358regulator/ldo_vaud28";
		mt_pmic_vaux18_ldo_reg = "/pwrap@1000d000/mt6358-pmic/mt6358regulator/ldo_vaux18";
		mt_pmic_vbif28_ldo_reg = "/pwrap@1000d000/mt6358-pmic/mt6358regulator/ldo_vbif28";
		mt_pmic_vcama1_ldo_reg = "/pwrap@1000d000/mt6358-pmic/mt6358regulator/ldo_vcama1";
		mt_pmic_vcama2_ldo_reg = "/pwrap@1000d000/mt6358-pmic/mt6358regulator/ldo_vcama2";
		mt_pmic_vcamd_ldo_reg = "/pwrap@1000d000/mt6358-pmic/mt6358regulator/ldo_vcamd";
		mt_pmic_vcamio_ldo_reg = "/pwrap@1000d000/mt6358-pmic/mt6358regulator/ldo_vcamio";
		mt_pmic_vcn18_ldo_reg = "/pwrap@1000d000/mt6358-pmic/mt6358regulator/ldo_vcn18";
		mt_pmic_vcn28_ldo_reg = "/pwrap@1000d000/mt6358-pmic/mt6358regulator/ldo_vcn28";
		mt_pmic_vcn33_bt_ldo_reg = "/pwrap@1000d000/mt6358-pmic/mt6358regulator/ldo_vcn33_bt";
		mt_pmic_vcn33_wifi_ldo_reg = "/pwrap@1000d000/mt6358-pmic/mt6358regulator/ldo_vcn33_wifi";
		mt_pmic_vcore_buck_reg = "/pwrap@1000d000/mt6358-pmic/mt6358regulator/buck_vcore";
		mt_pmic_vdram1_buck_reg = "/pwrap@1000d000/mt6358-pmic/mt6358regulator/buck_vdram1";
		mt_pmic_vdram2_ldo_reg = "/pwrap@1000d000/mt6358-pmic/mt6358regulator/ldo_vdram2";
		mt_pmic_vefuse_ldo_reg = "/pwrap@1000d000/mt6358-pmic/mt6358regulator/ldo_vefuse";
		mt_pmic_vemc_ldo_reg = "/pwrap@1000d000/mt6358-pmic/mt6358regulator/ldo_vemc";
		mt_pmic_vfe28_ldo_reg = "/pwrap@1000d000/mt6358-pmic/mt6358regulator/ldo_vfe28";
		mt_pmic_vgpu_buck_reg = "/pwrap@1000d000/mt6358-pmic/mt6358regulator/buck_vgpu";
		mt_pmic_vibr_ldo_reg = "/pwrap@1000d000/mt6358-pmic/mt6358regulator/ldo_vibr";
		mt_pmic_vio18_ldo_reg = "/pwrap@1000d000/mt6358-pmic/mt6358regulator/ldo_vio18";
		mt_pmic_vio28_ldo_reg = "/pwrap@1000d000/mt6358-pmic/mt6358regulator/ldo_vio28";
		mt_pmic_vldo28_ldo_reg = "/pwrap@1000d000/mt6358-pmic/mt6358regulator/ldo_vldo28";
		mt_pmic_vmc_ldo_reg = "/pwrap@1000d000/mt6358-pmic/mt6358regulator/ldo_vmc";
		mt_pmic_vmch_ldo_reg = "/pwrap@1000d000/mt6358-pmic/mt6358regulator/ldo_vmch";
		mt_pmic_vmodem_buck_reg = "/pwrap@1000d000/mt6358-pmic/mt6358regulator/buck_vmodem";
		mt_pmic_vpa_buck_reg = "/pwrap@1000d000/mt6358-pmic/mt6358regulator/buck_vpa";
		mt_pmic_vproc11_buck_reg = "/pwrap@1000d000/mt6358-pmic/mt6358regulator/buck_vproc11";
		mt_pmic_vproc12_buck_reg = "/pwrap@1000d000/mt6358-pmic/mt6358regulator/buck_vproc12";
		mt_pmic_vrf12_ldo_reg = "/pwrap@1000d000/mt6358-pmic/mt6358regulator/ldo_vrf12";
		mt_pmic_vrf18_ldo_reg = "/pwrap@1000d000/mt6358-pmic/mt6358regulator/ldo_vrf18";
		mt_pmic_vs1_buck_reg = "/pwrap@1000d000/mt6358-pmic/mt6358regulator/buck_vs1";
		mt_pmic_vs2_buck_reg = "/pwrap@1000d000/mt6358-pmic/mt6358regulator/buck_vs2";
		mt_pmic_vsim1_ldo_reg = "/pwrap@1000d000/mt6358-pmic/mt6358regulator/ldo_vsim1";
		mt_pmic_vsim2_ldo_reg = "/pwrap@1000d000/mt6358-pmic/mt6358regulator/ldo_vsim2";
		mt_pmic_vsram_gpu_ldo_reg = "/pwrap@1000d000/mt6358-pmic/mt6358regulator/ldo_vsram_gpu";
		mt_pmic_vsram_others_ldo_reg = "/pwrap@1000d000/mt6358-pmic/mt6358regulator/ldo_vsram_others";
		mt_pmic_vsram_proc11_ldo_reg = "/pwrap@1000d000/mt6358-pmic/mt6358regulator/ldo_vsram_proc11";
		mt_pmic_vsram_proc12_ldo_reg = "/pwrap@1000d000/mt6358-pmic/mt6358regulator/ldo_vsram_proc12";
		mt_pmic_vusb_ldo_reg = "/pwrap@1000d000/mt6358-pmic/mt6358regulator/ldo_vusb";
		mt_pmic_vxo22_ldo_reg = "/pwrap@1000d000/mt6358-pmic/mt6358regulator/ldo_vxo22";
		mtkfb = "/mtkfb@0";
		nfc = "/nfc";
		odm = "/odm";
		pd_adapter = "/pd_adapter";
		pericfg = "/pericfg@10003000";
		pio = "/pinctrl";
		pmic = "/pwrap@1000d000/mt6358-pmic/mt-pmic";
		pmic_auxadc = "/pwrap@1000d000/mt6358-pmic/mt635x-auxadc";
		pmic_clock_buffer_ctrl = "/pmic_clock_buffer_ctrl";
		prize_disp = "/prize_disp";
		pwrap = "/pwrap@1000d000";
		pwraph = "/pwraphal@";
		radio_md_cfg = "/radio_md_cfg";
		reserved_memory = "/reserved-memory";
		rt1711_typec = "/type_c_port0";
		rt9465_slave_chr = "/rt9465_slave_chr";
		scpsys = "/scpsys@10001000";
		sleep = "/sleep@10006000";
		smart_pa = "/smart_pa";
		smi_larb0 = "/smi_larb0@14003000";
		smi_larb1 = "/smi_larb1@16010000";
		smi_larb2 = "/smi_larb2@15021000";
		smi_larb3 = "/smi_larb3@1a002000";
		smi_larb4 = "/smi_larb4@17010000";
		snd_scp_spk = "/snd_scp_spk";
		sound = "/sound";
		spi0 = "/spi0@1100a000";
		spi1 = "/spi1@11010000";
		spi2 = "/spi2@11012000";
		spi3 = "/spi3@11013000";
		spi4 = "/spi4@11014000";
		spi5 = "/spi5@11015000";
		subpmic_pmu_eint = "/mt6370_pmu_eint";
		sysirq = "/intpol-controller@0";
		tboard_thermistor1 = "/thermal-sensor1";
		tboard_thermistor2 = "/thermal-sensor2";
		tcpc_pd = "/tcpc_pd_eint";
		timer = "/timer";
		topckgen = "/topckgen@10000000";
		toprgu = "/toprgu@10007000";
		touch = "/touch";
		vcu = "/vcu@16000000";
		vdec_gcon = "/vdec_gcon@16000000";
		venc_gcon = "/venc_gcon@17000000";
		vow_clk_miso_off = "/pinctrl/vow_clk_miso_off";
		vow_clk_miso_on = "/pinctrl/vow_clk_miso_on";
		vow_dat_miso_off = "/pinctrl/vow_dat_miso_off";
		vow_dat_miso_on = "/pinctrl/vow_dat_miso_on";
	};

	accdet {
		compatible = "mediatek,pmic-accdet";
		phandle = <0xa9>;
	};

	aes_top0@10016000 {
		compatible = "mediatek,aes_top0";
		reg = <0x00 0x10016000 0x00 0x1000>;
	};

	amms_control {
		compatible = "mediatek,amms";
		interrupts = <0x00 0x131 0x01>;
	};

	ap_ccif0@10209000 {
		compatible = "mediatek,ap_ccif0";
		interrupts = <0x00 0xa4 0x08>;
		reg = <0x00 0x10209000 0x00 0x1000>;
	};

	ap_ccif1@1020b000 {
		compatible = "mediatek,ap_ccif1";
		interrupts = <0x00 0xa6 0x08>;
		reg = <0x00 0x1020b000 0x00 0x1000>;
	};

	ap_ccif2@1023c000 {
		compatible = "mediatek,ap_ccif2";
		interrupts = <0x00 0xa0 0x08>;
		reg = <0x00 0x1023c000 0x00 0x1000>;
	};

	ap_ccif3@1023e000 {
		compatible = "mediatek,ap_ccif3";
		interrupts = <0x00 0xa3 0x08>;
		reg = <0x00 0x1023e000 0x00 0x1000>;
	};

	ap_dma@11000000 {
		compatible = "mediatek,ap_dma";
		interrupts = <0x00 0x66 0x08>;
		reg = <0x00 0x11000000 0x00 0x1000>;
	};

	apcldmain@1021b000 {
		compatible = "mediatek,apcldmain";
		reg = <0x00 0x1021b000 0x00 0x100>;
	};

	apcldmain@1021b100 {
		compatible = "mediatek,apcldmain";
		reg = <0x00 0x1021b100 0x00 0x100>;
	};

	apcldmain_ao@10014000 {
		compatible = "mediatek,apcldmain_ao";
		reg = <0x00 0x10014000 0x00 0x400>;
	};

	apcldmamisc@1021b800 {
		compatible = "mediatek,apcldmamisc";
		interrupts = <0x00 0xb4 0x04>;
		reg = <0x00 0x1021b800 0x00 0x100>;
	};

	apcldmamisc@1021b900 {
		compatible = "mediatek,apcldmamisc";
		reg = <0x00 0x1021b900 0x00 0x400>;
	};

	apcldmamisc_ao@10014800 {
		compatible = "mediatek,apcldmamisc_ao";
		reg = <0x00 0x10014800 0x00 0x400>;
	};

	apcldmamisc_ao@10014c00 {
		compatible = "mediatek,apcldmamisc_ao";
		reg = <0x00 0x10014c00 0x00 0x400>;
	};

	apcldmaout@1021b400 {
		compatible = "mediatek,apcldmaout";
		reg = <0x00 0x1021b400 0x00 0x100>;
	};

	apcldmaout@1021b500 {
		compatible = "mediatek,apcldmaout";
		reg = <0x00 0x1021b500 0x00 0x100>;
	};

	apcldmaout_ao@10014400 {
		compatible = "mediatek,apcldmaout_ao";
		reg = <0x00 0x10014400 0x00 0x400>;
	};

	apirq@1000b000 {
		compatible = "mediatek,apirq";
		interrupts = <0x00 0xba 0x04>;
		phandle = <0x1d>;
		reg = <0x00 0x1000b000 0x00 0x1000>;
	};

	apmixed@1000c000 {
		#clock-cells = <0x01>;
		compatible = "mediatek,apmixed\0syscon";
		phandle = <0x3c>;
		reg = <0x00 0x1000c000 0x00 0x1000>;
	};

	apxgpt@10008000 {
		clocks = <0x1f>;
		compatible = "mediatek,apxgpt";
		interrupts = <0x00 0xb9 0x08>;
		reg = <0x00 0x10008000 0x00 0x1000>;
	};

	atf_logger {
		compatible = "mediatek,atf_logger";
		interrupts = <0x00 0x128 0x01>;
	};

	audio@11220000 {
		#clock-cells = <0x01>;
		compatible = "mediatek,audio\0syscon";
		phandle = <0x3d>;
		reg = <0x00 0x11220000 0x00 0x1000>;
	};

	audio_sram@11221000 {
		block_size = <0x1000>;
		compatible = "mediatek,audio_sram";
		mode_size = <0x6c00 0x9000>;
		prefer_mode = <0x01>;
		reg = <0x00 0x11221000 0x00 0x9000>;
	};

	auxadc@11001000 {
		#io-channel-cells = <0x01>;
		clock-names = "main";
		clocks = <0x21 0x21>;
		compatible = "mediatek,mt6768-auxadc";
		interrupts = <0x00 0x42 0x02>;
		mediatek,cali-efuse-index = <0x6a>;
		mediatek,cali-en-bit = <0x14>;
		mediatek,cali-ge-bit = <0x0a>;
		mediatek,cali-oe-bit = <0x00>;
		phandle = <0x23>;
		reg = <0x00 0x11001000 0x00 0x1000>;
	};

	battery {
		ACTIVE_TABLE = <0x06>;
		CAR_TUNE_VALUE = <0x64>;
		COM_FG_METER_RESISTANCE = <0x64>;
		COM_R_FG_VALUE = <0x00>;
		DIFFERENCE_FULLOCV_ITH = <0xc8>;
		EMBEDDED_SEL = <0x00>;
		FG_METER_RESISTANCE = <0x64>;
		KEEP_100_PERCENT = <0x01>;
		MULTI_TEMP_GAUGE0 = <0x01>;
		PMIC_MIN_VOL = <0x82dc>;
		PMIC_SHUTDOWN_CURRENT = <0x14>;
		POWERON_SYSTEM_IBOOT = <0x1f4>;
		Q_MAX_SYS_VOLTAGE_BAT0 = <0xd16>;
		Q_MAX_SYS_VOLTAGE_BAT1 = <0xd16>;
		Q_MAX_SYS_VOLTAGE_BAT2 = <0xd16>;
		Q_MAX_SYS_VOLTAGE_BAT3 = <0xd16>;
		R_FG_VALUE = <0x0a>;
		SHUTDOWN_1_TIME = <0x1e>;
		SHUTDOWN_GAUGE0_VOLTAGE = <0x84d0>;
		TEMPERATURE_T0 = <0x32>;
		TEMPERATURE_T1 = <0x19>;
		TEMPERATURE_T2 = <0x0a>;
		TEMPERATURE_T3 = <0x00>;
		TEMPERATURE_T4 = <0xfffffffa>;
		TEMPERATURE_T5 = <0xfffffff6>;
		battery0_profile_t0 = <0x00 0xa910 0x3cf 0x12d 0xa8a2 0x3cf 0x259 0xa82a 0x401 0x386 0xa7b1 0x3e8 0x4b2 0xa743 0x3cf 0x5df 0xa6c1 0x3b6 0x70c 0xa653 0x3d0 0x838 0xa5ee 0x419 0x965 0xa56c 0x3d0 0xa91 0xa508 0x401 0xbbe 0xa4a4 0x41a 0xceb 0xa435 0x419 0xe17 0xa3bd 0x402 0xf44 0xa34f 0x41a 0x1070 0xa2eb 0x41a 0x119d 0xa273 0x41a 0x12ca 0xa20b 0x41c 0x13f6 0xa19e 0x433 0x1523 0xa142 0x433 0x1650 0xa0d4 0x433 0x177c 0xa067 0x431 0x18a9 0xa003 0x41c 0x19d5 0x9fa7 0x433 0x1b02 0x9f2f 0x431 0x1c2f 0x9ec3 0x424 0x1d5b 0x9e73 0x499 0x1e88 0x9e22 0x4ac 0x1fb4 0x9dc7 0x47e 0x20e1 0x9d64 0x47a 0x220e 0x9d0b 0x453 0x233a 0x9cba 0x497 0x2467 0x9c68 0x495 0x2593 0x9c06 0x480 0x26c0 0x9bb6 0x497 0x27ed 0x9b66 0x49f 0x2919 0x9b15 0x4dd 0x2a46 0x9abc 0x4b5 0x2b72 0x9a6a 0x4e2 0x2c9f 0x9a0c 0x4da 0x2dcc 0x998c 0x494 0x2ef8 0x991c 0x478 0x3025 0x98a5 0x446 0x3151 0x983c 0x41d 0x327e 0x97f3 0x42a 0x33ab 0x979e 0x3eb 0x34d7 0x9769 0x401 0x3604 0x9723 0x3fe 0x3730 0x96e1 0x3ef 0x385d 0x96b4 0x412 0x398a 0x967b 0x3f0 0x3ab6 0x9653 0x41e 0x3be3 0x9628 0x42f 0x3d10 0x95ed 0x416 0x3e3c 0x95bf 0x40a 0x3f69 0x959b 0x449 0x4095 0x9563 0x491 0x41c2 0x953d 0x405 0x42ef 0x951f 0x423 0x441b 0x94ff 0x447 0x4548 0x94d7 0x43c 0x4674 0x94ab 0x457 0x47a1 0x9478 0x445 0x48ce 0x946c 0x4e8 0x49fa 0x9450 0x484 0x4b27 0x9420 0x447 0x4c53 0x9416 0x48d 0x4d80 0x93e8 0x465 0x4ead 0x93c8 0x46a 0x4fd9 0x939a 0x46f 0x5106 0x9352 0x429 0x5232 0x9306 0x401 0x535f 0x92ce 0x406 0x548c 0x92a3 0x41a 0x55b8 0x9271 0x40f 0x56e5 0x9241 0x3f3 0x5811 0x9219 0x435 0x593e 0x91f1 0x476 0x5a6b 0x91cb 0x401 0x5b97 0x91af 0x40d 0x5cc4 0x9190 0x42d 0x5df0 0x9152 0x413 0x5f1d 0x9109 0x3fa 0x604a 0x90c6 0x424 0x6176 0x90a5 0x4a1 0x62a3 0x9068 0x433 0x63d0 0x9002 0x42c 0x64fc 0x8fd6 0x405 0x6629 0x8fbd 0x3dd 0x6755 0x8fb9 0x401 0x6882 0x8fbd 0x40f 0x69af 0x8fb3 0x448 0x6adb 0x8fa6 0x49a 0x6c08 0x8f81 0x4d4 0x6d34 0x8f00 0x49a 0x6e61 0x8dd1 0x45e 0x6f8e 0x8c08 0x45b 0x70ba 0x89c7 0x47e 0x71e7 0x869b 0x4a3 0x7313 0x8143 0x600 0x7440 0x72ec 0x2198>;
		battery0_profile_t0_col = <0x03>;
		battery0_profile_t0_num = <0x64>;
		battery0_profile_t1 = <0x00 0xa8c0 0x41a 0x12d 0xa848 0x514 0x259 0xa7d0 0x546 0x386 0xa757 0x514 0x4b2 0xa6df 0x52d 0x5df 0xa67b 0x546 0x70c 0xa60d 0x55f 0x838 0xa594 0x579 0x965 0xa526 0x5aa 0xa91 0xa4b8 0x5aa 0xbbe 0xa453 0x5c2 0xceb 0xa3d2 0x5a9 0xe17 0xa36d 0x590 0xf44 0xa2ff 0x578 0x1070 0xa291 0x579 0x119d 0xa237 0x5aa 0x12ca 0xa1c5 0x5a8 0x13f6 0xa161 0x591 0x1523 0xa0fc 0x593 0x1650 0xa085 0x5a8 0x177c 0xa021 0x595 0x18a9 0x9fbd 0x5c3 0x19d5 0x9f63 0x5c3 0x1b02 0x9f0c 0x5c9 0x1c2f 0x9ed9 0x60e 0x1d5b 0x9e97 0x60e 0x1e88 0x9e11 0x605 0x1fb4 0x9d61 0x5ae 0x20e1 0x9cdf 0x5de 0x220e 0x9c6b 0x5f5 0x233a 0x9c1c 0x5fa 0x2467 0x9be1 0x635 0x2593 0x9bae 0x6b8 0x26c0 0x9b70 0x686 0x27ed 0x9b20 0x659 0x2919 0x9acc 0x651 0x2a46 0x9a55 0x60e 0x2b72 0x99f0 0x609 0x2c9f 0x9981 0x5d9 0x2dcc 0x9909 0x5c0 0x2ef8 0x9894 0x5a7 0x3025 0x983a 0x58b 0x3151 0x97e4 0x565 0x327e 0x97ae 0x585 0x33ab 0x9762 0x530 0x34d7 0x972f 0x546 0x3604 0x96f4 0x546 0x3730 0x96bf 0x53c 0x385d 0x967b 0x4ff 0x398a 0x9653 0x51c 0x3ab6 0x9626 0x53e 0x3be3 0x95e9 0x521 0x3d10 0x95d3 0x55b 0x3e3c 0x95b1 0x54a 0x3f69 0x957f 0x55b 0x4095 0x9551 0x54a 0x41c2 0x9531 0x556 0x42ef 0x950b 0x536 0x441b 0x94ec 0x564 0x4548 0x94ce 0x57d 0x4674 0x94ae 0x591 0x47a1 0x9486 0x588 0x48ce 0x9464 0x56d 0x49fa 0x9454 0x5aa 0x4b27 0x942e 0x5aa 0x4c53 0x9410 0x5aa 0x4d80 0x93ee 0x5a0 0x4ead 0x93c0 0x56e 0x4fd9 0x93a0 0x54b 0x5106 0x9378 0x55f 0x5232 0x9350 0x564 0x535f 0x9328 0x578 0x548c 0x92fd 0x578 0x55b8 0x92d0 0x573 0x56e5 0x92b2 0x56a 0x5811 0x9293 0x591 0x593e 0x9273 0x58b 0x5a6b 0x924d 0x57e 0x5b97 0x922a 0x585 0x5cc4 0x91f4 0x565 0x5df0 0x91b8 0x56b 0x5f1d 0x9177 0x539 0x604a 0x9134 0x528 0x6176 0x9109 0x558 0x62a3 0x90b8 0x53f 0x63d0 0x9076 0x526 0x64fc 0x9060 0x529 0x6629 0x905d 0x566 0x6755 0x904e 0x571 0x6882 0x9038 0x574 0x69af 0x902d 0x5aa 0x6adb 0x8fff 0x5bf 0x6c08 0x8f87 0x5e0 0x6d34 0x8e47 0x5b1 0x6e61 0x8c6f 0x5d9 0x6f8e 0x8a0d 0x62b 0x70ba 0x86ab 0x6c3 0x71e7 0x8045 0x1451 0x7313 0x6e34 0x1665 0x7440 0x6e14 0x15f9>;
		battery0_profile_t1_col = <0x03>;
		battery0_profile_t1_num = <0x64>;
		battery0_profile_t2 = <0x00 0xa816 0x76c 0x12d 0xa780 0x834 0x259 0xa712 0x898 0x386 0xa699 0x8b1 0x4b2 0xa617 0x898 0x5df 0xa5a9 0x8b1 0x70c 0xa53b 0x8b1 0x838 0xa4c3 0x8b1 0x965 0xa45e 0x8ca 0xa91 0xa3fa 0x8ca 0xbbe 0xa38c 0x8e3 0xceb 0xa314 0x8e4 0xe17 0xa2b0 0x8fd 0xf44 0xa255 0x915 0x1070 0xa1e7 0x916 0x119d 0xa179 0x92f 0x12ca 0xa111 0x947 0x13f6 0xa0a3 0x947 0x1523 0xa03f 0x947 0x1650 0x9fdd 0x949 0x177c 0x9f98 0x964 0x18a9 0x9f5c 0x99a 0x19d5 0x9f26 0x9f6 0x1b02 0x9ebf 0x9f2 0x1c2f 0x9e2e 0x9c2 0x1d5b 0x9d73 0x9ab 0x1e88 0x9cd6 0x9af 0x1fb4 0x9c5d 0x9db 0x20e1 0x9be9 0x9c8 0x220e 0x9b9b 0x9fb 0x233a 0x9b69 0xa26 0x2467 0x9b35 0xa11 0x2593 0x9af1 0xa28 0x26c0 0x9aba 0xa26 0x27ed 0x9a56 0xa07 0x2919 0x99f0 0x9bc 0x2a46 0x9977 0x96e 0x2b72 0x9900 0x910 0x2c9f 0x9894 0x8e0 0x2dcc 0x983c 0x8cd 0x2ef8 0x97f4 0x8da 0x3025 0x979d 0x89b 0x3151 0x9762 0x8b4 0x327e 0x972c 0x8c1 0x33ab 0x96e1 0x885 0x34d7 0x96b7 0x8b1 0x3604 0x967d 0x8b7 0x3730 0x9655 0x8e6 0x385d 0x962a 0x8f4 0x398a 0x95f8 0x8c2 0x3ab6 0x95c9 0x8a9 0x3be3 0x95a9 0x8fc 0x3d10 0x957e 0x8f3 0x3e3c 0x9547 0x8d3 0x3f69 0x952a 0x905 0x4095 0x9513 0x92a 0x41c2 0x94ed 0x915 0x42ef 0x94cd 0x915 0x441b 0x94a6 0x91a 0x4548 0x9488 0x929 0x4674 0x946a 0x91e 0x47a1 0x944e 0x947 0x48ce 0x9436 0x94c 0x49fa 0x9412 0x95b 0x4b27 0x93fc 0x947 0x4c53 0x93e2 0x951 0x4d80 0x93d0 0x96a 0x4ead 0x93a6 0x933 0x4fd9 0x9398 0x951 0x5106 0x937a 0x96f 0x5232 0x9358 0x947 0x535f 0x932c 0x947 0x548c 0x9314 0x947 0x55b8 0x92eb 0x942 0x56e5 0x92c8 0x93e 0x5811 0x92ad 0x974 0x593e 0x927b 0x960 0x5a6b 0x9249 0x96b 0x5b97 0x9216 0x98c 0x5cc4 0x91e3 0x98c 0x5df0 0x91ac 0x9b0 0x5f1d 0x9166 0x980 0x604a 0x911d 0x992 0x6176 0x90d5 0x99f 0x62a3 0x90a8 0x9bd 0x63d0 0x9095 0x9cd 0x64fc 0x9094 0xa21 0x6629 0x907e 0xa38 0x6755 0x9076 0xaac 0x6882 0x9055 0xaf6 0x69af 0x9005 0xb7f 0x6adb 0x8f12 0xb66 0x6c08 0x8d5c 0xb7f 0x6d34 0x8b18 0xc24 0x6e61 0x87fe 0xd09 0x6f8e 0x82cb 0x1010 0x70ba 0x774c 0x2e95 0x71e7 0x774c 0x2e95 0x7313 0x774c 0x2e95 0x7440 0x774c 0x2e95>;
		battery0_profile_t2_col = <0x03>;
		battery0_profile_t2_num = <0x64>;
		battery0_profile_t3 = <0x00 0xa6ea 0xa0f 0x12d 0xa636 0xce4 0x259 0xa5a9 0xd2f 0x386 0xa51d 0xd93 0x4b2 0xa4af 0xdc6 0x5df 0xa44b 0xe10 0x70c 0xa3dd 0xe11 0x838 0xa378 0xe5b 0x965 0xa30a 0xe74 0xa91 0xa2a6 0xe8d 0xbbe 0xa242 0xea6 0xceb 0xa1ca 0xea7 0xe17 0xa166 0xed9 0xf44 0xa101 0xef1 0x1070 0xa093 0xef2 0x119d 0xa039 0xf0b 0x12ca 0x9fde 0xf23 0x13f6 0x9fa4 0xf2d 0x1523 0x9f82 0xfbc 0x1650 0x9f2d 0xfe6 0x177c 0x9e8b 0xfa2 0x18a9 0x9dde 0xfb5 0x19d5 0x9d10 0xf87 0x1b02 0x9c7c 0xf85 0x1c2f 0x9bfc 0xf72 0x1d5b 0x9b99 0xfa2 0x1e88 0x9b49 0xfb9 0x1fb4 0x9afc 0xfbb 0x20e1 0x9ac8 0xfd2 0x220e 0x9a82 0xfd0 0x233a 0x9a42 0xfb2 0x2467 0x99d5 0xf6c 0x2593 0x9979 0xf4e 0x26c0 0x990b 0xf00 0x27ed 0x98a0 0xea6 0x2919 0x984f 0xea3 0x2a46 0x97f7 0xe8d 0x2b72 0x97b0 0xe82 0x2c9f 0x976b 0xe31 0x2dcc 0x9732 0xe7a 0x2ef8 0x9707 0xea6 0x3025 0x96cc 0xea3 0x3151 0x969a 0xe90 0x327e 0x9667 0xea9 0x33ab 0x962d 0xec2 0x34d7 0x9605 0xedb 0x3604 0x95dc 0xeeb 0x3730 0x95ac 0xec9 0x385d 0x958a 0xf0a 0x398a 0x955b 0xf12 0x3ab6 0x953b 0xf38 0x3be3 0x9515 0xf2b 0x3d10 0x94f5 0xf59 0x3e3c 0x94cf 0xf6e 0x3f69 0x94b1 0xf77 0x4095 0x9491 0xf97 0x41c2 0x946c 0xf77 0x42ef 0x9457 0xfa5 0x441b 0x943a 0xfbe 0x4548 0x9424 0xfd2 0x4674 0x9408 0xfdb 0x47a1 0x93f4 0x100d 0x48ce 0x93dc 0x102c 0x49fa 0x93ba 0x1009 0x4b27 0x93ac 0x1018 0x4c53 0x9390 0x1009 0x4d80 0x9378 0x101d 0x4ead 0x9352 0x1018 0x4fd9 0x9334 0x100e 0x5106 0x931a 0x103b 0x5232 0x930a 0x104a 0x535f 0x92df 0x1036 0x548c 0x92b2 0x1046 0x55b8 0x928d 0x1081 0x56e5 0x9251 0x108c 0x5811 0x9215 0x10b3 0x593e 0x91db 0x10c4 0x5a6b 0x91a4 0x10fe 0x5b97 0x915b 0x1104 0x5cc4 0x910e 0x111d 0x5df0 0x90df 0x1151 0x5f1d 0x90d3 0x11ba 0x604a 0x90bf 0x1207 0x6176 0x90ad 0x12a4 0x62a3 0x909e 0x1346 0x63d0 0x9078 0x13d7 0x64fc 0x9020 0x1492 0x6629 0x8f46 0x1514 0x6755 0x8dac 0x1596 0x6882 0x8b81 0x16d4 0x69af 0x888a 0x18af 0x6adb 0x83d6 0x1d63 0x6c08 0x7b28 0x3593 0x6d34 0x7364 0x26c5 0x6e61 0x7364 0x26c5 0x6f8e 0x7364 0x26c5 0x70ba 0x7364 0x26c5 0x71e7 0x7364 0x26c5 0x7313 0x7364 0x26c5 0x7440 0x7364 0x26c5>;
		battery0_profile_t3_col = <0x03>;
		battery0_profile_t3_num = <0x64>;
		battery0_profile_t4 = <0x00 0xa62c 0xdb6 0x12d 0xa564 0x1177 0x259 0xa4a5 0x1380 0x386 0xa3bf 0x15e2 0x4b2 0xa333 0x176f 0x5df 0xa2b1 0x172b 0x70c 0xa239 0x1784 0x838 0xa1ca 0x17a9 0x965 0xa15d 0x16c8 0xa91 0xa10d 0x174b 0xbbe 0xa0bc 0x17dc 0xceb 0xa06c 0x1770 0xe17 0xa007 0x177b 0xf44 0x9f84 0x1795 0x1070 0x9ee3 0x1713 0x119d 0x9e44 0x16b5 0x12ca 0x9db9 0x15dd 0x13f6 0x9d58 0x1586 0x1523 0x9d08 0x16da 0x1650 0x9cad 0x1639 0x177c 0x9c35 0x158f 0x18a9 0x9bc7 0x14fa 0x19d5 0x9b45 0x14eb 0x1b02 0x9aeb 0x133e 0x1c2f 0x9a86 0x14ea 0x1d5b 0x9a22 0x136d 0x1e88 0x99c8 0x141c 0x1fb4 0x9979 0x13d4 0x20e1 0x9932 0x14cc 0x220e 0x98e2 0x13e7 0x233a 0x989c 0x14a0 0x2467 0x984c 0x14a3 0x2593 0x9806 0x14f9 0x26c0 0x97c2 0x14e6 0x27ed 0x9772 0x14a0 0x2919 0x972c 0x13e2 0x2a46 0x96f0 0x1432 0x2b72 0x96b4 0x140b 0x2c9f 0x9677 0x1478 0x2dcc 0x9646 0x1457 0x2ef8 0x9627 0x1345 0x3025 0x95f5 0x142c 0x3151 0x95c3 0x1529 0x327e 0x959b 0x148d 0x33ab 0x9573 0x14b2 0x34d7 0x954b 0x1449 0x3604 0x952d 0x14be 0x3730 0x94fb 0x14b5 0x385d 0x94dd 0x14ca 0x398a 0x94bf 0x1510 0x3ab6 0x94a2 0x1540 0x3be3 0x9484 0x164d 0x3d10 0x9466 0x14f2 0x3e3c 0x9452 0x162f 0x3f69 0x9434 0x155e 0x4095 0x9416 0x1556 0x41c2 0x9402 0x15f1 0x42ef 0x93ee 0x1508 0x441b 0x93cf 0x15ff 0x4548 0x93b2 0x1628 0x4674 0x939e 0x16b7 0x47a1 0x9389 0x1983 0x48ce 0x9361 0x19ae 0x49fa 0x9343 0x1a46 0x4b27 0x9325 0x19cf 0x4c53 0x92fd 0x1ab2 0x4d80 0x92d6 0x1b26 0x4ead 0x92a4 0x1afe 0x4fd9 0x927c 0x1afe 0x5106 0x924a 0x1afe 0x5232 0x9222 0x1afe 0x535f 0x91ef 0x1afe 0x548c 0x91be 0x1afe 0x55b8 0x9195 0x1afe 0x56e5 0x9163 0x1afe 0x5811 0x913b 0x1afe 0x593e 0x911d 0x1afe 0x5a6b 0x90ea 0x1afe 0x5b97 0x9099 0x1b16 0x5cc4 0x9015 0x1ee6 0x5df0 0x8f4a 0x1ee6 0x5f1d 0x8e2e 0x1ee6 0x604a 0x8c98 0x1f0b 0x6176 0x8a6f 0x238c 0x62a3 0x8711 0x238c 0x63d0 0x82d1 0x238c 0x64fc 0x8227 0x238c 0x6629 0x81d6 0x238c 0x6755 0x812c 0x238c 0x6882 0x804e 0x238c 0x69af 0x7f1f 0x238c 0x6adb 0x7d37 0x238c 0x6c08 0x79bd 0x238c 0x6d34 0x76ac 0x238c 0x6e61 0x76ac 0x238c 0x6f8e 0x76ac 0x238c 0x70ba 0x76ac 0x238c 0x71e7 0x76ac 0x238c 0x7313 0x76ac 0x238c 0x7440 0x76ac 0x238c>;
		battery0_profile_t4_col = <0x03>;
		battery0_profile_t4_num = <0x64>;
		battery0_profile_t5 = <0x00 0xa5b4 0x251c 0x12d 0xa4e2 0x16a9 0x259 0xa3fb 0x1820 0x386 0xa2e3 0x1981 0x4b2 0xa239 0x1c54 0x5df 0xa1a3 0x1d1b 0x70c 0xa12b 0x1d99 0x838 0xa0b3 0x1e45 0x965 0xa04f 0x1e16 0xa91 0xa009 0x1eab 0xbbe 0x9fc3 0x1ef7 0xceb 0x9f86 0x1f42 0xe17 0x9f2a 0x1fa4 0xf44 0x9e93 0x1fa3 0x1070 0x9dd4 0x1f8b 0x119d 0x9d0c 0x1f89 0x12ca 0x9c55 0x1f59 0x13f6 0x9bd5 0x1f5c 0x1523 0x9b67 0x1f8e 0x1650 0x9b04 0x1fb8 0x177c 0x9ab4 0x1f78 0x18a9 0x9a65 0x1fbf 0x19d5 0x9a1f 0x1fdc 0x1b02 0x99e2 0x201d 0x1c2f 0x9991 0x1fe9 0x1d5b 0x9936 0x1fa4 0x1e88 0x98d2 0x1f9e 0x1fb4 0x987a 0x1f57 0x20e1 0x9832 0x1f3e 0x220e 0x97da 0x1f27 0x233a 0x9793 0x1f25 0x2467 0x974f 0x1f18 0x2593 0x971d 0x1f74 0x26c0 0x96ea 0x1f8e 0x27ed 0x96ae 0x1f95 0x2919 0x9674 0x1f1b 0x2a46 0x964a 0x1f90 0x2b72 0x960f 0x1fc8 0x2c9f 0x95de 0x2021 0x2dcc 0x95b8 0x2024 0x2ef8 0x95a0 0x203d 0x3025 0x956e 0x2059 0x3151 0x953d 0x2082 0x327e 0x9518 0x2078 0x33ab 0x9501 0x20d3 0x34d7 0x94da 0x20e3 0x3604 0x94bb 0x20bd 0x3730 0x9493 0x20e9 0x385d 0x946d 0x20f1 0x398a 0x9459 0x2127 0x3ab6 0x9445 0x216a 0x3be3 0x942d 0x2183 0x3d10 0x940a 0x2198 0x3e3c 0x93ff 0x21a9 0x3f69 0x93e9 0x21f8 0x4095 0x93d0 0x21f0 0x41c2 0x93cb 0x2237 0x42ef 0x93ad 0x2265 0x441b 0x938e 0x2279 0x4548 0x9374 0x2287 0x4674 0x9366 0x22d7 0x47a1 0x9346 0x233b 0x48ce 0x9320 0x238c 0x49fa 0x9300 0x23a4 0x4b27 0x92d6 0x2418 0x4c53 0x92a4 0x2459 0x4d80 0x9272 0x247c 0x4ead 0x9240 0x24d1 0x4fd9 0x920a 0x254f 0x5106 0x91c8 0x25cc 0x5232 0x9191 0x265e 0x535f 0x9152 0x2730 0x548c 0x9127 0x27c1 0x55b8 0x90f7 0x2859 0x56e5 0x90d2 0x2963 0x5811 0x90b8 0x2aae 0x593e 0x90a7 0x2c0d 0x5a6b 0x9076 0x2d98 0x5b97 0x901e 0x2fc4 0x5cc4 0x8f87 0x31ec 0x5df0 0x8e58 0x33f4 0x5f1d 0x8c86 0x3669 0x604a 0x89fa 0x39dc 0x6176 0x864c 0x3f52 0x62a3 0x80b8 0x42ea 0x63d0 0x79c6 0x33dd 0x64fc 0x78e6 0x335e 0x6629 0x78e6 0x335e 0x6755 0x78e6 0x335e 0x6882 0x78e6 0x335e 0x69af 0x78e6 0x335e 0x6adb 0x78e6 0x335e 0x6c08 0x78e6 0x335e 0x6d34 0x78e6 0x335e 0x6e61 0x78e6 0x335e 0x6f8e 0x78e6 0x335e 0x70ba 0x78e6 0x335e 0x71e7 0x78e6 0x335e 0x7313 0x78e6 0x335e 0x7440 0x78e6 0x335e>;
		battery0_profile_t5_col = <0x03>;
		battery0_profile_t5_num = <0x64>;
		compatible = "mediatek,bat_gm30";
		enable_tmp_intr_suspend = <0x00>;
		g_FG_PSEUDO100_T0 = <0x64>;
		g_FG_PSEUDO100_T1 = <0x64>;
		g_FG_PSEUDO100_T2 = <0x64>;
		g_FG_PSEUDO100_T3 = <0x64>;
		g_FG_PSEUDO100_T4 = <0x64>;
		phandle = <0xaa>;
	};

	bpi_bsi_slv0@1021e000 {
		compatible = "mediatek,bpi_bsi_slv0";
		reg = <0x00 0x1021e000 0x00 0x1000>;
	};

	bpi_bsi_slv1@1021f000 {
		compatible = "mediatek,bpi_bsi_slv1";
		reg = <0x00 0x1021f000 0x00 0x6000>;
	};

	bpi_bsi_slv2@10225000 {
		compatible = "mediatek,bpi_bsi_slv2";
		reg = <0x00 0x10225000 0x00 0x1000>;
	};

	btif@1100c000 {
		clock-names = "btifc\0apdmac";
		clocks = <0x21 0x1a 0x21 0x26>;
		compatible = "mediatek,btif";
		interrupts = <0x00 0x85 0x08 0x00 0x73 0x08 0x00 0x8d 0x08>;
		reg = <0x00 0x1100c000 0x00 0x1000 0x00 0x11000b80 0x00 0x80 0x00 0x11000c00 0x00 0x80>;
	};

	bus_dbg@10208000 {
		compatible = "mediatek,bus_dbg-v2";
		interrupts = <0x00 0x9e 0x08>;
		mediatek,bus_dbg_con_offset = <0x2fc>;
		reg = <0x00 0x10208000 0x00 0x1000 0x00 0x10001000 0x00 0x1000>;
	};

	cache_parity {
		compatible = "mediatek,cache_parity";
		err_level = <0x01>;
		interrupts = <0x00 0x16 0x04 0x00 0x17 0x04 0x00 0x18 0x04 0x00 0x19 0x04 0x00 0x1a 0x04 0x00 0x1b 0x04 0x00 0x1c 0x04 0x00 0x1d 0x04 0x00 0x13 0x04>;
		irq_config = <0x00 0x8090 0xff00 0x8090 0x44 0x8090 0xff 0x01 0x8090 0xff00 0x8090 0x44 0x8090 0xff 0x02 0x8090 0xff00 0x8090 0x44 0x8090 0xff 0x03 0x8090 0xff00 0x8090 0x44 0x8090 0xff 0x04 0x8090 0xff00 0x8090 0x44 0x8090 0xff 0x05 0x8090 0xff00 0x8090 0x44 0x8090 0xff 0x06 0x8090 0xff00 0x8090 0x44 0x8090 0xff 0x07 0x8090 0xff00 0x8090 0x44 0x8090 0xff 0x400 0xc8c0 0x1000000 0xc8c0 0x0c 0xc8c8 0x01>;
		reg = <0x00 0xc530000 0x00 0x10000>;
		version = <0x01>;
	};

	cam1@1a003000 {
		compatible = "mediatek,cam1";
		interrupts = <0x00 0xfa 0x08>;
		reg = <0x00 0x1a003000 0x00 0x1000>;
	};

	cam2@1a004000 {
		compatible = "mediatek,cam2";
		interrupts = <0x00 0xfb 0x08>;
		reg = <0x00 0x1a004000 0x00 0x1000>;
	};

	cam3@1a005000 {
		compatible = "mediatek,cam3";
		interrupts = <0x00 0xfc 0x08>;
		reg = <0x00 0x1a005000 0x00 0x1000>;
	};

	cam_clear@1a01b000 {
		compatible = "mediatek,cam_clear";
		reg = <0x00 0x1a01b000 0x00 0x1000>;
	};

	cam_inner@1a013000 {
		compatible = "mediatek,cam_inner";
		reg = <0x00 0x1a013000 0x00 0x1000>;
	};

	cam_set@1a00b000 {
		compatible = "mediatek,cam_set";
		reg = <0x00 0x1a00b000 0x00 0x1000>;
	};

	cama_clear@1a01c000 {
		compatible = "mediatek,cama_clear";
		reg = <0x00 0x1a01c000 0x00 0x1000>;
	};

	cama_ext@1a024000 {
		compatible = "mediatek,cama_ext";
		reg = <0x00 0x1a024000 0x00 0x1000>;
	};

	cama_inner@1a014000 {
		compatible = "mediatek,cama_inner";
		reg = <0x00 0x1a014000 0x00 0x1000>;
	};

	cama_set@1a00c000 {
		compatible = "mediatek,cama_set";
		reg = <0x00 0x1a00c000 0x00 0x1000>;
	};

	camb_clear@1a01d000 {
		compatible = "mediatek,camb_clear";
		reg = <0x00 0x1a01d000 0x00 0x1000>;
	};

	camb_ext@1a025000 {
		compatible = "mediatek,camb_ext";
		reg = <0x00 0x1a025000 0x00 0x1000>;
	};

	camb_inner@1a015000 {
		compatible = "mediatek,camb_inner";
		reg = <0x00 0x1a015000 0x00 0x1000>;
	};

	camb_set@1a00d000 {
		compatible = "mediatek,camb_set";
		reg = <0x00 0x1a00d000 0x00 0x1000>;
	};

	camsv1@1a050000 {
		compatible = "mediatek,camsv1";
		interrupts = <0x00 0x102 0x08>;
		reg = <0x00 0x1a050000 0x00 0x1000>;
	};

	camsv2@1a051000 {
		compatible = "mediatek,camsv2";
		interrupts = <0x00 0x103 0x08>;
		reg = <0x00 0x1a051000 0x00 0x1000>;
	};

	camsv3@1a052000 {
		compatible = "mediatek,camsv3";
		interrupts = <0x00 0x100 0x08>;
		reg = <0x00 0x1a052000 0x00 0x1000>;
	};

	camsv4@1a053000 {
		compatible = "mediatek,camsv4";
		interrupts = <0x00 0x101 0x08>;
		reg = <0x00 0x1a053000 0x00 0x1000>;
	};

	camsys@1a000000 {
		#clock-cells = <0x01>;
		compatible = "mediatek,camsys\0syscon";
		phandle = <0x57>;
		reg = <0x00 0x1a000000 0x00 0x1000>;
	};

	ccu@1a0b1000 {
		clock-names = "CCU_CLK_CAM_CCU\0CAM_PWR";
		clocks = <0x57 0x08 0x22 0x0a>;
		compatible = "mediatek,ccu";
		interrupts = <0x00 0x105 0x08>;
		reg = <0x00 0x1a0b1000 0x00 0x10000>;
	};

	charger {
		ac_charger_current = <0x1f47d0>;
		ac_charger_input_current = <0x30d400>;
		algorithm_name = "DualSwitchCharging";
		apple_1_0a_charger_current = <0x9eb10>;
		apple_2_1a_charger_current = "\0\f5";
		battery_cv = <0x432380>;
		bif_cv_under_threshold2 = <0x43e6d0>;
		bif_threshold1 = <0x40d990>;
		bif_threshold2 = <0x419ce0>;
		cable_imp_threshold = <0x2bb>;
		charging_host_charger_current = <0x16e360>;
		chg1_ta_ac_charger_current = <0x19f0a0>;
		chg2_ta_ac_charger_current = <0x1b7740>;
		compatible = "mediatek,charger";
		disable_pd_dual;
		dual_polling_ieoc = <0x3d090>;
		enable_dynamic_mivr;
		enable_min_charge_temp;
		enable_pe_2;
		enable_pe_3;
		enable_pe_plus;
		enable_type_c;
		high_temp_to_enter_pe40 = <0x27>;
		high_temp_to_leave_pe40 = <0x2e>;
		ibus_err = <0x0e>;
		jeita_temp_above_t4_cv = <0x40b280>;
		jeita_temp_below_t0_cv = <0x3da540>;
		jeita_temp_t0_to_t1_cv = <0x3da540>;
		jeita_temp_t1_to_t2_cv = <0x40b280>;
		jeita_temp_t2_to_t3_cv = <0x423920>;
		jeita_temp_t3_to_t4_cv = <0x40b280>;
		low_temp_to_enter_pe40 = <0x10>;
		low_temp_to_leave_pe40 = <0x0a>;
		max_charge_temp = <0x37>;
		max_charge_temp_minus_x_degree = <0x32>;
		max_charger_voltage = <0x90f560>;
		max_dmivr_charger_current = <0x155cc0>;
		min_charge_temp = <0xfffffffb>;
		min_charge_temp_plus_x_degree = <0x00>;
		min_charger_voltage = <0x432380>;
		min_charger_voltage_1 = <0x432380>;
		min_charger_voltage_2 = <0x401640>;
		non_std_ac_charger_current = <0x7a120>;
		parallel_vbus;
		pd_ichg_level_threshold = <0xf4240>;
		pd_stop_battery_soc = <0x50>;
		pd_vbus_low_bound = <0x4c4b40>;
		pd_vbus_upper_bound = <0x4c4b40>;
		pe20_ichg_level_threshold = <0xf4240>;
		pe40_dual_charger_chg1_current = <0x1e8480>;
		pe40_dual_charger_chg2_current = <0x1e8480>;
		pe40_dual_charger_input_current = <0x2dc6c0>;
		pe40_r_cable_1a_lower = <0x206>;
		pe40_r_cable_2a_lower = <0x17f>;
		pe40_r_cable_3a_lower = <0xf5>;
		pe40_single_charger_current = <0x2dc6c0>;
		pe40_single_charger_input_current = <0x2dc6c0>;
		pe40_stop_battery_soc = <0x50>;
		pe_ichg_level_threshold = <0xf4240>;
		phandle = <0xd5>;
		power_path_support;
		slave_mivr_diff = <0x186a0>;
		ta_9v_support;
		ta_ac_7v_input_current = <0x30d400>;
		ta_ac_9v_input_current = <0x30d400>;
		ta_ac_charger_current = <0x2dc6c0>;
		ta_start_battery_soc = <0x00>;
		ta_stop_battery_soc = <0x55>;
		temp_neg_10_thres = <0x00>;
		temp_t0_thres = <0x00>;
		temp_t0_thres_plus_x_degree = <0x00>;
		temp_t1_thres = <0x00>;
		temp_t1_thres_plus_x_degree = <0x06>;
		temp_t2_thres = <0x0a>;
		temp_t2_thres_plus_x_degree = <0x10>;
		temp_t3_thres = <0x2d>;
		temp_t3_thres_minus_x_degree = <0x27>;
		temp_t4_thres = <0x32>;
		temp_t4_thres_minus_x_degree = <0x2f>;
		usb_charger_current = <0x7a120>;
		usb_charger_current_configured = <0x7a120>;
		usb_charger_current_suspend = <0x00>;
		usb_charger_current_unconfigured = <0x11170>;
		vbat_cable_imp_threshold = <0x3b8260>;
		vsys_watt = <0x4c4b40>;
	};

	chipid@08000000 {
		compatible = "mediatek,chipid";
		reg = <0x00 0x8000000 0x00 0x04 0x00 0x8000004 0x00 0x04 0x00 0x8000008 0x00 0x04 0x00 0x800000c 0x00 0x04>;
	};

	chn_emi@1021a000 {
		compatible = "mediatek,chn_emi";
		reg = <0x00 0x1021a000 0x00 0x1000>;
	};

	chosen {
		bootargs = "console=tty0 console=ttyS0,921600n1 root=/dev/ram vmalloc=400M slub_debug=OFZPU swiotlb=noforce cgroup.memory=nosocket,nokmem firmware_class.path=/vendor/firmware page_owner=on loop.max_part=7";
		kaslr-seed = <0x00 0x00>;
		phandle = <0x63>;
	};

	clocks {

		clk26m {
			#clock-cells = <0x00>;
			clock-frequency = <0x18cba80>;
			compatible = "fixed-clock";
			phandle = <0x13>;
		};

		clk32k {
			#clock-cells = <0x00>;
			clock-frequency = <0x7d00>;
			compatible = "fixed-clock";
			phandle = <0x1f>;
		};
	};

	consys@18002000 {
		#address-cells = <0x02>;
		#size-cells = <0x02>;
		clock-names = "conn";
		clocks = <0x22 0x01>;
		compatible = "mediatek,mt6768-consys";
		interrupts = <0x00 0x11c 0x08 0x00 0x4e 0x08 0x00 0x11f 0x01>;
		phandle = <0xbf>;
		reg = <0x00 0x18002000 0x00 0x1000 0x00 0x10007000 0x00 0x100 0x00 0x10001000 0x00 0x1000 0x00 0x10006000 0x00 0x1000 0x00 0x18007000 0x00 0x1000 0x00 0x180b1000 0x00 0x1000 0x00 0x180a3000 0x00 0x1000 0x00 0x180a5000 0x00 0x800 0x00 0x180c1000 0x00 0x1000 0x00 0x18004000 0x00 0x1000>;
		wifi_ant_swap_gpio = <0x1e 0x6c 0x00>;
	};

	cpu_dbgapb@0e010000 {
		compatible = "mediatek,hw_dbg";
		num = <0x08>;
		phandle = <0x67>;
		reg = <0x00 0xe010000 0x00 0x1000 0x00 0xe110000 0x00 0x1000 0x00 0xe210000 0x00 0x1000 0x00 0xe310000 0x00 0x1000 0x00 0xe410000 0x00 0x1000 0x00 0xe510000 0x00 0x1000 0x00 0xe610000 0x00 0x1000 0x00 0xe710000 0x00 0x1000>;
	};

	cpus {
		#address-cells = <0x01>;
		#size-cells = <0x00>;

		cpu-map {

			cluster0 {

				core0 {
					cpu = <0x09>;
				};

				core1 {
					cpu = <0x0a>;
				};

				core2 {
					cpu = <0x0b>;
				};

				core3 {
					cpu = <0x0c>;
				};

				core4 {
					cpu = <0x0d>;
				};

				core5 {
					cpu = <0x0e>;
				};

				doe {
					phandle = <0x64>;
				};
			};

			cluster1 {

				core0 {
					cpu = <0x0f>;
				};

				core1 {
					cpu = <0x10>;
				};

				doe {
					phandle = <0x65>;
				};
			};
		};

		cpu@000 {
			clock-frequency = <0x65633340>;
			compatible = "arm,cortex-a55";
			cpu-idle-states = <0x02 0x03 0x04 0x05 0x06 0x07 0x08>;
			device_type = "cpu";
			enable-method = "psci";
			phandle = <0x09>;
			reg = <0x00>;
		};

		cpu@001 {
			clock-frequency = <0x65633340>;
			compatible = "arm,cortex-a55";
			cpu-idle-states = <0x02 0x03 0x04 0x05 0x06 0x07 0x08>;
			device_type = "cpu";
			enable-method = "psci";
			phandle = <0x0a>;
			reg = <0x100>;
		};

		cpu@002 {
			clock-frequency = <0x65633340>;
			compatible = "arm,cortex-a55";
			cpu-idle-states = <0x02 0x03 0x04 0x05 0x06 0x07 0x08>;
			device_type = "cpu";
			enable-method = "psci";
			phandle = <0x0b>;
			reg = <0x200>;
		};

		cpu@003 {
			clock-frequency = <0x65633340>;
			compatible = "arm,cortex-a55";
			cpu-idle-states = <0x02 0x03 0x04 0x05 0x06 0x07 0x08>;
			device_type = "cpu";
			enable-method = "psci";
			phandle = <0x0c>;
			reg = <0x300>;
		};

		cpu@100 {
			clock-frequency = <0x65633340>;
			compatible = "arm,cortex-a55";
			cpu-idle-states = <0x02 0x03 0x04 0x05 0x06 0x07 0x08>;
			device_type = "cpu";
			enable-method = "psci";
			phandle = <0x0d>;
			reg = <0x400>;
		};

		cpu@101 {
			clock-frequency = <0x65633340>;
			compatible = "arm,cortex-a55";
			cpu-idle-states = <0x02 0x03 0x04 0x05 0x06 0x07 0x08>;
			device_type = "cpu";
			enable-method = "psci";
			phandle = <0x0e>;
			reg = <0x500>;
		};

		cpu@102 {
			clock-frequency = <0x8166d4c0>;
			compatible = "arm,cortex-a75";
			cpu-idle-states = <0x02 0x03 0x04 0x05 0x06 0x07 0x08>;
			device_type = "cpu";
			enable-method = "psci";
			phandle = <0x0f>;
			reg = <0x600>;
		};

		cpu@103 {
			clock-frequency = <0x8166d4c0>;
			compatible = "arm,cortex-a75";
			cpu-idle-states = <0x02 0x03 0x04 0x05 0x06 0x07 0x08>;
			device_type = "cpu";
			enable-method = "psci";
			phandle = <0x10>;
			reg = <0x700>;
		};

		idle-states {
			entry-method = "arm,psci";

			idlebus26m {
				arm,psci-suspend-param = <0x1010004>;
				compatible = "arm,idle-state";
				entry-latency-us = <0x320>;
				exit-latency-us = <0x3e8>;
				min-residency-us = <0x7d0>;
				phandle = <0x07>;
				status = "okay";
			};

			idledram {
				arm,psci-suspend-param = <0x1010002>;
				compatible = "arm,idle-state";
				entry-latency-us = <0x320>;
				exit-latency-us = <0x3e8>;
				min-residency-us = <0x7d0>;
				phandle = <0x05>;
				status = "okay";
			};

			idlesyspll {
				arm,psci-suspend-param = <0x1010003>;
				compatible = "arm,idle-state";
				entry-latency-us = <0x320>;
				exit-latency-us = <0x3e8>;
				min-residency-us = <0x7d0>;
				phandle = <0x06>;
				status = "okay";
			};

			mcdi-cluster {
				arm,psci-suspend-param = <0x1010001>;
				compatible = "arm,idle-state";
				entry-latency-us = <0x258>;
				exit-latency-us = <0x258>;
				min-residency-us = <0x4b0>;
				phandle = <0x04>;
			};

			mcdi-cpu {
				arm,psci-suspend-param = <0x10001>;
				compatible = "arm,idle-state";
				entry-latency-us = <0x258>;
				exit-latency-us = <0x258>;
				min-residency-us = <0x4b0>;
				phandle = <0x03>;
			};

			standby {
				arm,psci-suspend-param = <0x01>;
				compatible = "arm,idle-state";
				entry-latency-us = <0x258>;
				exit-latency-us = <0x258>;
				min-residency-us = <0x4b0>;
				phandle = <0x02>;
			};

			suspend {
				arm,psci-suspend-param = <0x1010005>;
				compatible = "arm,idle-state";
				entry-latency-us = <0x320>;
				exit-latency-us = <0x3e8>;
				min-residency-us = <0x7d0>;
				phandle = <0x08>;
			};
		};
	};

	cq_dma@10212000 {
		clock-names = "cqdma";
		clocks = <0x21 0x43>;
		compatible = "mediatek,mt-cqdma-v1";
		interrupts = <0x00 0x86 0x08 0x00 0x87 0x08 0x00 0x88 0x08>;
		nr_channel = <0x03>;
		reg = <0x00 0x10212000 0x00 0x80 0x00 0x10212080 0x00 0x80 0x00 0x10212100 0x00 0x80>;
	};

	dbg_apmcu_mp0@0d400000 {
		compatible = "mediatek,dbg_apmcu_mp0";
		reg = <0x00 0xd400000 0x00 0x1000>;
	};

	dbg_apmcu_mp0@0d410000 {
		compatible = "mediatek,dbg_apmcu_mp0";
		reg = <0x00 0xd410000 0x00 0x1000>;
	};

	dbg_apmcu_mp0@0d420000 {
		compatible = "mediatek,dbg_apmcu_mp0";
		reg = <0x00 0xd420000 0x00 0x1000>;
	};

	dbg_apmcu_mp0@0d430000 {
		compatible = "mediatek,dbg_apmcu_mp0";
		reg = <0x00 0xd430000 0x00 0x1000>;
	};

	dbg_apmcu_mp0@0d440000 {
		compatible = "mediatek,dbg_apmcu_mp0";
		reg = <0x00 0xd440000 0x00 0x1000>;
	};

	dbg_apmcu_mp0@0d510000 {
		compatible = "mediatek,dbg_apmcu_mp0";
		reg = <0x00 0xd510000 0x00 0x1000>;
	};

	dbg_apmcu_mp0@0d520000 {
		compatible = "mediatek,dbg_apmcu_mp0";
		reg = <0x00 0xd520000 0x00 0x1000>;
	};

	dbg_apmcu_mp0@0d530000 {
		compatible = "mediatek,dbg_apmcu_mp0";
		reg = <0x00 0xd530000 0x00 0x1000>;
	};

	dbg_apmcu_mp0@0d540000 {
		compatible = "mediatek,dbg_apmcu_mp0";
		reg = <0x00 0xd540000 0x00 0x1000>;
	};

	dbg_apmcu_mp0@0d610000 {
		compatible = "mediatek,dbg_apmcu_mp0";
		reg = <0x00 0xd610000 0x00 0x1000>;
	};

	dbg_apmcu_mp0@0d620000 {
		compatible = "mediatek,dbg_apmcu_mp0";
		reg = <0x00 0xd620000 0x00 0x1000>;
	};

	dbg_apmcu_mp0@0d630000 {
		compatible = "mediatek,dbg_apmcu_mp0";
		reg = <0x00 0xd630000 0x00 0x1000>;
	};

	dbg_apmcu_mp0@0d640000 {
		compatible = "mediatek,dbg_apmcu_mp0";
		reg = <0x00 0xd640000 0x00 0x1000>;
	};

	dbg_apmcu_mp0@0d710000 {
		compatible = "mediatek,dbg_apmcu_mp0";
		reg = <0x00 0xd710000 0x00 0x1000>;
	};

	dbg_apmcu_mp0@0d720000 {
		compatible = "mediatek,dbg_apmcu_mp0";
		reg = <0x00 0xd720000 0x00 0x1000>;
	};

	dbg_apmcu_mp0@0d730000 {
		compatible = "mediatek,dbg_apmcu_mp0";
		reg = <0x00 0xd730000 0x00 0x1000>;
	};

	dbg_apmcu_mp0@0d740000 {
		compatible = "mediatek,dbg_apmcu_mp0";
		reg = <0x00 0xd740000 0x00 0x1000>;
	};

	dbg_apmcu_mp1@0d800000 {
		compatible = "mediatek,dbg_apmcu_mp1";
		reg = <0x00 0xd800000 0x00 0x1000>;
	};

	dbg_apmcu_mp1@0d810000 {
		compatible = "mediatek,dbg_apmcu_mp1";
		reg = <0x00 0xd810000 0x00 0x1000>;
	};

	dbg_apmcu_mp1@0d820000 {
		compatible = "mediatek,dbg_apmcu_mp1";
		reg = <0x00 0xd820000 0x00 0x1000>;
	};

	dbg_apmcu_mp1@0d830000 {
		compatible = "mediatek,dbg_apmcu_mp1";
		reg = <0x00 0xd830000 0x00 0x1000>;
	};

	dbg_apmcu_mp1@0d840000 {
		compatible = "mediatek,dbg_apmcu_mp1";
		reg = <0x00 0xd840000 0x00 0x1000>;
	};

	dbg_apmcu_mp1@0d910000 {
		compatible = "mediatek,dbg_apmcu_mp1";
		reg = <0x00 0xd910000 0x00 0x1000>;
	};

	dbg_apmcu_mp1@0d920000 {
		compatible = "mediatek,dbg_apmcu_mp1";
		reg = <0x00 0xd920000 0x00 0x1000>;
	};

	dbg_apmcu_mp1@0d930000 {
		compatible = "mediatek,dbg_apmcu_mp1";
		reg = <0x00 0xd930000 0x00 0x1000>;
	};

	dbg_apmcu_mp1@0d940000 {
		compatible = "mediatek,dbg_apmcu_mp1";
		reg = <0x00 0xd940000 0x00 0x1000>;
	};

	dbg_apmcu_mp1@0da10000 {
		compatible = "mediatek,dbg_apmcu_mp1";
		reg = <0x00 0xda10000 0x00 0x1000>;
	};

	dbg_apmcu_mp1@0da20000 {
		compatible = "mediatek,dbg_apmcu_mp1";
		reg = <0x00 0xda20000 0x00 0x1000>;
	};

	dbg_apmcu_mp1@0da30000 {
		compatible = "mediatek,dbg_apmcu_mp1";
		reg = <0x00 0xda30000 0x00 0x1000>;
	};

	dbg_apmcu_mp1@0da40000 {
		compatible = "mediatek,dbg_apmcu_mp1";
		reg = <0x00 0xda40000 0x00 0x1000>;
	};

	dbg_apmcu_mp1@0db10000 {
		compatible = "mediatek,dbg_apmcu_mp1";
		reg = <0x00 0xdb10000 0x00 0x1000>;
	};

	dbg_apmcu_mp1@0db20000 {
		compatible = "mediatek,dbg_apmcu_mp1";
		reg = <0x00 0xdb20000 0x00 0x1000>;
	};

	dbg_apmcu_mp1@0db30000 {
		compatible = "mediatek,dbg_apmcu_mp1";
		reg = <0x00 0xdb30000 0x00 0x1000>;
	};

	dbg_apmcu_mp1@0db40000 {
		compatible = "mediatek,dbg_apmcu_mp1";
		reg = <0x00 0xdb40000 0x00 0x1000>;
	};

	dbg_cti@0d020000 {
		compatible = "mediatek,dbg_cti";
		reg = <0x00 0xd020000 0x00 0x10000>;
	};

	dbg_dem@0d0a0000 {
		compatible = "mediatek,dbg_dem";
		interrupts = <0x00 0x9d 0x08>;
		reg = <0x00 0xd0a0000 0x00 0x10000>;
	};

	dbg_etr@0d030000 {
		compatible = "mediatek,dbg_etr";
		reg = <0x00 0xd030000 0x00 0x10000>;
	};

	dbg_funnel@0d040000 {
		compatible = "mediatek,dbg_funnel";
		reg = <0x00 0xd040000 0x00 0x10000>;
	};

	dbg_mdsys1@0d0c0000 {
		compatible = "mediatek,dbg_mdsys1";
		reg = <0x00 0xd0c0000 0x00 0x40000>;
	};

	dcm {
		compatible = "mediatek,dcm";
		phandle = <0x6e>;
	};

	ddrphy@10015000 {
		compatible = "mediatek,ddrphy";
		reg = <0x00 0x10015000 0x00 0x1000>;
	};

	devapc@10207000 {
		clock-names = "devapc-infra-clock";
		clocks = <0x21 0x28>;
		compatible = "mediatek,mt6768-devapc";
		interrupts = <0x00 0x9f 0x08>;
		reg = <0x00 0x10207000 0x00 0x1000 0x00 0x1000e000 0x00 0x1000>;
	};

	dfd@10200b00 {
		compatible = "mediatek,dfd";
		mediatek,chain_length = <0xa7f8>;
		mediatek,enabled = <0x01>;
		mediatek,rg_dfd_timeout = <0xa0>;
		reg = <0x00 0x10200b00 0x00 0x10000>;
	};

	dfd_cache {
		compatible = "mediatek,dfd_cache";
		mediatek,enabled = <0x00>;
		mediatek,rg_dfd_timeout = <0x3e80>;
		phandle = <0xab>;
	};

	dip1@15022000 {
		compatible = "mediatek,dip1";
		interrupts = <0x00 0x10e 0x08>;
		reg = <0x00 0x15022000 0x00 0x3000>;
	};

	disp_aal0@14011000 {
		compatible = "mediatek,disp_aal0";
		interrupts = <0x00 0xeb 0x08>;
		reg = <0x00 0x14011000 0x00 0x1000>;
	};

	disp_ccorr0@14010000 {
		compatible = "mediatek,disp_ccorr0";
		interrupts = <0x00 0xea 0x08>;
		reg = <0x00 0x14010000 0x00 0x1000>;
	};

	disp_color0@1400f000 {
		clock-names = "MDP_COLOR";
		clocks = <0x24 0x0c>;
		compatible = "mediatek,disp_color0";
		interrupts = <0x00 0xe9 0x08>;
		phandle = <0x2b>;
		reg = <0x00 0x1400f000 0x00 0x1000>;
	};

	disp_dither0@14013000 {
		compatible = "mediatek,disp_dither0";
		interrupts = <0x00 0xed 0x08>;
		reg = <0x00 0x14013000 0x00 0x1000>;
	};

	disp_gamma0@14012000 {
		compatible = "mediatek,disp_gamma0";
		interrupts = <0x00 0xec 0x08>;
		reg = <0x00 0x14012000 0x00 0x1000>;
	};

	disp_mutex0@14001000 {
		compatible = "mediatek,disp_mutex0";
		interrupts = <0x00 0xdf 0x08>;
		phandle = <0x2d>;
		reg = <0x00 0x14001000 0x00 0x1000>;
	};

	disp_ovl0@1400b000 {
		compatible = "mediatek,disp_ovl0";
		interrupts = <0x00 0xe6 0x08>;
		reg = <0x00 0x1400b000 0x00 0x1000>;
	};

	disp_ovl0_2l@1400c000 {
		compatible = "mediatek,disp_ovl0_2l";
		interrupts = <0x00 0xf2 0x08>;
		reg = <0x00 0x1400c000 0x00 0x1000>;
	};

	disp_pwm@1100e000 {
		compatible = "mediatek,disp_pwm";
		reg = <0x00 0x1100e000 0x00 0x1000>;
	};

	disp_rdma0@1400d000 {
		compatible = "mediatek,disp_rdma0";
		interrupts = <0x00 0xe7 0x08>;
		reg = <0x00 0x1400d000 0x00 0x1000>;
	};

	disp_rsz0@14015000 {
		compatible = "mediatek,disp_rsz0";
		interrupts = <0x00 0x125 0x08>;
		reg = <0x00 0x14015000 0x00 0x1000>;
	};

	disp_wdma0@1400e000 {
		compatible = "mediatek,disp_wdma0";
		interrupts = <0x00 0xe8 0x08>;
		reg = <0x00 0x1400e000 0x00 0x1000>;
	};

	dispsys {
		clock-names = "MMSYS_MTCMOS\0MMSYS_SMI_COMMON\0MMSYS_SMI_LARB0\0MMSYS_GALS_COMM0\0MMSYS_GALS_COMM1\0MMSYS_DISP_OVL0\0MMSYS_DISP_OVL0_2L\0MMSYS_DISP_RDMA0\0MMSYS_DISP_WDMA0\0MMSYS_DISP_COLOR0\0MMSYS_DISP_CCORR0\0MMSYS_DISP_AAL0\0MMSYS_DISP_GAMMA0\0MMSYS_DISP_DITHER0\0MMSYS_DSI0_MM_CK\0MMSYS_DSI0_IF_CK\0MMSYS_IMG_DL_RELAY\0MMSYS_26M\0MMSYS_DISP_RSZ0\0APMIXED_MIPI_26M\0TOP_MUX_DISP_PWM\0DISP_PWM\0TOP_26M\0TOP_UNIVPLL2_D4\0TOP_ULPOSC1_D2\0TOP_ULPOSC1_D8";
		clocks = <0x22 0x03 0x24 0x13 0x24 0x14 0x24 0x15 0x24 0x16 0x24 0x07 0x24 0x08 0x24 0x0a 0x24 0x0b 0x24 0x0c 0x24 0x0d 0x24 0x0e 0x24 0x0f 0x24 0x10 0x24 0x11 0x24 0x1e 0x24 0x1c 0x24 0x1f 0x24 0x09 0x3c 0x15 0x12 0x63 0x21 0x31 0x13 0x12 0x1b 0x12 0x2e 0x12 0x30>;
		compatible = "mediatek,dispsys";
		mediatek,larb = <0x55>;
	};

	dma-controller@11000980 {
		#dma-cells = <0x01>;
		clock-names = "apdma";
		clocks = <0x21 0x26>;
		compatible = "mediatek,mt6577-uart-dma";
		dma-bits = <0x22>;
		interrupts = <0x00 0x66 0x08 0x00 0x67 0x08 0x00 0x68 0x08 0x00 0x72 0x08>;
		phandle = <0x2f>;
		reg = <0x00 0x11000980 0x00 0x80 0x00 0x11000a00 0x00 0x80 0x00 0x11000a80 0x00 0x80 0x00 0x11000b00 0x00 0x80>;
	};

	dpe@15028000 {
		clock-names = "DPE_CG_IMG_DPE";
		clocks = <0x56 0x03>;
		compatible = "mediatek,dpe";
		interrupts = <0x00 0x10f 0x08>;
		reg = <0x00 0x15028000 0x00 0x1000>;
	};

	dramc@1022a000 {
		compatible = "mediatek,dramc";
		reg = <0x00 0x1022a000 0x00 0x2000 0x00 0x10232000 0x00 0x2000 0x00 0x1022c000 0x00 0x1000 0x00 0x10234000 0x00 0x1000 0x00 0x10228000 0x00 0x2000 0x00 0x10230000 0x00 0x2000 0x00 0x1022e000 0x00 0x1000 0x00 0x10236000 0x00 0x1000>;
	};

	drcc {
		compatible = "mediatek,drcc";
		drcc0_Code = <0xff>;
		drcc0_Hwgatepct = <0xff>;
		drcc0_Vref = <0xff>;
		drcc1_Code = <0xff>;
		drcc1_Hwgatepct = <0xff>;
		drcc1_Vref = <0xff>;
		drcc2_Code = <0xff>;
		drcc2_Hwgatepct = <0xff>;
		drcc2_Vref = <0xff>;
		drcc3_Code = <0xff>;
		drcc3_Hwgatepct = <0xff>;
		drcc3_Vref = <0xff>;
		drcc4_Code = <0xff>;
		drcc4_Hwgatepct = <0xff>;
		drcc4_Vref = <0xff>;
		drcc5_Code = <0xff>;
		drcc5_Hwgatepct = <0xff>;
		drcc5_Vref = <0xff>;
		drcc6_Code = <0xff>;
		drcc6_Hwgatepct = <0xff>;
		drcc6_Vref = <0xff>;
		drcc7_Code = <0xff>;
		drcc7_Hwgatepct = <0xff>;
		drcc7_Vref = <0xff>;
		phandle = <0xbe>;
		state = <0xff>;
	};

	dsi0@14014000 {
		compatible = "mediatek,dsi0";
		interrupts = <0x00 0xee 0x08>;
		reg = <0x00 0x14014000 0x00 0x1000>;
	};

	dsi_te {
		compatible = "mediatek, dsi_te-eint";
		phandle = <0xc9>;
		status = "disabled";
	};

	dsu-pmu-0 {
		compatible = "arm,dsu-pmu";
		cpus = <0x09 0x0a 0x0b 0x0c 0x0d 0x0e 0x0f 0x10>;
		interrupts = <0x00 0x12 0x04>;
	};

	dvfsp@00110800 {
		B-table = <0x7d0 0x48 0x01 0x01 0x79e 0x45 0x01 0x01 0x76c 0x41 0x01 0x01 0x73a 0x3d 0x01 0x01 0x708 0x3a 0x01 0x01 0x6ae 0x36 0x01 0x01 0x655 0x32 0x01 0x01 0x60c 0x30 0x02 0x01 0x5a3 0x2b 0x02 0x01 0x54a 0x27 0x02 0x01 0x4f1 0x24 0x02 0x01 0x498 0x20 0x02 0x01 0x43f 0x1d 0x02 0x01 0x3e6 0x19 0x02 0x01 0x38d 0x16 0x02 0x01 0x352 0x13 0x02 0x01>;
		CCI-table = <0x4a3 0x38 0x02 0x01 0x460 0x34 0x02 0x01 0x419 0x30 0x02 0x01 0x3f6 0x2e 0x02 0x01 0x3c1 0x2b 0x02 0x01 0x38d 0x28 0x02 0x01 0x358 0x24 0x02 0x01 0x335 0x22 0x02 0x01 0x300 0x1f 0x02 0x01 0x2dd 0x1d 0x04 0x01 0x2ba 0x1b 0x04 0x01 0x297 0x19 0x04 0x01 0x274 0x17 0x04 0x01 0x251 0x15 0x04 0x01 0x3a 0x13 0x04 0x01 0x1f4 0x10 0x04 0x01>;
		L-table = <0x6a4 0x38 0x02 0x01 0x659 0x35 0x02 0x01 0x5dc 0x30 0x02 0x01 0x5aa 0x2e 0x02 0x01 0x55f 0x2b 0x02 0x01 0x52d 0x29 0x02 0x01 0x4fb 0x27 0x02 0x01 0x497 0x22 0x02 0x01 0x44c 0x29 0x02 0x01 0x41a 0x1d 0x02 0x01 0x3e7 0x1b 0x02 0x01 0x3b6 0x19 0x02 0x01 0x384 0x17 0x02 0x01 0x352 0x15 0x04 0x01 0x306 0x13 0x04 0x01 0x1f4 0x10 0x04 0x01>;
		big-down-time = <0x2ee>;
		big-rise-time = <0x3e8>;
		change_flag = <0x00>;
		compatible = "mediatek,mt6768-dvfsp";
		little-down-time = <0x2ee>;
		little-rise-time = <0x3e8>;
		phandle = <0xa4>;
		reg = <0x00 0x110800 0x00 0x1400 0x00 0x110800 0x00 0x1400>;
		state = <0x01>;
	};

	dvfsp@10227000 {
		compatible = "mediatek,dvfsp";
		reg = <0x00 0x10227000 0x00 0x1000>;
	};

	dvfsrc@10012000 {
		compatible = "mediatek,dvfsrc";
		phandle = <0x9f>;
		reg = <0x00 0x10012000 0x00 0x1000 0x00 0x110780 0x00 0x80>;
	};

	dxcc_sec@10210000 {
		compatible = "mediatek,dxcc_sec";
		interrupts = <0x00 0xb1 0x04>;
		reg = <0x00 0x10210000 0x00 0x1000>;
	};

	eem_fsm@1100b000 {
		compatible = "mediatek,eem_fsm";
		eem-clamp-big = <0x00>;
		eem-clamp-cci = <0x00>;
		eem-clamp-gpu = <0x00>;
		eem-clamp-little = <0x00>;
		eem-initmon-big = <0x0f>;
		eem-initmon-cci = <0x0f>;
		eem-initmon-gpu = <0x0f>;
		eem-initmon-little = <0x0f>;
		eem-offset-big = <0xff>;
		eem-offset-cci = <0xff>;
		eem-offset-gpu = <0xff>;
		eem-offset-little = <0xff>;
		eem-status = <0x01>;
		interrupts = <0x00 0x8e 0x08>;
		phandle = <0xbb>;
		reg = <0x00 0x1100b000 0x00 0x1000>;
	};

	efuse_dbg@10004000 {
		compatible = "mediatek,efuse_dbg";
		reg = <0x00 0x10004000 0x00 0x1000>;
	};

	efusec@11ce0000 {
		compatible = "mediatek,efusec";
		reg = <0x00 0x11ce0000 0x00 0x10000>;
	};

	emi@10219000 {
		compatible = "mediatek,emi";
		interrupts = <0x00 0xa1 0x08>;
		reg = <0x00 0x10219000 0x00 0x1000 0x00 0x10226000 0x00 0x1000 0x00 0x1022d000 0x00 0x1000 0x00 0x10235000 0x00 0x1000 0x00 0x1020e000 0x00 0x1000>;
	};

	emi_mpu@10226000 {
		compatible = "mediatek,emi_mpu";
		reg = <0x00 0x10226000 0x00 0x1000>;
	};

	fdvt@1502b000 {
		clock-names = "FD_CLK_IMG_FDVT";
		clocks = <0x56 0x02>;
		compatible = "mediatek,fdvt";
		interrupts = <0x00 0x111 0x08>;
		reg = <0x00 0x1502b000 0x00 0x1000>;
	};

	fhctl@1000ce00 {
		compatible = "mediatek,fhctl";
		reg = <0x00 0x1000ce00 0x00 0x200>;
	};

	fingerprint {
		compatible = "mediatek,goodix-fp";
		phandle = <0xa7>;
	};

	flashlight_core {
		compatible = "mediatek,flashlight_core";
		phandle = <0xcd>;
	};

	flashlights_aw36518 {
		compatible = "mediatek,flashlights_aw36518";
		decouple = <0x01>;
		phandle = <0xcf>;

		channel@1 {
			ct = <0x00>;
			part = <0x00>;
			type = <0x00>;
		};

		channel@2 {
			ct = <0x01>;
			part = <0x00>;
			type = <0x00>;
		};
	};

	flashlights_mt6370 {
		compatible = "mediatek,flashlights_mt6370";
		decouple = <0x00>;
		phandle = <0xce>;

		channel@1 {
			ct = <0x00>;
			part = <0x00>;
			type = <0x00>;
		};

		channel@2 {
			ct = <0x01>;
			part = <0x00>;
			type = <0x00>;
		};
	};

	fpc {
		compatible = "mediatek,mt6765-fpc";
		phandle = <0xa8>;
	};

	gauge_timer {
		compatible = "mediatek,gauge_timer_service";
	};

	gce@10238000 {
		#clock-cells = <0x01>;
		ap_dma_base = <0x18010000 0x17 0xffff0000>;
		audio_base = <0x17000000 0x12 0xffff0000>;
		buf_underrun_event_0 = <0x8c>;
		camsv_0_pass1_done = <0x143>;
		camsv_1_pass1_done = <0x144>;
		camsv_2_pass1_done = <0x145>;
		camsys1_base = <0x180a0000 0x1c 0xffff0000>;
		camsys2_base = <0x180b0000 0x1d 0xffff0000>;
		camsys_base = <0x18080000 0x1b 0xffff0000>;
		clock-names = "GCE\0GCE_TIMER\0MMSYS_MTCMOS";
		clocks = <0x21 0x09 0x21 0x18 0x22 0x03>;
		compatible = "mediatek,gce\0syscon";
		conn_peri_base = <0x18820000 0x07 0xffff0000>;
		dip_cq_thread0_frame_done = <0x101>;
		dip_cq_thread10_frame_done = <0x10b>;
		dip_cq_thread11_frame_done = <0x10c>;
		dip_cq_thread12_frame_done = <0x10d>;
		dip_cq_thread13_frame_done = <0x10e>;
		dip_cq_thread14_frame_done = <0x10f>;
		dip_cq_thread15_frame_done = <0x110>;
		dip_cq_thread16_frame_done = <0x111>;
		dip_cq_thread17_frame_done = <0x112>;
		dip_cq_thread18_frame_done = <0x113>;
		dip_cq_thread1_frame_done = <0x102>;
		dip_cq_thread2_frame_done = <0x103>;
		dip_cq_thread3_frame_done = <0x104>;
		dip_cq_thread4_frame_done = <0x105>;
		dip_cq_thread5_frame_done = <0x106>;
		dip_cq_thread6_frame_done = <0x107>;
		dip_cq_thread7_frame_done = <0x108>;
		dip_cq_thread8_frame_done = <0x109>;
		dip_cq_thread9_frame_done = <0x10a>;
		disp_2l_ovl0_frame_done = <0x1c>;
		disp_2l_ovl0_sof = <0x08>;
		disp_aal0_frame_done = <0x22>;
		disp_aal0_sof = <0x0d>;
		disp_ccorr0_frame_done = <0x21>;
		disp_ccorr0_sof = <0x0c>;
		disp_color0_frame_done = <0x20>;
		disp_color0_sof = <0x0b>;
		disp_dither0_frame_done = <0x24>;
		disp_dither0_sof = <0x0f>;
		disp_dither_base = <0x14010000 0x02 0xffff0000>;
		disp_dsi0_frame_done = <0x25>;
		disp_dsi0_sof = <0x10>;
		disp_gamma0_frame_done = <0x23>;
		disp_gamma0_sof = <0x0e>;
		disp_mutex_reg = <0x14016000 0x1000>;
		disp_ovl0_frame_done = <0x1b>;
		disp_ovl0_frame_rst_done_pusle = <0x98>;
		disp_ovl0_sof = <0x07>;
		disp_pwm0_sof = <0x13>;
		disp_rdma0_frame_done = <0x1e>;
		disp_rdma0_sof = <0x09>;
		disp_rsz0_frame_done = <0x1d>;
		disp_rsz0_sof = <0x11>;
		disp_wdma0_frame_done = <0x1f>;
		disp_wdma0_rst_done = <0x93>;
		disp_wdma0_sof = <0x0a>;
		dsi0_done_event = <0x8f>;
		dsi0_irq_event = <0x8e>;
		dsi0_te_event = <0x8d>;
		dsi0_te_from_infra = <0x382>;
		dve_frame_done = <0x114>;
		g3d_config_base = <0x13000000 0x00 0xffff0000>;
		gce_base = <0x18020000 0x18 0xffff0000>;
		gcpu_base = <0x10050000 0x0f 0xffff0000>;
		img_dl_relay_sof = <0x12>;
		imgsys_base = <0x15020000 0x04 0xffff0000>;
		infra_na3_base = <0x10010000 0x0b 0xffff0000>;
		infra_na4_base = <0x10020000 0x0c 0xffff0000>;
		interrupts = <0x00 0xaa 0x08>;
		isp_frame_done_b = <0x142>;
		jpgenc_done = <0x123>;
		kp_base = <0x18840000 0x09 0xffff0000>;
		mboxes = <0x2e 0x00 0x00 0x04 0x2e 0x02 0x00 0x05 0x2e 0x03 0x00 0x04 0x2e 0x04 0x00 0x04 0x2e 0x06 0x00 0x03 0x2e 0x07 0xffffffff 0x02 0x2e 0x08 0x00 0x01 0x2e 0x09 0x00 0x01 0x2e 0x0a 0x00 0x01 0x2e 0x0b 0x00 0x01 0x2e 0x0c 0x00 0x01 0x2e 0x0d 0x00 0x01 0x2e 0x0e 0x00 0x01 0x2e 0x0f 0xffffffff 0x01>;
		mcucfg_base = <0x10040000 0x0e 0xffff0000>;
		mdp_ccorr0 = <0x2c>;
		mdp_ccorr0_frame_done = <0x15>;
		mdp_ccorr0_sof = <0x01>;
		mdp_color0 = <0x2b>;
		mdp_rdma0 = <0x25>;
		mdp_rdma0_frame_done = <0x14>;
		mdp_rdma0_rst_done = <0x97>;
		mdp_rdma0_sof = <0x00>;
		mdp_rsz0 = <0x26>;
		mdp_rsz0_frame_done = <0x16>;
		mdp_rsz0_sof = <0x02>;
		mdp_rsz1 = <0x27>;
		mdp_rsz1_frame_done = <0x17>;
		mdp_rsz1_sof = <0x03>;
		mdp_tdshp0 = <0x2a>;
		mdp_tdshp0_frame_done = <0x1a>;
		mdp_tdshp0_sof = <0x06>;
		mdp_wdma0 = <0x28>;
		mdp_wdma_frame_done = <0x19>;
		mdp_wdma_rst_done = <0x94>;
		mdp_wdma_sof = <0x04>;
		mdp_wrot0 = <0x29>;
		mdp_wrot0_rst_done = <0x95>;
		mdp_wrot0_sof = <0x05>;
		mdp_wrot0_write_frame_done = <0x18>;
		mediatek,mailbox-gce = <0x2e>;
		mm_mutex = <0x2d>;
		mm_na_base = <0x14020000 0x03 0xffff0000>;
		mmsys_config = <0x24>;
		mmsys_config_base = <0x14000000 0x01 0xffff0000>;
		msdc2_base = <0x17020000 0x14 0xffff0000>;
		msdc3_base = <0x18000000 0x16 0xffff0000>;
		phandle = <0xa6>;
		pwm_sw_base = <0x1100e000 0x63 0xffff0000>;
		reg = <0x00 0x10238000 0x00 0x4000>;
		rsc_frame_done = <0x116>;
		scp_base = <0x10030000 0x0d 0xffff0000>;
		scp_sram_base = <0x10000000 0x0a 0xffff0000>;
		secure_thread = <0x06 0x08>;
		seninf_0_fifo_full = <0x147>;
		seninf_1_fifo_full = <0x148>;
		seninf_2_fifo_full = <0x149>;
		seninf_3_fifo_full = <0x14a>;
		seninf_4_fifo_full = <0x14b>;
		seninf_5_fifo_full = <0x14c>;
		seninf_6_fifo_full = <0x14d>;
		seninf_7_fifo_full = <0x14e>;
		sram_share_cnt = <0x01>;
		sram_share_engine = <0x0d>;
		sram_share_event = <0x2c6>;
		stream_done_0 = <0x82>;
		stream_done_1 = <0x83>;
		stream_done_2 = <0x84>;
		stream_done_3 = <0x85>;
		stream_done_4 = <0x86>;
		stream_done_5 = <0x87>;
		stream_done_6 = <0x88>;
		stream_done_7 = <0x89>;
		stream_done_8 = <0x8a>;
		stream_done_9 = <0x8b>;
		topckgen_base = <0x18830000 0x08 0xffff0000>;
		tsf_done = <0x146>;
		usb0_base = <0x10200000 0x10 0xffff0000>;
		usb_sif_base = <0x10280000 0x11 0xffff0000>;
		vdec1_base = <0x17030000 0x15 0xffff0000>;
		vdec2_base = <0x18040000 0x19 0xffff0000>;
		vdec3_base = <0x18050000 0x1a 0xffff0000>;
		vdec_base = <0x17010000 0x13 0xffff0000>;
		vdec_gcon_base = <0x18800000 0x05 0xffff0000>;
		venc_128byte_cnt_done = <0x125>;
		venc_frame_done = <0x121>;
		venc_gcon_base = <0x18810000 0x06 0xffff0000>;
		venc_mb_done = <0x124>;
		venc_pause_done = <0x122>;
		wmf_frame_done = <0x115>;
	};

	gce_mbox@10238000 {
		#gce-event-cells = <0x01>;
		#gce-subsys-cells = <0x02>;
		#mbox-cells = <0x03>;
		clock-names = "gce\0gce-timer";
		clocks = <0x21 0x09 0x21 0x18>;
		compatible = "mediatek,mailbox-gce";
		interrupts = <0x00 0xaa 0x08>;
		phandle = <0x2e>;
		reg = <0x00 0x10238000 0x00 0x4000>;
	};

	gic500@0c000000 {
		compatible = "mediatek,gic500";
		reg = <0x00 0xc000000 0x00 0x400000>;
	};

	gic_cpu@0c400000 {
		compatible = "mediatek,gic_cpu";
		reg = <0x00 0xc400000 0x00 0x40000>;
	};

	gpio {
		compatible = "mediatek,gpio_usage_mapping";
		phandle = <0xe0>;
	};

	gpio@10005000 {
		compatible = "mediatek,gpio";
		phandle = <0x14>;
		reg = <0x00 0x10005000 0x00 0x1000>;
	};

	gpufreq {
		clock-names = "clk_mux\0clk_main_parent\0clk_sub_parent\0subsys_mfg_cg\0mtcmos_mfg_async\0mtcmos_mfg\0mtcmos_mfg_core0\0mtcmos_mfg_core1";
		clocks = <0x12 0x54 0x12 0x26 0x12 0x06 0x54 0x00 0x22 0x09 0x22 0x04 0x22 0x07 0x22 0x08>;
		compatible = "mediatek,mt6768-gpufreq";
	};

	hacc@1000a000 {
		compatible = "mediatek,hacc";
		interrupts = <0x00 0xcb 0x08>;
		reg = <0x00 0x1000a000 0x00 0x1000>;
	};

	hwrng {
		compatible = "mediatek,mt67xx-rng";
		phandle = <0xa1>;
	};

	i2c0@11007000 {
		aed = <0x1a>;
		clock-div = <0x05>;
		clock-names = "main\0dma";
		clocks = <0x21 0x0b 0x21 0x26>;
		compatible = "mediatek,i2c";
		eh_cfg = <0x30>;
		gpio_start = <0x10002a00>;
		id = <0x00>;
		interrupts = <0x00 0x69 0x08>;
		mem_len = <0x200>;
		phandle = <0xaf>;
		pu_cfg = <0x70>;
		reg = <0x00 0x11007000 0x00 0x1000 0x00 0x11000080 0x00 0x80>;
		rsel_cfg = <0x90>;
		scl-gpio-id = <0x53>;
		sda-gpio-id = <0x52>;

		fuelguage@62 {
			bat_channel_num = <0x03>;
			bat_first_endrange = <0x61a80>;
			bat_first_startrange = <0x30d40>;
			bat_second_endrange = "\0\f5";
			bat_second_startrange = <0x927c0>;
			bat_third_endrange = <0x10c8e0>;
			bat_third_startrange = <0xdbba0>;
			batinfo_default = <0x180a6266 0x68686767 0x635d6759 0x6d534741 0x39312c29 0x2d3a454b 0x1a640b85 0x1d3b4351 0x6568686d 0x401c6d55 0xb1c3762 0x8294990e 0x237696a4 0x8090bbcb 0x2f0064a5 0xb50e0929>;
			batinfo_first = <0x180a6266 0x68686767 0x635d6759 0x6d534741 0x39312c29 0x2d3a454b 0x1a640b85 0x1d3b4351 0x6568686d 0x401c6d55 0xb1c3762 0x8294990e 0x237696a4 0x8090bbcb 0x2f0064a5 0xb50e0929>;
			batinfo_second = <0x180a6b6b 0x6b6b6867 0x60685a59 0x635a483f 0x362f2924 0x2830414f 0x284a0b85 0x3455566f 0x827f8081 0x3e195d57 0xb36295a 0x8394990d 0x297a96a8 0x8095aacb 0x2f0064a5 0xb50e08b9>;
			batinfo_third = <0x18145f69 0x6f6b6a68 0x62656159 0x64594941 0x37312721 0x2735414f 0x21460b85 0x2848516c 0x817e7e7e 0x3e1b5c46 0xe205287 0x8f919452 0x828c9296 0x95a6c3cb 0x2f7d64a5 0xb50e0869>;
			compatible = "cellwise,cw2015";
			enable_iio_interface;
			first_bat_capacity = <0x1324>;
			io-channel-names = "thermistor-ch3";
			io-channels = <0x23 0x03>;
			reg = <0x62>;
			sec_bat_capacity = <0x1306>;
			third_bat_capacity = <0x1388>;
		};

		i2c_lcd_bias@3e {
			compatible = "ti,tps65132";
			phandle = <0xb0>;
			reg = <0x3e>;
			status = "okay";
		};
	};

	i2c1@11008000 {
		aed = <0x1a>;
		clock-div = <0x05>;
		clock-names = "main\0dma";
		clocks = <0x21 0x0b 0x21 0x26>;
		compatible = "mediatek,i2c";
		eh_cfg = <0x30>;
		gpio_start = <0x10002a00>;
		id = <0x01>;
		interrupts = <0x00 0x6a 0x08>;
		mem_len = <0x200>;
		phandle = <0xb1>;
		pu_cfg = <0x70>;
		reg = <0x00 0x11008000 0x00 0x1000 0x00 0x11000100 0x00 0x80>;
		rsel_cfg = <0x90>;
		scl-gpio-id = <0x54>;
		sda-gpio-id = <0x51>;
	};

	i2c2@11009000 {
		aed = <0x1a>;
		ch_offset_ccu = <0x200>;
		ch_offset_default = <0x100>;
		clock-div = <0x05>;
		clock-names = "main\0dma";
		clocks = <0x21 0x0b 0x21 0x26>;
		compatible = "mediatek,i2c";
		eh_cfg = <0x40>;
		gpio_start = <0x10002800>;
		id = <0x02>;
		interrupts = <0x00 0x6b 0x08>;
		mem_len = <0x200>;
		phandle = <0xb2>;
		pu_cfg = <0xa0>;
		reg = <0x00 0x11009000 0x00 0x1000 0x00 0x11000180 0x00 0x180>;
		rsel_cfg = <0xf0>;
		scl-gpio-id = <0x67>;
		sda-gpio-id = <0x68>;
	};

	i2c3@1100f000 {
		aed = <0x1a>;
		ch_offset_ccu = <0x200>;
		ch_offset_default = <0x100>;
		clock-div = <0x05>;
		clock-names = "main\0dma";
		clocks = <0x21 0x0b 0x21 0x26>;
		compatible = "mediatek,i2c";
		eh_cfg = <0x30>;
		gpio_start = <0x10002600>;
		id = <0x03>;
		interrupts = <0x00 0x6c 0x08>;
		mem_len = <0x200>;
		phandle = <0xb3>;
		pu_cfg = <0x60>;
		reg = <0x00 0x1100f000 0x00 0x1000 0x00 0x11000300 0x00 0x100>;
		rsel_cfg = <0x90>;
		scl-gpio-id = <0x32>;
		sda-gpio-id = <0x33>;
	};

	i2c4@11011000 {
		aed = <0x1a>;
		ch_offset_ccu = <0x200>;
		ch_offset_default = <0x100>;
		clock-div = <0x05>;
		clock-names = "main\0dma";
		clocks = <0x21 0x0b 0x21 0x26>;
		compatible = "mediatek,i2c";
		eh_cfg = <0x40>;
		gpio_start = <0x10002800>;
		id = <0x04>;
		interrupts = <0x00 0x6d 0x08>;
		mem_len = <0x200>;
		phandle = <0xb4>;
		pu_cfg = <0xa0>;
		reg = <0x00 0x11011000 0x00 0x1000 0x00 0x11000400 0x00 0x180>;
		rsel_cfg = <0xf0>;
		scl-gpio-id = <0x69>;
		sda-gpio-id = <0x6a>;
	};

	i2c5@11016000 {
		aed = <0x1a>;
		clock-div = <0x05>;
		clock-names = "main\0dma";
		clocks = <0x21 0x0b 0x21 0x26>;
		compatible = "mediatek,i2c";
		eh_cfg = <0x30>;
		gpio_start = <0x10002600>;
		id = <0x05>;
		interrupts = <0x00 0x93 0x08>;
		mem_len = <0x200>;
		phandle = <0xb5>;
		pu_cfg = <0x60>;
		reg = <0x00 0x11016000 0x00 0x1000 0x00 0x11000580 0x00 0x80>;
		rsel_cfg = <0x90>;
		scl-gpio-id = <0x30>;
		sda-gpio-id = <0x31>;
	};

	i2c6@1100d000 {
		aed = <0x1a>;
		clock-div = <0x05>;
		clock-names = "main\0dma";
		clocks = <0x21 0x0b 0x21 0x26>;
		compatible = "mediatek,i2c";
		eh_cfg = <0x30>;
		gpio_start = <0x10002000>;
		id = <0x06>;
		interrupts = <0x00 0x94 0x08>;
		mem_len = <0x200>;
		phandle = <0xb6>;
		pu_cfg = <0x60>;
		reg = <0x00 0x1100d000 0x00 0x1000 0x00 0x11000600 0x00 0x80>;
		rsel_cfg = <0x90>;
		scl-gpio-id = <0x59>;
		sda-gpio-id = <0x5a>;
	};

	i2c7@11004000 {
		#address-cells = <0x01>;
		#size-cells = <0x00>;
		aed = <0x1a>;
		clock-div = <0x05>;
		clock-names = "main\0dma";
		clocks = <0x21 0x0b 0x21 0x26>;
		compatible = "mediatek,i2c";
		eh_cfg = <0x30>;
		gpio_start = <0x10002600>;
		id = <0x07>;
		interrupts = <0x00 0x6e 0x08>;
		mem_len = <0x200>;
		phandle = <0xb7>;
		pu_cfg = <0x60>;
		reg = <0x00 0x11004000 0x00 0x1000 0x00 0x11000680 0x00 0x180>;
		rsel_cfg = <0x90>;
		scl-gpio-id = <0xaf>;
		sda-gpio-id = <0xb0>;

		rt-swchg@53 {
			compatible = "richtek,swchg";
			reg = <0x53>;
			rt,intr_gpio = <0x1e 0x13 0x00>;
			rt,intr_gpio_num = <0x13>;
			status = "okay";

			rt9471 {
				aicr = <0x7a120>;
				chg_alias_name = "rt9471_chg";
				chg_name = "secondary_chg";
				cv = <0x432380>;
				en_qon_rst;
				en_safe_tmr;
				ichg = <0xf4240>;
				ieoc = <0x30d40>;
				interrupt-names = "wdt\0chg_mivr\0vbus_gd\0vac_ov\0chg_rdy\0chg_done\0chg_tout\0chg_batov\0detach";
				mivr = <0x432380>;
				mivr_track = <0x00>;
				rm-dev-addr = [53];
				rm-name = "rt9471";
				safe_tmr = <0x0a>;
				vac_ovp = <0xd59f80>;
				wdt = <0x28>;
			};
		};

		rt9467@5b {
			aicr = <0x7a120>;
			charger_name = "primary_chg";
			compatible = "richtek,rt9467";
			cv = <0x432380>;
			en_chgdet;
			en_te;
			en_wdt;
			ichg = <0x1e8480>;
			ieoc = <0x3d090>;
			interrupt-names = "wdtmri\0chg_mivr\0chg_aiclmeasi\0attachi\0detachi\0pwr_rdy\0chg_statci\0chg_ieoci";
			ircmp_resistor = <0x61a8>;
			ircmp_vclamp = <0x7d00>;
			mivr = <0x432380>;
			otgen-gpio = <0x1e 0x39 0x00>;
			reg = <0x5b>;
			regmap_name = "rt9467_primary";
			regmap_represent_slave_addr = <0x5b>;
			rt,intr_gpio = <0x1e 0x14 0x00>;
			rt,intr_gpio_num = <0x14>;
			safety_timer = <0x0c>;
			status = "okay";
		};
	};

	i2c8@11005000 {
		aed = <0x1a>;
		clock-div = <0x05>;
		clock-names = "main\0dma";
		clocks = <0x21 0x0b 0x21 0x26>;
		compatible = "mediatek,i2c";
		id = <0x08>;
		interrupts = <0x00 0x6f 0x08>;
		phandle = <0xb8>;
		reg = <0x00 0x11005000 0x00 0x1000 0x00 0x11000800 0x00 0x180>;
	};

	i2c_common {
		check_max_freq = [01];
		cnt_constraint = [01];
		compatible = "mediatek,i2c_common";
		control_irq_sel = [01];
		dma_support = [03];
		ext_time_config = [18 01];
		idvfs = [01];
		phandle = <0xae>;
		set_dt_div = [01];
		set_ltiming = [01];
		ver = [02];
	};

	imgsys@15020000 {
		#clock-cells = <0x01>;
		clock-names = "ISP_SCP_SYS_DIS\0ISP_SCP_SYS_ISP\0ISP_SCP_SYS_CAM\0ISP_CLK_IMG_DIP\0ISP_CLK_CAM\0ISP_CLK_CAMTG\0ISP_CLK_CAM_SENINF\0ISP_CLK_CAMSV0\0ISP_CLK_CAMSV1\0ISP_CLK_CAMSV2";
		clocks = <0x22 0x03 0x22 0x05 0x22 0x0a 0x56 0x01 0x57 0x02 0x57 0x03 0x57 0x04 0x57 0x05 0x57 0x06 0x57 0x07>;
		compatible = "mediatek,imgsys\0syscon";
		phandle = <0x56>;
		reg = <0x00 0x15020000 0x00 0x1000>;
	};

	imp_iic@11017000 {
		compatible = "mediatek,imp_iic";
		reg = <0x00 0x11017000 0x00 0x1000>;
	};

	infra_dbgsystop_cpu0@0e000000 {
		compatible = "mediatek,infra_dbgsystop_cpu0";
		reg = <0x00 0xe000000 0x00 0x100000>;
	};

	infra_dbgsystop_cpu1@0e100000 {
		compatible = "mediatek,infra_dbgsystop_cpu1";
		reg = <0x00 0xe100000 0x00 0x100000>;
	};

	infra_dbgsystop_cpu2@0e200000 {
		compatible = "mediatek,infra_dbgsystop_cpu2";
		reg = <0x00 0xe200000 0x00 0x100000>;
	};

	infra_dbgsystop_cpu3@0e300000 {
		compatible = "mediatek,infra_dbgsystop_cpu3";
		reg = <0x00 0xe300000 0x00 0x100000>;
	};

	infra_dbgsystop_cpu4@0e400000 {
		compatible = "mediatek,infra_dbgsystop_cpu4";
		reg = <0x00 0xe400000 0x00 0x100000>;
	};

	infra_dbgsystop_cpu5@0e500000 {
		compatible = "mediatek,infra_dbgsystop_cpu5";
		reg = <0x00 0xe500000 0x00 0x100000>;
	};

	infra_dbgsystop_cpu6@0e600000 {
		compatible = "mediatek,infra_dbgsystop_cpu6";
		reg = <0x00 0xe600000 0x00 0x100000>;
	};

	infra_dbgsystop_cpu7@0e700000 {
		compatible = "mediatek,infra_dbgsystop_cpu7";
		reg = <0x00 0xe700000 0x00 0x100000>;
	};

	infra_mbist@1020d000 {
		compatible = "mediatek,infra_mbist";
		reg = <0x00 0x1020d000 0x00 0x1000>;
	};

	infracfg@1020e000 {
		compatible = "mediatek,infracfg";
		reg = <0x00 0x1020e000 0x00 0x1000>;
	};

	infracfg_ao@10001000 {
		#clock-cells = <0x01>;
		compatible = "mediatek,infracfg_ao\0syscon";
		interrupts = <0x00 0x47 0x01>;
		phandle = <0x21>;
		reg = <0x00 0x10001000 0x00 0x1000>;
	};

	interrupt-controller {
		#address-cells = <0x02>;
		#interrupt-cells = <0x03>;
		#redistributor-regions = <0x01>;
		#size-cells = <0x02>;
		compatible = "arm,gic-v3";
		interrupt-controller;
		interrupt-parent = <0x11>;
		interrupts = <0x01 0x09 0x04>;
		phandle = <0x11>;
		reg = <0x00 0xc000000 0x00 0x40000 0x00 0xc040000 0x00 0x200000 0x00 0xc53a650 0x00 0x50>;
	};

	intpol-controller@0 {
		#interrupt-cells = <0x03>;
		compatible = "mediatek,mt6577-sysirq";
		interrupt-controller;
		interrupt-parent = <0x11>;
		phandle = <0x01>;
		reg = <0x00 0xc53a650 0x00 0x50>;
	};

	io_cfg_bl@10002600 {
		compatible = "mediatek,io_cfg_bl";
		phandle = <0x18>;
		reg = <0x00 0x10002600 0x00 0x200>;
	};

	io_cfg_lb@10002400 {
		compatible = "mediatek,io_cfg_lb";
		phandle = <0x17>;
		reg = <0x00 0x10002400 0x00 0x200>;
	};

	io_cfg_lm@10002200 {
		compatible = "mediatek,io_cfg_lm";
		phandle = <0x16>;
		reg = <0x00 0x10002200 0x00 0x200>;
	};

	io_cfg_lt@10002000 {
		compatible = "mediatek,io_cfg_lt";
		phandle = <0x15>;
		reg = <0x00 0x10002000 0x00 0x200>;
	};

	io_cfg_rb@10002a00 {
		compatible = "mediatek,io_cfg_rb";
		phandle = <0x1a>;
		reg = <0x00 0x10002a00 0x00 0x200>;
	};

	io_cfg_rm@10002800 {
		compatible = "mediatek,io_cfg_rm";
		phandle = <0x19>;
		reg = <0x00 0x10002800 0x00 0x200>;
	};

	io_cfg_rt@10002c00 {
		compatible = "mediatek,io_cfg_rt";
		phandle = <0x1b>;
		reg = <0x00 0x10002c00 0x00 0x200>;
	};

	io_cfg_tl@10002e00 {
		compatible = "mediatek,io_cfg_tl";
		phandle = <0x1c>;
		reg = <0x00 0x10002e00 0x00 0x200>;
	};

	iocfg_0@10002000 {
		compatible = "mediatek,iocfg_0";
		reg = <0x00 0x10002000 0x00 0x200>;
	};

	iocfg_1@10002200 {
		compatible = "mediatek,iocfg_1";
		reg = <0x00 0x10002200 0x00 0x200>;
	};

	iocfg_2@10002400 {
		compatible = "mediatek,iocfg_2";
		reg = <0x00 0x10002400 0x00 0x200>;
	};

	iocfg_3@10002600 {
		compatible = "mediatek,iocfg_3";
		reg = <0x00 0x10002600 0x00 0x200>;
	};

	iocfg_4@10002800 {
		compatible = "mediatek,iocfg_4";
		reg = <0x00 0x10002800 0x00 0x200>;
	};

	iocfg_5@10002a00 {
		compatible = "mediatek,iocfg_5";
		reg = <0x00 0x10002a00 0x00 0x200>;
	};

	irq_nfc {
		compatible = "mediatek,irq_nfc-eint";
		phandle = <0xde>;
	};

	irtx_pwm {
		compatible = "mediatek,irtx-pwm";
		phandle = <0xda>;
		pwm_ch = <0x00>;
		pwm_data_invert = <0x00>;
	};

	kd_camera_hw1@1a040000 {
		clock-names = "CLK_TOP_CAMTG_SEL\0CLK_TOP_CAMTG1_SEL\0CLK_TOP_CAMTG2_SEL\0CLK_TOP_CAMTG3_SEL\0CLK_MCLK_6M\0CLK_MCLK_12M\0CLK_MCLK_13M\0CLK_MCLK_48M\0CLK_MCLK_52M\0CLK_MCLK_24M\0CLK_MCLK_26M\0CLK_CAM_SENINF_CG\0CLK_MIPI_C0_26M_CG\0CLK_MIPI_C1_26M_CG\0CLK_MIPI_ANA_0A_CG\0CLK_MIPI_ANA_0B_CG\0CLK_MIPI_ANA_1A_CG\0CLK_MIPI_ANA_1B_CG\0CLK_MIPI_ANA_2A_CG\0CLK_MIPI_ANA_2B_CG\0CLK_TOP_CAMTM_SEL_CG\0CLK_TOP_CAMTM_208_CG\0CLK_SCP_SYS_CAM";
		clocks = <0x12 0x56 0x12 0x57 0x12 0x58 0x12 0x59 0x12 0x14 0x12 0x13 0x12 0x1d 0x12 0x11 0x12 0x1c 0x12 0x12 0x13 0x57 0x04 0x3c 0x0e 0x3c 0x12 0x5d 0x00 0x5e 0x00 0x5f 0x00 0x60 0x00 0x61 0x00 0x62 0x00 0x12 0x6d 0x12 0x1a 0x22 0x0a>;
		compatible = "mediatek,camera_hw";
		phandle = <0xcc>;
		reg = <0x00 0x1a040000 0x00 0x1000>;
	};

	kp@10010000 {
		compatible = "mediatek,kp";
		interrupts = <0x00 0x49 0x02>;
		phandle = <0x9d>;
		reg = <0x00 0x10010000 0x00 0x1000>;
	};

	lastbus@10001000 {
		compatible = "mediatek,lastbus-v1";
		reg = <0x00 0x10001000 0x00 0x1000 0x00 0x10003000 0x00 0x1000>;
	};

	lk_charger {
		ac_charger_current = <0x1f47d0>;
		ac_charger_input_current = <0x30d400>;
		charging_host_charger_current = <0x16e360>;
		compatible = "mediatek,lk_charger";
		enable_anime;
		enable_pd20_reset;
		enable_pe_plus;
		fast_charge_voltage = <0x2dc6c0>;
		max_charger_voltage = <0x90f560>;
		non_std_ac_charger_current = <0x7a120>;
		pd_charger_current = <0x7a120>;
		phandle = <0xd4>;
		power_path_support;
		ta_ac_charger_current = <0x2dc6c0>;
		temp_t1_threshold = <0x00>;
		temp_t3_threshold = <0x2d>;
		temp_t4_threshold = <0x32>;
		usb_charger_current = <0x7a120>;
	};

	m4u@10205000 {
		cell-index = <0x00>;
		compatible = "mediatek,m4u";
		interrupts = <0x00 0xae 0x08>;
		reg = <0x00 0x10205000 0x00 0x1000>;
	};

	mali@13040000 {
		compatible = "mediatek,mali\0arm,mali-midgard\0arm,mali-bifrost";
		interrupt-names = "GPU\0MMU\0JOB\0EVENT\0PWR";
		interrupts = <0x00 0x112 0x08 0x00 0x113 0x08 0x00 0x114 0x08 0x00 0x115 0x08 0x00 0x116 0x08>;
		reg = <0x00 0x13040000 0x00 0x4000>;
	};

	mbist@17040000 {
		compatible = "mediatek,mbist";
		reg = <0x00 0x17040000 0x00 0x10000>;
	};

	mbist@17050000 {
		compatible = "mediatek,mbist";
		reg = <0x00 0x17050000 0x00 0x10000>;
	};

	mbist@17060000 {
		compatible = "mediatek,mbist";
		reg = <0x00 0x17060000 0x00 0x10000>;
	};

	mbist@17070000 {
		compatible = "mediatek,mbist";
		reg = <0x00 0x17070000 0x00 0x10000>;
	};

	mbist_ao@10013000 {
		compatible = "mediatek,mbist_ao";
		reg = <0x00 0x10013000 0x00 0x1000>;
	};

	mcdi@0010fc00 {
		compatible = "mediatek,mt6768-mcdi";
		mediatek,enabled = <0x01>;
		phandle = <0x69>;
		reg = <0x00 0x10fc00 0x00 0x800 0x00 0xc53a000 0x00 0x1000>;
	};

	mcucfg@0c530000 {
		compatible = "mediatek,mcucfg";
		phandle = <0xa0>;
		reg = <0x00 0xc530000 0x00 0x10000>;
	};

	mcucfg_mp0_counter@0c530000 {
		compatible = "mediatek,mcucfg_mp0_counter";
		reg = <0x00 0xc530000 0x00 0x10000>;
	};

	mcupm_reg@10216000 {
		compatible = "mediatek,mcupm_reg";
		reg = <0x00 0x10216000 0x00 0x1000>;
	};

	mcupm_sram0@10217000 {
		compatible = "mediatek,mcupm_sram0";
		reg = <0x00 0x10217000 0x00 0x1000>;
	};

	mcupm_sram1@10218000 {
		compatible = "mediatek,mcupm_sram1";
		reg = <0x00 0x10218000 0x00 0x1000>;
	};

	mcupm_sram2@10211000 {
		compatible = "mediatek,mcupm_sram2";
		reg = <0x00 0x10211000 0x00 0x1000>;
	};

	mcupm_sram3@10213000 {
		compatible = "mediatek,mcupm_sram3";
		reg = <0x00 0x10213000 0x00 0x1000>;
	};

	md1_sim1_hot_plug_eint {
		phandle = <0xe1>;
	};

	md1_sim2_hot_plug_eint {
		phandle = <0xe2>;
	};

	md_auxadc {
		compatible = "mediatek,md_auxadc";
		io-channel-names = "md-channel";
		io-channels = <0x23 0x02>;
		phandle = <0xa3>;
	};

	md_ccif0@1020a000 {
		compatible = "mediatek,md_ccif0";
		reg = <0x00 0x1020a000 0x00 0x1000>;
	};

	md_ccif1@1020c000 {
		compatible = "mediatek,md_ccif1";
		reg = <0x00 0x1020c000 0x00 0x1000>;
	};

	md_ccif2@1023d000 {
		compatible = "mediatek,md_ccif2";
		reg = <0x00 0x1023d000 0x00 0x1000>;
	};

	md_ccif3@1023f000 {
		compatible = "mediatek,md_ccif3";
		reg = <0x00 0x1023f000 0x00 0x1000>;
	};

	mdcldma@10014000 {
		clock-names = "scp-sys-md1-main\0infra-cldma-bclk\0infra-ccif-ap\0infra-ccif-md\0infra-ccif1-ap\0infra-ccif1-md\0infra-ccif2-ap\0infra-ccif2-md";
		clocks = <0x22 0x00 0x21 0x32 0x21 0x29 0x21 0x2c 0x21 0x23 0x21 0x24 0x21 0x51 0x21 0x52>;
		compatible = "mediatek,mdcldma";
		interrupts = <0x00 0xb4 0x04 0x00 0xa4 0x08 0x00 0xa5 0x08 0x00 0x4b 0x02>;
		mediatek,cldma_capability = <0x06>;
		mediatek,md_id = <0x00>;
		phandle = <0xa2>;
		reg = <0x00 0x10014000 0x00 0x1000 0x00 0x1021b000 0x00 0x1000 0x00 0x10209000 0x00 0x1000 0x00 0x1020a000 0x00 0x1000>;
	};

	mdcldmain@1021c000 {
		compatible = "mediatek,mdcldmain";
		reg = <0x00 0x1021c000 0x00 0x400>;
	};

	mdcldmain_ao@10015000 {
		compatible = "mediatek,mdcldmain_ao";
		reg = <0x00 0x10015000 0x00 0x400>;
	};

	mdcldmamisc@1021c000 {
		compatible = "mediatek,mdcldmamisc";
		reg = <0x00 0x1021c000 0x00 0x1000>;
	};

	mdcldmamisc@1021c900 {
		compatible = "mediatek,mdcldmamisc";
		reg = <0x00 0x1021c900 0x00 0x400>;
	};

	mdcldmamisc_ao@10015800 {
		compatible = "mediatek,mdcldmamisc_ao";
		reg = <0x00 0x10015800 0x00 0x400>;
	};

	mdcldmaout@1021c400 {
		compatible = "mediatek,mdcldmaout";
		reg = <0x00 0x1021c400 0x00 0x400>;
	};

	mdcldmaout_ao@10015400 {
		compatible = "mediatek,mdcldmaout_ao";
		reg = <0x00 0x10015400 0x00 0x400>;
	};

	mdp_ccorr0@14005000 {
		clock-names = "MDP_CCORR";
		clocks = <0x24 0x01>;
		compatible = "mediatek,mdp_ccorr0";
		interrupts = <0x00 0xef 0x08>;
		phandle = <0x2c>;
		reg = <0x00 0x14005000 0x00 0x1000>;
	};

	mdp_rdma0@14004000 {
		clock-names = "MDP_RDMA0";
		clocks = <0x24 0x00>;
		compatible = "mediatek,mdp_rdma0";
		interrupts = <0x00 0xe0 0x08>;
		phandle = <0x25>;
		reg = <0x00 0x14004000 0x00 0x1000>;
	};

	mdp_rsz0@14006000 {
		clock-names = "MDP_RSZ0";
		clocks = <0x24 0x02>;
		compatible = "mediatek,mdp_rsz0";
		interrupts = <0x00 0xe1 0x08>;
		phandle = <0x26>;
		reg = <0x00 0x14006000 0x00 0x1000>;
	};

	mdp_rsz1@14007000 {
		clock-names = "MDP_RSZ1";
		clocks = <0x24 0x03>;
		compatible = "mediatek,mdp_rsz1";
		interrupts = <0x00 0xe2 0x08>;
		phandle = <0x27>;
		reg = <0x00 0x14007000 0x00 0x1000>;
	};

	mdp_tdshp0@1400a000 {
		clock-names = "MDP_TDSHP";
		clocks = <0x24 0x04>;
		compatible = "mediatek,mdp_tdshp0";
		phandle = <0x2a>;
		reg = <0x00 0x1400a000 0x00 0x1000>;
	};

	mdp_wdma0@14008000 {
		clock-names = "MDP_WDMA";
		clocks = <0x24 0x06>;
		compatible = "mediatek,mdp_wdma0";
		interrupts = <0x00 0xe5 0x08>;
		phandle = <0x28>;
		reg = <0x00 0x14008000 0x00 0x1000>;
	};

	mdp_wrot0@14009000 {
		clock-names = "MDP_WROT0";
		clocks = <0x24 0x05>;
		compatible = "mediatek,mdp_wrot0";
		interrupts = <0x00 0xe4 0x08>;
		phandle = <0x29>;
		reg = <0x00 0x14009000 0x00 0x1000>;
	};

	memory {
		device_type = "memory";
		reg = <0x00 0x40000000 0x00 0x3e605000>;
	};

	memory-ssmr-features {
		2d_fr-size = <0x00 0x8000000>;
		compatible = "mediatek,memory-ssmr-features";
		iris-recognition-size = <0x00 0x10000000>;
		phandle = <0xd1>;
		prot-sharedmem-size = <0x00 0x8000000>;
		sdsp-firmware-size = <0x00 0x1000000>;
		sdsp-tee-sharedmem-size = <0x00 0x1000000>;
		svp-size = <0x00 0x10000000>;
		ta-elf-size = <0x00 0x1000000>;
		ta-stack-heap-size = <0x00 0x6000000>;
		tui-size = <0x00 0x4000000>;
		wfd-size = <0x00 0x4000000>;
	};

	mfg_cfg@13000000 {
		#clock-cells = <0x01>;
		compatible = "mediatek,mfgcfg\0syscon";
		phandle = <0x54>;
		reg = <0x00 0x13000000 0x00 0x1000>;
	};

	mipi_rx_ana_csi0a@11c10000 {
		#clock-cells = <0x01>;
		compatible = "mediatek,mipi_rx_ana_csi0a\0syscon";
		phandle = <0x5d>;
		reg = <0x00 0x11c10000 0x00 0x1000>;
	};

	mipi_rx_ana_csi0b@11c11000 {
		#clock-cells = <0x01>;
		compatible = "mediatek,mipi_rx_ana_csi0b\0syscon";
		phandle = <0x5e>;
		reg = <0x00 0x11c11000 0x00 0x1000>;
	};

	mipi_rx_ana_csi1a@11c12000 {
		#clock-cells = <0x01>;
		compatible = "mediatek,mipi_rx_ana_csi1a\0syscon";
		phandle = <0x5f>;
		reg = <0x00 0x11c12000 0x00 0x1000>;
	};

	mipi_rx_ana_csi1b@11c13000 {
		#clock-cells = <0x01>;
		compatible = "mediatek,mipi_rx_ana_csi1b\0syscon";
		phandle = <0x60>;
		reg = <0x00 0x11c13000 0x00 0x1000>;
	};

	mipi_rx_ana_csi2a@11c14000 {
		#clock-cells = <0x01>;
		compatible = "mediatek,mipi_rx_ana_csi2a\0syscon";
		phandle = <0x61>;
		reg = <0x00 0x11c14000 0x00 0x1000>;
	};

	mipi_rx_ana_csi2b@11c15000 {
		#clock-cells = <0x01>;
		compatible = "mediatek,mipi_rx_ana_csi2b\0syscon";
		phandle = <0x62>;
		reg = <0x00 0x11c15000 0x00 0x1000>;
	};

	mipi_tx0@11c80000 {
		compatible = "mediatek,mipi_tx0";
		reg = <0x00 0x11c80000 0x00 0x10000>;
	};

	mm_mutex@14016000 {
		compatible = "mediatek,mm_mutex";
		reg = <0x00 0x14016000 0x00 0x1000>;
	};

	mmdvfs_pmqos {
		cam_freq = "cam_step0\0cam_step1\0cam_step2";
		cam_step0 = <0x222 0x01 0x02 0x07>;
		cam_step1 = <0x138 0x01 0x02 0x04>;
		cam_step2 = <0xe4 0x01 0x02 0x05>;
		clock-names = "mmdvfs_clk_mm_sel_ck\0mmdvfs_clk_venc_sel_ck\0mmdvfs_clk_cam_sel_ck\0mmdvfs_clk_mmpll_ck\0mmdvfs_clk_univpll1_d2_ck\0mmdvfs_clk_mmpll_d2_ck\0mmdvfs_clk_univpll_d3_ck\0mmdvfs_clk_syspll_d2_ck";
		clocks = <0x12 0x52 0x12 0x6e 0x12 0x6f 0x12 0x21 0x12 0x17 0x12 0x22 0x12 0x19 0x12 0x01>;
		compatible = "mediatek,mmdvfs_pmqos";
		disp_freq = "mm_step0\0mm_step1\0mm_step2";
		img_freq = "mm_step0\0mm_step1\0mm_step2";
		mdp_freq = "mm_step0\0mm_step1\0mm_step2";
		mm_step0 = <0x1c9 0x01 0x00 0x03>;
		mm_step1 = <0x138 0x01 0x00 0x04>;
		mm_step2 = <0xe4 0x01 0x00 0x05>;
		vdec_freq = "mm_step0\0mm_step1\0mm_step2";
		venc_freq = "venc_step0\0venc_step1\0venc_step2";
		venc_step0 = <0x1c9 0x01 0x01 0x03>;
		venc_step1 = <0x1a0 0x01 0x01 0x06>;
		venc_step2 = <0x138 0x01 0x01 0x04>;
		vopp_steps = <0x00 0x01 0x03>;
	};

	mmsys_config@14000000 {
		#clock-cells = <0x01>;
		clock-names = "CAM_MDP\0IMG_DL_RELAY\0IMG_DL_ASYNC_TOP";
		clocks = <0x24 0x17 0x24 0x1c 0x24 0x1d>;
		compatible = "mediatek,mmsys_config\0syscon";
		interrupts = <0x00 0xf0 0x08>;
		phandle = <0x24>;
		reg = <0x00 0x14000000 0x00 0x1000>;
	};

	mobicore {
		compatible = "trustonic,mobicore";
		interrupts = <0x00 0x129 0x01>;
	};

	modem_temp_share@10018000 {
		compatible = "mediatek,modem_temp_share";
		reg = <0x00 0x10018000 0x00 0x1000>;
	};

	mrdump_ext_rst {
		compatible = "mediatek, mrdump_ext_rst-eint";
		mode = "IRQ";
		phandle = <0x9e>;
		status = "okay";
	};

	msdc0_top@11cd0000 {
		compatible = "mediatek,msdc0_top";
		reg = <0x00 0x11cd0000 0x00 0x1000>;
	};

	msdc1_top@11c90000 {
		compatible = "mediatek,msdc1_top";
		reg = <0x00 0x11c90000 0x00 0x1000>;
	};

	msdc@11230000 {
		bootable;
		bus-width = <0x08>;
		cap-mmc-highspeed;
		clk_src = [01];
		clock-names = "msdc0-clock\0msdc0-hclock\0msdc0-aes-clock";
		clocks = <0x21 0x4c 0x21 0x1c 0x21 0x44>;
		compatible = "mediatek,msdc";
		host_function = [00];
		index = [00];
		interrupts = <0x00 0x64 0x08>;
		max-frequency = <0xbebc200>;
		mmc-ddr-1_8v;
		mmc-hs200-1_8v;
		mmc-hs400-1_8v;
		no-sd;
		no-sdio;
		non-removable;
		phandle = <0xc4>;
		pinctl = <0x30>;
		pinctl_hs200 = <0x32>;
		pinctl_hs400 = <0x31>;
		reg = <0x00 0x11230000 0x00 0x10000>;
		register_setting = <0x33>;
		status = "okay";
		vmmc-supply = <0x34>;
	};

	msdc@11240000 {
		bus-width = <0x04>;
		cap-sd-highspeed;
		cd-gpios = <0x1e 0x12 0x00>;
		cd_level = [01];
		clk_src = [02];
		clock-names = "msdc1-clock\0msdc1-hclock";
		clocks = <0x21 0x4d 0x21 0x1d>;
		compatible = "mediatek,msdc";
		host_function = [01];
		index = [01];
		interrupts = <0x00 0x65 0x08>;
		max-frequency = <0xbebc200>;
		no-mmc;
		no-sdio;
		phandle = <0xc5>;
		pinctl = <0x35>;
		pinctl_ddr50 = <0x38>;
		pinctl_sdr104 = <0x36>;
		pinctl_sdr50 = <0x37>;
		reg = <0x00 0x11240000 0x00 0x10000>;
		register_setting = <0x39>;
		sd-uhs-ddr50;
		sd-uhs-sdr104;
		sd-uhs-sdr12;
		sd-uhs-sdr25;
		sd-uhs-sdr50;
		status = "okay";
		vmmc-supply = <0x3a>;
		vqmmc-supply = <0x3b>;
	};

	mt6358_gauge {
		alias_name = "MT6358";
		compatible = "mediatek,mt6358_gauge";
		gauge_name = "gauge";
	};

	mt6358_snd {
		compatible = "mediatek,mt6358-sound";
		mediatek,pwrap-regmap = <0x20>;
		phandle = <0x52>;
	};

	mt6370_pmu_eint {
		phandle = <0xd8>;
	};

	mt6768-afe-pcm@11220000 {
		apmixed = <0x3c>;
		clock-names = "aud_afe_clk\0aud_dac_clk\0aud_dac_predis_clk\0aud_adc_clk\0aud_apll22m_clk\0aud_apll24m_clk\0aud_apll1_tuner_clk\0aud_tml_clk\0aud_infra_axi_clk\0aud_infra_26m_clk\0top_mux_audio\0top_mux_audio_int\0top_sys_pll1_d4\0top_mux_aud_1\0top_apll1_ck\0top_mux_aud_eng1\0top_apll1_d8\0top_i2s0_m_sel\0top_i2s1_m_sel\0top_i2s2_m_sel\0top_i2s3_m_sel\0top_apll12_div0\0top_apll12_div1\0top_apll12_div2\0top_apll12_div3\0apmixed_apll1\0top_clk26m_clk";
		clocks = <0x3d 0x00 0x3d 0x05 0x3d 0x06 0x3d 0x04 0x3d 0x01 0x3d 0x02 0x3d 0x03 0x3d 0x07 0x21 0x2b 0x21 0x33 0x12 0x5f 0x12 0x60 0x12 0x03 0x12 0x61 0x12 0x29 0x12 0x62 0x12 0x2c 0x12 0x82 0x12 0x83 0x12 0x84 0x12 0x85 0x12 0x70 0x12 0x71 0x12 0x72 0x12 0x73 0x3c 0x08 0x13>;
		compatible = "mediatek,mt6768-sound";
		interrupts = <0x00 0xa9 0x08>;
		phandle = <0x53>;
		pinctrl-0 = <0x3e>;
		pinctrl-1 = <0x3f>;
		pinctrl-10 = <0x48>;
		pinctrl-11 = <0x49>;
		pinctrl-12 = <0x4a>;
		pinctrl-13 = <0x4b>;
		pinctrl-14 = <0x4c>;
		pinctrl-15 = <0x4d>;
		pinctrl-16 = <0x4e>;
		pinctrl-17 = <0x4f>;
		pinctrl-18 = <0x50>;
		pinctrl-19 = <0x51>;
		pinctrl-2 = <0x40>;
		pinctrl-3 = <0x41>;
		pinctrl-4 = <0x42>;
		pinctrl-5 = <0x43>;
		pinctrl-6 = <0x44>;
		pinctrl-7 = <0x45>;
		pinctrl-8 = <0x46>;
		pinctrl-9 = <0x47>;
		pinctrl-names = "aud_clk_mosi_off\0aud_clk_mosi_on\0aud_clk_miso_off\0aud_clk_miso_on\0aud_dat_mosi_off\0aud_dat_mosi_on\0aud_dat_miso_off\0aud_dat_miso_on\0aud_gpio_i2s0_off\0aud_gpio_i2s0_on\0aud_gpio_i2s1_off\0aud_gpio_i2s1_on\0aud_gpio_i2s2_off\0aud_gpio_i2s2_on\0aud_gpio_i2s3_off\0aud_gpio_i2s3_on\0vow_dat_miso_off\0vow_dat_miso_on\0vow_clk_miso_off\0vow_clk_miso_on";
		reg = <0x00 0x11220000 0x00 0x1000>;
		topckgen = <0x12>;
	};

	mt_charger {
		compatible = "mediatek,mt-charger";
		phandle = <0xd3>;
	};

	mt_cpufreq {
		compatible = "mediatek,mt-cpufreq";
		phandle = <0xa5>;
	};

	mt_soc_playback_offload {
		compatible = "mediatek,mt_soc_offload_common";
	};

	mtk-btcvsd-snd@18050000 {
		compatible = "mediatek,mtk-btcvsd-snd";
		interrupts = <0x00 0x11b 0x08>;
		mediatek,infracfg = <0x21>;
		mediatek,offset = <0xf00 0x800 0x140 0x144 0x148>;
		reg = <0x00 0x18050000 0x00 0x1000 0x00 0x18080000 0x00 0x10000>;
	};

	mtkfb@0 {
		compatible = "mediatek,mtkfb";
		phandle = <0xc8>;
	};

	nfc {
		compatible = "mediatek,nfc-gpio-v2";
		gpio-irq = <0x09>;
		gpio-irq-std = <0x1e 0x09 0x00>;
		gpio-rst = <0x9f>;
		gpio-rst-std = <0x1e 0x9f 0x00>;
		phandle = <0xdd>;
	};

	nfi@11018000 {
		compatible = "mediatek,nfi";
		reg = <0x00 0x11018000 0x00 0x1000>;
	};

	nfiecc@11019000 {
		compatible = "mediatek,nfiecc";
		reg = <0x00 0x11019000 0x00 0x1000>;
	};

	odm {
		compatible = "simple-bus";
		phandle = <0xd0>;
	};

	pd_adapter {
		adapter_name = "pd_adapter";
		compatible = "mediatek,pd_adapter";
		phandle = <0xd6>;
	};

	pericfg@10003000 {
		#clock-cells = <0x01>;
		compatible = "mediatek,pericfg\0syscon";
		phandle = <0x6a>;
		reg = <0x00 0x10003000 0x00 0x1000>;
	};

	pinctrl {
		#gpio-cells = <0x02>;
		#interrupt-cells = <0x04>;
		compatible = "mediatek,mt6768-pinctrl";
		gpio-controller;
		gpio-ranges = <0x1e 0x00 0x00 0xba>;
		interrupt-controller;
		interrupts = <0x00 0xba 0x04>;
		phandle = <0x1e>;
		pins-are-numbered;
		reg_base_eint = <0x1d>;
		reg_bases = <0x14 0x15 0x16 0x17 0x18 0x19 0x1a 0x1b 0x1c>;

		aud_clk_miso_off {
			phandle = <0x40>;

			pins_cmd0_dat {
				pinmux = <0x8c00 0x8d00>;
			};
		};

		aud_clk_miso_on {
			phandle = <0x41>;

			pins_cmd0_dat {
				input-schmitt-enable;
				pinmux = <0x8c01>;
			};

			pins_cmd1_dat {
				input-schmitt-enable;
				pinmux = <0x8d01>;
			};
		};

		aud_clk_mosi_off {
			phandle = <0x3e>;

			pins_cmd0_dat {
				pinmux = <0x8800 0x8900>;
			};
		};

		aud_clk_mosi_on {
			phandle = <0x3f>;

			pins_cmd0_dat {
				input-schmitt-enable;
				pinmux = <0x8801>;
			};

			pins_cmd1_dat {
				input-schmitt-enable;
				pinmux = <0x8901>;
			};
		};

		aud_dat_miso_off {
			phandle = <0x44>;

			pins_cmd0_dat {
				bias-disable;
				input-enable;
				pinmux = <0x8c00>;
				slew-rate = <0x00>;
			};

			pins_cmd1_dat {
				bias-disable;
				input-enable;
				pinmux = <0x8d00>;
				slew-rate = <0x00>;
			};

			pins_cmd2_dat {
				bias-disable;
				input-enable;
				pinmux = <0x8e00>;
				slew-rate = <0x00>;
			};

			pins_cmd3_dat {
				bias-disable;
				input-enable;
				pinmux = <0x8f00>;
				slew-rate = <0x00>;
			};
		};

		aud_dat_miso_on {
			phandle = <0x45>;

			pins_cmd0_dat {
				input-schmitt-enable;
				pinmux = <0x8c01>;
			};

			pins_cmd1_dat {
				input-schmitt-enable;
				pinmux = <0x8d01>;
			};

			pins_cmd2_dat {
				input-schmitt-enable;
				pinmux = <0x8e01>;
			};

			pins_cmd3_dat {
				input-schmitt-enable;
				pinmux = <0x8f01>;
			};
		};

		aud_dat_mosi_off {
			phandle = <0x42>;

			pins_cmd0_dat {
				bias-disable;
				input-enable;
				pinmux = <0x8800>;
				slew-rate = <0x00>;
			};

			pins_cmd1_dat {
				bias-disable;
				input-enable;
				pinmux = <0x8900>;
				slew-rate = <0x00>;
			};

			pins_cmd2_dat {
				bias-disable;
				input-enable;
				pinmux = <0x8a00>;
				slew-rate = <0x00>;
			};

			pins_cmd3_dat {
				bias-pull-down;
				input-enable;
				pinmux = <0x8b00>;
				slew-rate = <0x00>;
			};
		};

		aud_dat_mosi_on {
			phandle = <0x43>;

			pins_cmd0_dat {
				input-schmitt-enable;
				pinmux = <0x8801>;
			};

			pins_cmd1_dat {
				input-schmitt-enable;
				pinmux = <0x8901>;
			};

			pins_cmd2_dat {
				input-schmitt-enable;
				pinmux = <0x8a01>;
			};

			pins_cmd3_dat {
				input-schmitt-enable;
				pinmux = <0x8b01>;
			};
		};

		aud_gpio_i2s0_off {
			phandle = <0x46>;

			pins_cmd_dat {
				pinmux = <0x2800>;
			};
		};

		aud_gpio_i2s0_on {
			phandle = <0x47>;

			pins_cmd_dat {
				pinmux = <0x2802>;
			};
		};

		aud_gpio_i2s1_off {
			phandle = <0x48>;
		};

		aud_gpio_i2s1_on {
			phandle = <0x49>;
		};

		aud_gpio_i2s2_off {
			phandle = <0x4a>;
		};

		aud_gpio_i2s2_on {
			phandle = <0x4b>;
		};

		aud_gpio_i2s3_off {
			phandle = <0x4c>;

			pins_cmd_dat {
				pinmux = <0x2500 0x2600 0x2400>;
			};
		};

		aud_gpio_i2s3_on {
			phandle = <0x4d>;

			pins_cmd_dat {
				pinmux = <0x2502 0x2602 0x2402>;
			};
		};

		lcm_power_gpio {
			compatible = "prize,lcm_power_gpio";
			phandle = <0x6b>;
		};

		msdc0@default {
			phandle = <0x30>;

			pins_clk {
				drive-strength = [03];
			};

			pins_cmd {
				drive-strength = [03];
			};

			pins_dat {
				drive-strength = [03];
			};

			pins_ds {
				drive-strength = [03];
			};

			pins_rst {
				drive-strength = [03];
			};
		};

		msdc0@hs200 {
			phandle = <0x32>;

			pins_clk {
				drive-strength = [04];
			};

			pins_cmd {
				drive-strength = [03];
			};

			pins_dat {
				drive-strength = [04];
			};

			pins_ds {
				drive-strength = [04];
			};

			pins_rst {
				drive-strength = [03];
			};
		};

		msdc0@hs400 {
			phandle = <0x31>;

			pins_clk {
				drive-strength = [04];
			};

			pins_cmd {
				drive-strength = [03];
			};

			pins_dat {
				drive-strength = [04];
			};

			pins_ds {
				drive-strength = [04];
			};

			pins_rst {
				drive-strength = [03];
			};
		};

		msdc0@register_default {
			cmd_edge = [00];
			phandle = <0x33>;
			rdata_edge = [00];
			wdata_edge = [00];
		};

		msdc1@ddr50 {
			phandle = <0x38>;

			pins_clk {
				drive-strength = [03];
			};

			pins_cmd {
				drive-strength = [03];
			};

			pins_dat {
				drive-strength = [03];
			};
		};

		msdc1@default {
			phandle = <0x35>;

			pins_clk {
				drive-strength = [03];
			};

			pins_cmd {
				drive-strength = [03];
			};

			pins_dat {
				drive-strength = [03];
			};
		};

		msdc1@register_default {
			cmd_edge = [00];
			phandle = <0x39>;
			rdata_edge = [00];
			wdata_edge = [00];
		};

		msdc1@sdr104 {
			phandle = <0x36>;

			pins_clk {
				drive-strength = [03];
			};

			pins_cmd {
				drive-strength = [03];
			};

			pins_dat {
				drive-strength = [03];
			};
		};

		msdc1@sdr50 {
			phandle = <0x37>;

			pins_clk {
				drive-strength = [03];
			};

			pins_cmd {
				drive-strength = [03];
			};

			pins_dat {
				drive-strength = [03];
			};
		};

		vow_clk_miso_off {
			phandle = <0x50>;

			pins_cmd3_dat {
				pinmux = <0x8f00>;
			};
		};

		vow_clk_miso_on {
			phandle = <0x51>;

			pins_cmd3_dat {
				pinmux = <0x8f04>;
			};
		};

		vow_dat_miso_off {
			phandle = <0x4e>;

			pins_cmd1_dat {
				pinmux = <0x8e00>;
			};
		};

		vow_dat_miso_on {
			phandle = <0x4f>;

			pins_cmd1_dat {
				pinmux = <0x8e04>;
			};
		};
	};

	pmic_clock_buffer_ctrl {
		compatible = "mediatek,pmic_clock_buffer";
		mediatek,clkbuf-config = <0x02 0x01 0x01 0x02 0x00 0x00 0x00>;
		mediatek,clkbuf-driving-current = <0x01 0x01 0x01 0x01 0x01 0x01 0x01>;
		mediatek,clkbuf-quantity = <0x07>;
		phandle = <0xdb>;
	};

	pmu {
		compatible = "arm,armv8-pmuv3";
		interrupt-parent = <0x11>;
		interrupts = <0x01 0x07 0x08>;
	};

	prize_disp {
		compatible = "prize,dispsys_gpio";
		phandle = <0xe3>;
	};

	psci {
		compatible = "arm,psci-1.0";
		method = "smc";
	};

	pwm@11006000 {
		clock-names = "PWM1-main\0PWM2-main\0PWM3-main\0PWM4-main\0PWM5-main\0PWM6-main\0PWM-HCLK-main\0PWM-main";
		clocks = <0x21 0x10 0x21 0x11 0x21 0x12 0x21 0x13 0x21 0x14 0x21 0x30 0x21 0x0f 0x21 0x15>;
		compatible = "mediatek,pwm";
		interrupts = <0x00 0x62 0x08>;
		reg = <0x00 0x11006000 0x00 0x1000>;
	};

	pwrap@1000d000 {
		clock-names = "spi\0wrap";
		clocks = <0x13 0x13>;
		compatible = "mediatek,mt6768-pwrap";
		interrupts = <0x00 0xc2 0x04>;
		phandle = <0x20>;
		reg = <0x00 0x1000d000 0x00 0x1000>;
		reg-names = "pwrap";

		mt6358-pmic {
			#interrupt-cells = <0x02>;
			compatible = "mediatek,mt6358-pmic";
			interrupt-controller;
			interrupt-names = "vproc11_oc\0vproc12_oc\0vcore_oc\0vgpu_oc\0vmodem_oc\0vdram1_oc\0vs1_oc\0vs2_oc\0vpa_oc\0vcore_preoc\0vfe28_oc\0vxo22_oc\0vrf18_oc\0vrf12_oc\0vefuse_oc\0vcn33_oc\0vcn28_oc\0vcn18_oc\0vcama1_oc\0vcama2_oc\0vcamd_oc\0vcamio_oc\0vldo28_oc\0va12_oc\0vaux18_oc\0vaud28_oc\0vio28_oc\0vio18_oc\0vsram_proc11_oc\0vsram_proc12_oc\0vsram_others_oc\0vsram_gpu_oc\0vdram2_oc\0vmc_oc\0vmch_oc\0vemc_oc\0vsim1_oc\0vsim2_oc\0vibr_oc\0vusb_oc\0vbif28_oc\0pwrkey\0homekey\0pwrkey_r\0homekey_r\0ni_lbat_int\0chrdet\0chrdet_edge\0vcdt_hv_det\0rtc\0fg_bat0_h\0fg_bat0_l\0fg_cur_h\0fg_cur_l\0fg_zcv\0fg_bat1_h\0fg_bat1_l\0fg_n_charge_l\0fg_iavg_h\0fg_iavg_l\0fg_time_h\0fg_discharge\0fg_charge\0baton_lv\0baton_ht\0baton_bat_in\0baton_bat_out\0bif\0bat_h\0bat_l\0bat2_h\0bat2_l\0bat_temp_h\0bat_temp_l\0auxadc_imp\0nag_c_dltv\0audio\0accdet\0accdet_eint0\0accdet_eint1\0spi_cmd_alert";
			interrupt-parent = <0x1e>;
			interrupts = <0x90 0x04 0x90 0x00>;
			mediatek,num-pmic-irqs = <0x91>;
			mediatek,pmic-irqs = <0x00 0x00 0x01 0x00 0x02 0x00 0x03 0x00 0x04 0x00 0x05 0x00 0x06 0x00 0x07 0x00 0x08 0x00 0x09 0x00 0x10 0x01 0x11 0x01 0x12 0x01 0x13 0x01 0x14 0x01 0x15 0x01 0x16 0x01 0x17 0x01 0x18 0x01 0x19 0x01 0x1a 0x01 0x1b 0x01 0x1c 0x01 0x1d 0x01 0x1e 0x01 0x1f 0x01 0x20 0x01 0x21 0x01 0x22 0x01 0x23 0x01 0x24 0x01 0x25 0x01 0x26 0x01 0x27 0x01 0x28 0x01 0x29 0x01 0x2a 0x01 0x2b 0x01 0x2c 0x01 0x2d 0x01 0x2e 0x01 0x30 0x02 0x31 0x02 0x32 0x02 0x33 0x02 0x34 0x02 0x35 0x02 0x36 0x02 0x37 0x02 0x40 0x03 0x50 0x04 0x51 0x04 0x52 0x04 0x53 0x04 0x54 0x04 0x55 0x04 0x56 0x04 0x57 0x04 0x58 0x04 0x59 0x04 0x5a 0x04 0x5b 0x04 0x5c 0x04 0x60 0x04 0x61 0x04 0x62 0x04 0x63 0x04 0x64 0x04 0x70 0x05 0x71 0x05 0x72 0x05 0x73 0x05 0x74 0x05 0x75 0x05 0x76 0x05 0x77 0x05 0x80 0x06 0x85 0x06 0x86 0x06 0x87 0x06 0x90 0x07>;
			phandle = <0x6f>;
			status = "okay";

			mt-pmic {
				compatible = "mediatek,mt-pmic";
				interrupt-names = "pwrkey\0pwrkey_r\0homekey\0homekey_r\0bat_h\0bat_l\0fg_cur_h\0fg_cur_l";
				interrupts = <0x30 0x04 0x32 0x04 0x31 0x04 0x33 0x04 0x70 0x04 0x71 0x04 0x52 0x04 0x53 0x04>;
				phandle = <0x70>;
			};

			mt6358_misc {
				apply-lpsd-solution;
				base = <0x580>;
				compatible = "mediatek,mt6358-misc";
				dcxo-switch;
				phandle = <0x9b>;
			};

			mt6358_rtc {
				apply-lpsd-solution;
				base = <0x580>;
				compatible = "mediatek,mt6358-rtc";
				interrupt-names = "rtc";
				interrupts = <0x40 0x00>;
				phandle = <0x9a>;
			};

			mt6358regulator {
				compatible = "mediatek,mt6358-regulator";
				phandle = <0x72>;

				buck_vcore {
					phandle = <0x74>;
					regulator-enable-ramp-delay = <0xc8>;
					regulator-max-microvolt = <0x13bdb6>;
					regulator-min-microvolt = <0x7a120>;
					regulator-name = "vcore";
				};

				buck_vdram1 {
					phandle = <0x73>;
					regulator-enable-ramp-delay = <0x00>;
					regulator-max-microvolt = <0x1fda4c>;
					regulator-min-microvolt = <0x7a120>;
					regulator-name = "vdram1";
				};

				buck_vgpu {
					phandle = <0x78>;
					regulator-enable-ramp-delay = <0xc8>;
					regulator-max-microvolt = <0x13bdb6>;
					regulator-min-microvolt = <0x7a120>;
					regulator-name = "vgpu";
				};

				buck_vmodem {
					phandle = <0x7a>;
					regulator-enable-ramp-delay = <0x384>;
					regulator-max-microvolt = <0x13bdb6>;
					regulator-min-microvolt = <0x7a120>;
					regulator-name = "vmodem";
				};

				buck_vpa {
					phandle = <0x75>;
					regulator-enable-ramp-delay = <0xfa>;
					regulator-max-microvolt = <0x37b1d0>;
					regulator-min-microvolt = <0x7a120>;
					regulator-name = "vpa";
				};

				buck_vproc11 {
					phandle = <0x76>;
					regulator-enable-ramp-delay = <0xc8>;
					regulator-max-microvolt = <0x13bdb6>;
					regulator-min-microvolt = <0x7a120>;
					regulator-name = "vproc11";
				};

				buck_vproc12 {
					phandle = <0x77>;
					regulator-enable-ramp-delay = <0xc8>;
					regulator-max-microvolt = <0x13bdb6>;
					regulator-min-microvolt = <0x7a120>;
					regulator-name = "vproc12";
				};

				buck_vs1 {
					phandle = <0x7b>;
					regulator-enable-ramp-delay = <0x00>;
					regulator-max-microvolt = <0x277b6c>;
					regulator-min-microvolt = <0xf4240>;
					regulator-name = "vs1";
				};

				buck_vs2 {
					phandle = <0x79>;
					regulator-enable-ramp-delay = <0x00>;
					regulator-max-microvolt = <0x1fda4c>;
					regulator-min-microvolt = <0x7a120>;
					regulator-name = "vs2";
				};

				ldo_va09 {
					compatible = "regulator-fixed";
					phandle = <0x99>;
					regulator-boot-on;
					regulator-enable-ramp-delay = <0x108>;
					regulator-max-microvolt = <0xdbba0>;
					regulator-min-microvolt = <0xdbba0>;
					regulator-name = "va09";
				};

				ldo_va12 {
					compatible = "regulator-fixed";
					phandle = <0x91>;
					regulator-enable-ramp-delay = <0x10e>;
					regulator-max-microvolt = <0x124f80>;
					regulator-min-microvolt = <0x124f80>;
					regulator-name = "va12";
				};

				ldo_vaud28 {
					compatible = "regulator-fixed";
					phandle = <0x97>;
					regulator-enable-ramp-delay = <0x10e>;
					regulator-max-microvolt = <0x2ab980>;
					regulator-min-microvolt = <0x2ab980>;
					regulator-name = "vaud28";
				};

				ldo_vaux18 {
					compatible = "regulator-fixed";
					phandle = <0x8c>;
					regulator-enable-ramp-delay = <0x10e>;
					regulator-max-microvolt = <0x1b7740>;
					regulator-min-microvolt = <0x1b7740>;
					regulator-name = "vaux18";
				};

				ldo_vbif28 {
					compatible = "regulator-fixed";
					phandle = <0x8d>;
					regulator-enable-ramp-delay = <0x10e>;
					regulator-max-microvolt = <0x2ab980>;
					regulator-min-microvolt = <0x2ab980>;
					regulator-name = "vbif28";
				};

				ldo_vcama1 {
					phandle = <0x8f>;
					regulator-enable-ramp-delay = <0x10e>;
					regulator-max-microvolt = <0x2dc6c0>;
					regulator-min-microvolt = <0x1b7740>;
					regulator-name = "vcama1";
				};

				ldo_vcama2 {
					phandle = <0x95>;
					regulator-enable-ramp-delay = <0x10e>;
					regulator-max-microvolt = <0x2dc6c0>;
					regulator-min-microvolt = <0x1b7740>;
					regulator-name = "vcama2";
				};

				ldo_vcamd {
					phandle = <0x83>;
					regulator-enable-ramp-delay = <0x10e>;
					regulator-max-microvolt = <0x1b7740>;
					regulator-min-microvolt = <0xdbba0>;
					regulator-name = "vcamd";
				};

				ldo_vcamio {
					compatible = "regulator-fixed";
					phandle = <0x82>;
					regulator-enable-ramp-delay = <0x10e>;
					regulator-max-microvolt = <0x1b7740>;
					regulator-min-microvolt = <0x1b7740>;
					regulator-name = "vcamio";
				};

				ldo_vcn18 {
					compatible = "regulator-fixed";
					phandle = <0x84>;
					regulator-enable-ramp-delay = <0x10e>;
					regulator-max-microvolt = <0x1b7740>;
					regulator-min-microvolt = <0x1b7740>;
					regulator-name = "vcn18";
				};

				ldo_vcn28 {
					compatible = "regulator-fixed";
					phandle = <0x87>;
					regulator-enable-ramp-delay = <0x10e>;
					regulator-max-microvolt = <0x2ab980>;
					regulator-min-microvolt = <0x2ab980>;
					regulator-name = "vcn28";
				};

				ldo_vcn33_bt {
					phandle = <0x93>;
					regulator-enable-ramp-delay = <0x10e>;
					regulator-max-microvolt = <0x3567e0>;
					regulator-min-microvolt = <0x325aa0>;
					regulator-name = "vcn33_bt";
				};

				ldo_vcn33_wifi {
					phandle = <0x94>;
					regulator-enable-ramp-delay = <0x10e>;
					regulator-max-microvolt = <0x3567e0>;
					regulator-min-microvolt = <0x325aa0>;
					regulator-name = "vcn33_wifi";
				};

				ldo_vdram2 {
					phandle = <0x7c>;
					regulator-enable-ramp-delay = <0xce4>;
					regulator-max-microvolt = <0x1b7740>;
					regulator-min-microvolt = <0x927c0>;
					regulator-name = "vdram2";
				};

				ldo_vefuse {
					phandle = <0x8b>;
					regulator-enable-ramp-delay = <0x10e>;
					regulator-max-microvolt = <0x1cfde0>;
					regulator-min-microvolt = <0x19f0a0>;
					regulator-name = "vefuse";
				};

				ldo_vemc {
					phandle = <0x34>;
					regulator-enable-ramp-delay = <0x3c>;
					regulator-max-microvolt = <0x325aa0>;
					regulator-min-microvolt = <0x2c4020>;
					regulator-name = "vemc";
				};

				ldo_vfe28 {
					compatible = "regulator-fixed";
					phandle = <0x85>;
					regulator-enable-ramp-delay = <0x10e>;
					regulator-max-microvolt = <0x2ab980>;
					regulator-min-microvolt = <0x2ab980>;
					regulator-name = "vfe28";
				};

				ldo_vibr {
					phandle = <0x7e>;
					regulator-enable-ramp-delay = <0x3c>;
					regulator-max-microvolt = <0x325aa0>;
					regulator-min-microvolt = <0x124f80>;
					regulator-name = "vibr";
				};

				ldo_vio18 {
					compatible = "regulator-fixed";
					phandle = <0x80>;
					regulator-enable-ramp-delay = <0xa8c>;
					regulator-max-microvolt = <0x1b7740>;
					regulator-min-microvolt = <0x1b7740>;
					regulator-name = "vio18";
				};

				ldo_vio28 {
					compatible = "regulator-fixed";
					phandle = <0x90>;
					regulator-enable-ramp-delay = <0x10e>;
					regulator-max-microvolt = <0x2ab980>;
					regulator-min-microvolt = <0x2ab980>;
					regulator-name = "vio28";
				};

				ldo_vldo28 {
					phandle = <0x96>;
					regulator-enable-ramp-delay = <0x10e>;
					regulator-max-microvolt = <0x2dc6c0>;
					regulator-min-microvolt = <0x2ab980>;
					regulator-name = "vldo28";
				};

				ldo_vmc {
					phandle = <0x3b>;
					regulator-enable-ramp-delay = <0x3c>;
					regulator-max-microvolt = <0x325aa0>;
					regulator-min-microvolt = <0x1b7740>;
					regulator-name = "vmc";
				};

				ldo_vmch {
					phandle = <0x3a>;
					regulator-enable-ramp-delay = <0x3c>;
					regulator-max-microvolt = <0x325aa0>;
					regulator-min-microvolt = <0x2c4020>;
					regulator-name = "vmch";
				};

				ldo_vrf12 {
					compatible = "regulator-fixed";
					phandle = <0x7f>;
					regulator-enable-ramp-delay = <0x78>;
					regulator-max-microvolt = <0x124f80>;
					regulator-min-microvolt = <0x124f80>;
					regulator-name = "vrf12";
				};

				ldo_vrf18 {
					compatible = "regulator-fixed";
					phandle = <0x92>;
					regulator-enable-ramp-delay = <0x78>;
					regulator-max-microvolt = <0x1b7740>;
					regulator-min-microvolt = <0x1b7740>;
					regulator-name = "vrf18";
				};

				ldo_vsim1 {
					phandle = <0x7d>;
					regulator-enable-ramp-delay = <0x21c>;
					regulator-max-microvolt = <0x2f4d60>;
					regulator-min-microvolt = <0x19f0a0>;
					regulator-name = "vsim1";
				};

				ldo_vsim2 {
					phandle = <0x98>;
					regulator-enable-ramp-delay = <0x21c>;
					regulator-max-microvolt = <0x2f4d60>;
					regulator-min-microvolt = <0x19f0a0>;
					regulator-name = "vsim2";
				};

				ldo_vsram_gpu {
					phandle = <0x89>;
					regulator-enable-ramp-delay = <0xf0>;
					regulator-max-microvolt = <0x13bdb6>;
					regulator-min-microvolt = <0x7a120>;
					regulator-name = "vsram_gpu";
				};

				ldo_vsram_others {
					phandle = <0x88>;
					regulator-enable-ramp-delay = <0xf0>;
					regulator-max-microvolt = <0x13bdb6>;
					regulator-min-microvolt = <0x7a120>;
					regulator-name = "vsram_others";
				};

				ldo_vsram_proc11 {
					phandle = <0x86>;
					regulator-enable-ramp-delay = <0xf0>;
					regulator-max-microvolt = <0x13bdb6>;
					regulator-min-microvolt = <0x7a120>;
					regulator-name = "vsram_proc11";
				};

				ldo_vsram_proc12 {
					phandle = <0x8e>;
					regulator-enable-ramp-delay = <0xf0>;
					regulator-max-microvolt = <0x13bdb6>;
					regulator-min-microvolt = <0x7a120>;
					regulator-name = "vsram_proc12";
				};

				ldo_vusb {
					phandle = <0x81>;
					regulator-enable-ramp-delay = <0x10e>;
					regulator-max-microvolt = <0x2f4d60>;
					regulator-min-microvolt = <0x2dc6c0>;
					regulator-name = "vusb";
				};

				ldo_vxo22 {
					compatible = "regulator-fixed";
					phandle = <0x8a>;
					regulator-enable-ramp-delay = <0x78>;
					regulator-max-microvolt = <0x2191c0>;
					regulator-min-microvolt = <0x2191c0>;
					regulator-name = "vxo22";
				};
			};

			mt635x-auxadc {
				#io-channel-cells = <0x01>;
				compatible = "mediatek,mt6358-auxadc";
				phandle = <0x71>;

				accdet {
					channel = <0x09>;
				};

				bat_temp {
					channel = <0x03>;
					resistance-ratio = <0x02 0x01>;
				};

				batadc {
					avg-num = <0x80>;
					channel = <0x00>;
					resistance-ratio = <0x03 0x01>;
				};

				chip_temp {
					channel = <0x05>;
				};

				dcxo_temp {
					avg-num = <0x10>;
					channel = <0x0d>;
				};

				dcxo_volt {
					channel = <0x0a>;
					resistance-ratio = <0x03 0x02>;
				};

				hpofs_cal {
					avg-num = <0x100>;
					channel = <0x0c>;
				};

				tsx_temp {
					avg-num = <0x80>;
					channel = <0x0b>;
				};

				vbif {
					channel = <0x0e>;
					resistance-ratio = <0x02 0x01>;
				};

				vcdt {
					channel = <0x02>;
				};

				vcore_temp {
					channel = <0x06>;
				};

				vgpu_temp {
					channel = <0x08>;
				};

				vproc_temp {
					channel = <0x07>;
				};
			};
		};
	};

	pwrap_md32@10448000 {
		compatible = "mediatek,pwrap_md32";
		reg = <0x00 0x10448000 0x00 0x1000>;
	};

	pwrap_mpu@1000d000 {
		compatible = "mediatek,pwrap_mpu";
		reg = <0x00 0x1000d000 0x00 0x1000>;
	};

	pwrap_p2p@1005cb000 {
		compatible = "mediatek,pwrap_p2p";
		reg = <0x00 0x105cb000 0x00 0x1000>;
	};

	pwraphal@ {
		compatible = "mediatek,pwraph";
		mediatek,pwrap-regmap = <0x20>;
		phandle = <0x9c>;
	};

	radio_md_cfg {
		compatible = "mediatek,radio_md_cfg";
		phandle = <0xd2>;
	};

	reserve@16030000 {
		compatible = "mediatek,reserve";
		reg = <0x00 0x16030000 0x00 0x10000>;
	};

	reserved-memory {
		#address-cells = <0x02>;
		#size-cells = <0x02>;
		phandle = <0x66>;
		ranges;

		consys-reserve-memory {
			alignment = <0x00 0x1000000>;
			alloc-ranges = <0x00 0x40000000 0x00 0x80000000>;
			compatible = "mediatek,consys-reserve-memory";
			no-map;
			size = <0x00 0x400000>;
		};

		ion-carveout-heap {
			alignment = <0x00 0x1000>;
			alloc-ranges = <0x00 0x40000000 0x00 0x80000000>;
			compatible = "mediatek,ion-carveout-heap";
			no-map;
			size = <0x00 0x4000>;
		};

		reserve-memory-scp_share {
			alignment = <0x00 0x1000000>;
			alloc-ranges = <0x00 0x40000000 0x00 0x50000000>;
			compatible = "mediatek,reserve-memory-scp_share";
			no-map;
			size = <0x00 0x300000>;
		};

		reserve-memory-sspm_share {
			alignment = <0x00 0x10000>;
			alloc-ranges = <0x00 0x40000000 0x00 0x60000000>;
			compatible = "mediatek,reserve-memory-sspm_share";
			no-map;
			size = <0x00 0x510000>;
			status = "okay";
		};

		soter-shared-mem {
			alignment = <0x00 0x200000>;
			alloc-ranges = <0x00 0x40000000 0x00 0x50000000>;
			compatible = "microtrust,shared_mem";
			no-map;
			size = <0x00 0x200000>;
		};

		wifi-reserve-memory {
			alignment = <0x00 0x1000000>;
			alloc-ranges = <0x00 0x40000000 0x00 0x80000000>;
			compatible = "mediatek,wifi-reserve-memory";
			no-map;
			size = <0x00 0x300000>;
		};

		zmc-default {
			alignment = <0x00 0x1000000>;
			alloc-ranges = <0x00 0xc0000000 0x04 0x00>;
			compatible = "mediatek,zone_movable_cma";
			size = <0x00 0x2d000000>;
		};
	};

	rt-pd-manager {
		compatible = "mediatek,rt-pd-manager";
	};

	rt9465_slave_chr {
		compatible = "richtek,rt9465";
		phandle = <0xd7>;
	};

	scp@10500000 {
		compatible = "mediatek,scp";
		core_1 = "enable";
		interrupts = <0x00 0xcd 0x04>;
		reg = <0x00 0x10500000 0x00 0x80000 0x00 0x105c0000 0x00 0x3000 0x00 0x105c4000 0x00 0x1000 0x00 0x105d4000 0x00 0x6000>;
		scp_sramSize = <0x80000>;
		status = "okay";
	};

	scp_dvfs {
		clock-names = "clk_mux\0clk_pll_0\0clk_pll_1\0clk_pll_2\0clk_pll_3\0clk_pll_4\0clk_pll_5\0clk_pll_6";
		clocks = <0x12 0x53 0x13 0x12 0x0e 0x12 0x1a 0x12 0x02 0x12 0x17 0x12 0x06 0x12 0x19>;
		compatible = "mediatek,scp_dvfs";
	};

	scpsys@10001000 {
		#clock-cells = <0x01>;
		compatible = "mediatek,scpsys\0syscon";
		phandle = <0x22>;
		reg = <0x00 0x10001000 0x00 0x1000 0x00 0x10006000 0x00 0x1000 0x00 0x14002000 0x00 0x1000 0x00 0x1020e000 0x00 0x1000 0x00 0x18004000 0x00 0x1000 0x00 0x18002000 0x00 0x1000 0x00 0x10000000 0x00 0x1000 0x00 0x16000000 0x00 0x1000 0x00 0x16025000 0x00 0x1000>;
	};

	security_ao@1001a000 {
		compatible = "mediatek,security_ao";
		reg = <0x00 0x1001a000 0x00 0x1000>;
	};

	seninf1@1a040000 {
		compatible = "mediatek,seninf1";
		reg = <0x00 0x1a040000 0x00 0x1000>;
	};

	seninf2@1a041000 {
		compatible = "mediatek,seninf2";
		reg = <0x00 0x1a041000 0x00 0x1000>;
	};

	seninf3@1a042000 {
		compatible = "mediatek,seninf3";
		reg = <0x00 0x1a042000 0x00 0x1000>;
	};

	seninf4@1a043000 {
		compatible = "mediatek,seninf4";
		reg = <0x00 0x1a043000 0x00 0x1000>;
	};

	serial@11002000 {
		clock-names = "baud\0bus";
		clocks = <0x13 0x21 0x16>;
		compatible = "mediatek,mt6577-uart";
		dma-names = "tx\0rx";
		dmas = <0x2f 0x00 0x2f 0x01>;
		interrupts = <0x00 0x70 0x08>;
		phandle = <0xac>;
		reg = <0x00 0x11002000 0x00 0x1000>;
	};

	serial@11003000 {
		clock-names = "baud\0bus";
		clocks = <0x13 0x21 0x17>;
		compatible = "mediatek,mt6577-uart";
		dma-names = "tx\0rx";
		dmas = <0x2f 0x02 0x2f 0x03>;
		interrupts = <0x00 0x71 0x08>;
		phandle = <0xad>;
		reg = <0x00 0x11003000 0x00 0x1000>;
	};

	sleep@10006000 {
		compatible = "mediatek,sleep";
		interrupts = <0x00 0xc3 0x08>;
		phandle = <0x6c>;
		reg = <0x00 0x10006000 0x00 0x1000>;
	};

	sleep_reg_md@1000f000 {
		compatible = "mediatek,sleep_reg_md";
		reg = <0x00 0x1000f000 0x00 0x1000>;
	};

	smart_pa {
		phandle = <0xdf>;
	};

	smi_common@14002000 {
		clock-names = "scp-dis\0mm-comm0\0mm-comm1\0mm-common";
		clocks = <0x22 0x03 0x24 0x15 0x24 0x16 0x24 0x13>;
		compatible = "mediatek,smi_common";
		mediatek,smi-id = <0x05>;
		mmsys_config = <0x24>;
		reg = <0x00 0x14002000 0x00 0x1000>;
	};

	smi_larb0@14003000 {
		clock-names = "scp-dis\0mm-larb0";
		clocks = <0x22 0x03 0x24 0x14>;
		compatible = "mediatek,smi_larb0\0mediatek,smi_larb";
		mediatek,smi-id = <0x00>;
		phandle = <0x55>;
		reg = <0x00 0x14003000 0x00 0x1000>;
	};

	smi_larb1@16010000 {
		clock-names = "scp-vdec\0mm-vdec\0vdec-larb1";
		clocks = <0x22 0x0c 0x24 0x1b 0x5a 0x03>;
		compatible = "mediatek,smi_larb1\0mediatek,smi_larb";
		interrupts = <0x00 0xf7 0x08>;
		mediatek,smi-id = <0x01>;
		phandle = <0x58>;
		reg = <0x00 0x16010000 0x00 0x1000>;
	};

	smi_larb2@15021000 {
		clock-names = "scp-isp\0mm-img\0img-larb2";
		clocks = <0x22 0x05 0x24 0x18 0x56 0x00>;
		compatible = "mediatek,smi_larb2\0mediatek,smi_larb";
		mediatek,smi-id = <0x02>;
		phandle = <0xca>;
		reg = <0x00 0x15021000 0x00 0x1000>;
	};

	smi_larb3@1a002000 {
		clock-names = "scp-cam\0mm-cam\0cam-larb3";
		clocks = <0x22 0x0a 0x24 0x19 0x57 0x00>;
		compatible = "mediatek,smi_larb3\0mediatek,smi_larb";
		mediatek,smi-id = <0x03>;
		phandle = <0xcb>;
		reg = <0x00 0x1a002000 0x00 0x1000>;
	};

	smi_larb4@17010000 {
		clock-names = "scp-venc\0mm-venc\0venc-venc\0venc-jpgenc";
		clocks = <0x22 0x0b 0x24 0x1a 0x5c 0x01 0x5c 0x02>;
		compatible = "mediatek,smi_larb4\0mediatek,smi_larb";
		mediatek,smi-id = <0x04>;
		phandle = <0x5b>;
		reg = <0x00 0x17010000 0x00 0x1000>;
	};

	snd_scp_spk {
		compatible = "mediatek,snd_scp_spk";
		phandle = <0xc7>;
	};

	sound {
		compatible = "mediatek,mt6768-mt6358-sound";
		mediatek,audio-codec = <0x52>;
		mediatek,platform = <0x53>;
		mtk_spk_i2s_in = <0x00>;
		mtk_spk_i2s_out = <0x03>;
		phandle = <0xc6>;
	};

	spi0@1100a000 {
		clock-names = "parent-clk\0sel-clk\0spi-clk";
		clocks = <0x12 0x0b 0x12 0x5b 0x21 0x1b>;
		compatible = "mediatek,mt6765-spi";
		interrupts = <0x00 0x8a 0x08>;
		mediatek,pad-select = <0x00>;
		phandle = <0xba>;
		reg = <0x00 0x1100a000 0x00 0x1000>;
	};

	spi1@11010000 {
		clock-names = "parent-clk\0sel-clk\0spi-clk";
		clocks = <0x12 0x0b 0x12 0x5b 0x21 0x34>;
		compatible = "mediatek,mt6765-spi";
		interrupts = <0x00 0x8b 0x08>;
		mediatek,pad-select = <0x00>;
		phandle = <0xc0>;
		reg = <0x00 0x11010000 0x00 0x1000>;
	};

	spi2@11012000 {
		clock-names = "parent-clk\0sel-clk\0spi-clk";
		clocks = <0x12 0x0b 0x12 0x5b 0x21 0x37>;
		compatible = "mediatek,mt6765-spi";
		interrupts = <0x00 0x91 0x08>;
		mediatek,pad-select = <0x00>;
		phandle = <0xb9>;
		reg = <0x00 0x11012000 0x00 0x1000>;
	};

	spi3@11013000 {
		clock-names = "parent-clk\0sel-clk\0spi-clk";
		clocks = <0x12 0x0b 0x12 0x5b 0x21 0x38>;
		compatible = "mediatek,mt6765-spi";
		interrupts = <0x00 0x92 0x08>;
		mediatek,pad-select = <0x00>;
		phandle = <0xc1>;
		reg = <0x00 0x11013000 0x00 0x1000>;
	};

	spi4@11014000 {
		clock-names = "parent-clk\0sel-clk\0spi-clk";
		clocks = <0x12 0x0b 0x12 0x5b 0x21 0x41>;
		compatible = "mediatek,mt6765-spi";
		interrupts = <0x00 0x74 0x08>;
		mediatek,pad-select = <0x00>;
		phandle = <0xc2>;
		reg = <0x00 0x11014000 0x00 0x1000>;
	};

	spi5@11015000 {
		clock-names = "parent-clk\0sel-clk\0spi-clk";
		clocks = <0x12 0x0b 0x12 0x5b 0x21 0x42>;
		compatible = "mediatek,mt6765-spi";
		interrupts = <0x00 0x75 0x08>;
		mediatek,pad-select = <0x00>;
		phandle = <0xc3>;
		reg = <0x00 0x11015000 0x00 0x1000>;
	};

	sramrom@10214000 {
		compatible = "mediatek,sramrom";
		reg = <0x00 0x10214000 0x00 0x1000>;
	};

	sspm@10440000 {
		compatible = "mediatek,sspm";
		interrupt-names = "ipc\0mbox0\0mbox1\0mbox2\0mbox3\0mbox4";
		interrupts = <0x00 0xd7 0x04 0x00 0xda 0x04 0x00 0xdb 0x04 0x00 0xdc 0x04 0x00 0xdd 0x04 0x00 0xde 0x04>;
		reg = <0x00 0x10440000 0x00 0x10000 0x00 0x10450000 0x00 0x100 0x00 0x10451000 0x00 0x08 0x00 0x10460000 0x00 0x100 0x00 0x10461000 0x00 0x08 0x00 0x10470000 0x00 0x100 0x00 0x10471000 0x00 0x08 0x00 0x10480000 0x00 0x100 0x00 0x10481000 0x00 0x08 0x00 0x10490000 0x00 0x100 0x00 0x10491000 0x00 0x08>;
		reg-names = "cfgreg\0mbox0_base\0mbox0_ctrl\0mbox1_base\0mbox1_ctrl\0mbox2_base\0mbox2_ctrl\0mbox3_base\0mbox3_ctrl\0mbox4_base\0mbox4_ctrl";
	};

	sys_cirq@10204000 {
		compatible = "mediatek,sys_cirq";
		interrupts = <0x00 0x127 0x08>;
		mediatek,cirq_num = <0xe8>;
		mediatek,spi_start_offset = <0x40>;
		reg = <0x00 0x10204000 0x00 0x1000>;
	};

	sys_timer@10017000 {
		clocks = <0x12 0x86>;
		compatible = "mediatek,sys_timer";
		interrupts = <0x00 0xcf 0x04>;
		reg = <0x00 0x10017000 0x00 0x1000>;
		reg-names = "sys_timer_base";
	};

	tcpc_pd_eint {
		phandle = <0xd9>;
	};

	therm_ctrl@1100b000 {
		clock-names = "therm-main";
		clocks = <0x21 0x0a>;
		compatible = "mediatek,therm_ctrl";
		interrupts = <0x00 0x63 0x08>;
		reg = <0x00 0x1100b000 0x00 0x1000>;
	};

	thermal-sensor1 {
		compatible = "mediatek,mtboard-thermistor1";
		io-channel-names = "thermistor-ch0";
		io-channels = <0x23 0x00>;
		phandle = <0xbc>;
	};

	thermal-sensor2 {
		compatible = "mediatek,mtboard-thermistor2";
		io-channel-names = "thermistor-ch1";
		io-channels = <0x23 0x01>;
		phandle = <0xbd>;
	};

	timer {
		clock-frequency = <0xc65d40>;
		compatible = "arm,armv8-timer";
		interrupt-parent = <0x11>;
		interrupts = <0x01 0x0d 0x08 0x01 0x0e 0x08 0x01 0x0b 0x08 0x01 0x0a 0x08>;
		phandle = <0x68>;
	};

	topckgen@10000000 {
		#clock-cells = <0x01>;
		compatible = "mediatek,topckgen\0syscon";
		phandle = <0x12>;
		reg = <0x00 0x10000000 0x00 0x1000>;
	};

	topckgen_ao@1001b000 {
		compatible = "mediatek,topckgen_ao";
		reg = <0x00 0x1001b000 0x00 0x1000>;
	};

	topmisc@10011000 {
		compatible = "mediatek,topmisc";
		reg = <0x00 0x10011000 0x00 0x1000>;
	};

	toprgu@10007000 {
		compatible = "mediatek,toprgu";
		interrupts = <0x00 0x9c 0x08>;
		phandle = <0x6d>;
		reg = <0x00 0x10007000 0x00 0x1000>;
	};

	touch {
		compatible = "mediatek,touch";
		phandle = <0xdc>;
	};

	trng@1020f000 {
		compatible = "mediatek,trng";
		interrupts = <0x00 0xb0 0x08>;
		reg = <0x00 0x1020f000 0x00 0x1000>;
	};

	type_c_port0 {
		phandle = <0xe4>;
		rt-tcpc,name = "type_c_port0";
		rt-tcpc,notifier_supply_num = <0x03>;
		rt-tcpc,role_def = <0x04>;
		rt-tcpc,rp_level = <0x00>;
		rt-tcpc,vconn_supply = <0x01>;
		rt1711pd,intr_gpio = <0x1e 0x29 0x00>;
		rt1711pd,intr_gpio_num = <0x29>;
		tcpc-dual,supported_modes = <0x00>;

		dpm_caps {
			attemp_discover_cable;
			attemp_discover_id;
			attemp_enter_dp_mode;
			dr_check = <0x00>;
			local_dr_data;
			local_dr_power;
			local_no_suspend;
			local_usb_comm;
			local_vconn_supply;
			pr_check = <0x00>;
			pr_check_gp_source;
		};

		pd-data {
			bat,nr = <0x01>;
			pd,charging_policy = <0x21>;
			pd,country_nr = <0x00>;
			pd,id-vdo-data = <0xd10029cf 0x00 0x10000>;
			pd,id-vdo-size = <0x03>;
			pd,mfrs = "RichtekTCPC";
			pd,pid = <0x5081>;
			pd,sink-pdo-data = <0x190c8 0xc0761e3c>;
			pd,sink-pdo-size = <0x02>;
			pd,source-cap-ext = <0x171129cf 0x00 0x102 0x00 0x00 0x2000000>;
			pd,source-pdo-data = <0x19032>;
			pd,source-pdo-size = <0x01>;
			pd,vid = <0x29cf>;

			bat-info0 {
				bat,design_cap = <0xbb8>;
				bat,mfrs = "bat1";
				bat,pid = <0x1711>;
				bat,vid = <0x29cf>;
			};
		};
	};

	usb0@11200000 {
		clock-names = "usb0\0usb0_clk_top_sel\0usb0_clk_univpll3_d4";
		clocks = <0x21 0x08 0x12 0x66 0x12 0x20>;
		compatible = "mediatek,mt6768-usb20";
		interrupts = <0x00 0x61 0x08>;
		mode = <0x02>;
		multipoint = <0x01>;
		num_eps = <0x10>;
		reg = <0x00 0x11200000 0x00 0x10000 0x00 0x11cc0000 0x00 0x10000>;
	};

	usb1p_sif@11210000 {
		compatible = "mediatek,usb1p_sif";
		reg = <0x00 0x11210000 0x00 0x10000>;
	};

	utos {
		compatible = "microtrust,utos";
		interrupts = <0x00 0x12b 0x01 0x00 0x12c 0x01>;
	};

	utos_tester {
		compatible = "microtrust,tester-v1";
	};

	vcu@16000000 {
		compatible = "mediatek-vcu";
		gce-event-names = "venc_eof\0venc_cmdq_pause_done\0venc_mb_done\0venc_128B_cnt_done";
		gce-events = <0x2e 0x121 0x2e 0x122 0x2e 0x124 0x2e 0x125>;
		mboxes = <0x2e 0x01 0x00 0x01 0x2e 0x05 0x00 0x01>;
		mediatek,mailbox-gce = <0x2e>;
		mediatek,vcuid = <0x00>;
		mediatek,vcuname = "vcu";
		phandle = <0x59>;
		reg = <0x00 0x16000000 0x00 0x40000 0x00 0x17020000 0x00 0x10000 0x00 0x19002000 0x00 0x1000>;
	};

	vdec@16020000 {
		compatible = "mediatek,vdec";
		interrupts = <0x00 0xf6 0x08>;
		reg = <0x00 0x16020000 0x00 0x10000>;
	};

	vdec_gcon@16000000 {
		#clock-cells = <0x01>;
		clock-names = "MT_SCP_SYS_DIS\0MT_SCP_SYS_VDE\0MT_CG_VDEC";
		clocks = <0x22 0x03 0x22 0x0c 0x5a 0x00>;
		compatible = "mediatek,vdec_gcon\0syscon";
		interrupts = <0x00 0xf6 0x08>;
		mediatek,larb = <0x58>;
		mediatek,vcu = <0x59>;
		phandle = <0x5a>;
		reg = <0x00 0x16000000 0x00 0x1000 0x00 0x16020000 0x00 0x400 0x00 0x16025000 0x00 0x1000>;
	};

	vdec_mbist_ctrl@16001000 {
		compatible = "mediatek,vdec_mbist_ctrl";
		reg = <0x00 0x16001000 0x00 0x1000>;
	};

	venc@17020000 {
		compatible = "mediatek,venc";
		interrupts = <0x00 0xf3 0x08>;
		reg = <0x00 0x17020000 0x00 0x10000>;
	};

	venc_gcon@17000000 {
		#clock-cells = <0x01>;
		clock-names = "MT_SCP_SYS_DIS\0MT_SCP_SYS_VEN\0MT_CG_VENC";
		clocks = <0x22 0x03 0x22 0x0b 0x5c 0x01>;
		compatible = "mediatek,venc_gcon\0syscon";
		interrupts = <0x00 0xf3 0x08>;
		mediatek,larb = <0x5b>;
		mediatek,vcu = <0x59>;
		phandle = <0x5c>;
		reg = <0x00 0x17000000 0x00 0x1000 0x00 0x17020000 0x00 0x1000>;
	};

	venc_jpg@17030000 {
		clock-names = "MT_CG_VENC_JPGENC";
		clocks = <0x5c 0x02>;
		compatible = "mediatek,venc_jpg";
		interrupts = <0x00 0xf5 0x08>;
		reg = <0x00 0x17030000 0x00 0x10000>;
	};

	wifi@18000000 {
		compatible = "mediatek,wifi";
		interrupts = <0x00 0x11d 0x08>;
		reg = <0x00 0x18000000 0x00 0x100000>;
	};
};
